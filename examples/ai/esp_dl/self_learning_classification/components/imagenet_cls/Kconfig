## examples/bluetooth/ble_adv/bthome/dimmer/main/Kconfig.projbuild
```kconfig
menu "Example Configuration"

    choice EXAMPLE_MAX_CPU_FREQ
        prompt "Maximum CPU frequency"
        default EXAMPLE_MAX_CPU_FREQ_80
        depends on PM_ENABLE
        help
            Maximum CPU frequency to use for dynamic frequency scaling.

        config EXAMPLE_MAX_CPU_FREQ_80
            bool "80 MHz"
        config EXAMPLE_MAX_CPU_FREQ_120
            bool "120 MHz"
            depends on IDF_TARGET_ESP32C2
        config EXAMPLE_MAX_CPU_FREQ_160
            bool "160 MHz"
            depends on !IDF_TARGET_ESP32C2
        config EXAMPLE_MAX_CPU_FREQ_240
            bool "240 MHz"
            depends on IDF_TARGET_ESP32 || IDF_TARGET_ESP32S2 || IDF_TARGET_ESP32S3 || IDF_TARGET_ESP32C5
    endchoice

    config EXAMPLE_MAX_CPU_FREQ_MHZ
        int
        default 80 if EXAMPLE_MAX_CPU_FREQ_80
        default 120 if EXAMPLE_MAX_CPU_FREQ_120
        default 160 if EXAMPLE_MAX_CPU_FREQ_160
        default 240 if EXAMPLE_MAX_CPU_FREQ_240

    choice EXAMPLE_MIN_CPU_FREQ
        prompt "Minimum CPU frequency"
        default EXAMPLE_MIN_CPU_FREQ_48M if IDF_TARGET_ESP32C5
        default EXAMPLE_MIN_CPU_FREQ_10M
        depends on PM_ENABLE
        help
            Minimum CPU frequency to use for dynamic frequency scaling.
            Should be set to XTAL frequency or XTAL frequency divided by integer.

        config EXAMPLE_MIN_CPU_FREQ_48M
            bool "48 MHz (use with 48MHz XTAL)"
            depends on XTAL_FREQ_48 || (XTAL_FREQ_AUTO && IDF_TARGET_ESP32C5)
        config EXAMPLE_MIN_CPU_FREQ_40M
            bool "40 MHz (use with 40MHz XTAL)"
            depends on XTAL_FREQ_40 || XTAL_FREQ_AUTO
        config EXAMPLE_MIN_CPU_FREQ_24M
            bool "24 MHz (use with 48MHz XTAL)"
            depends on XTAL_FREQ_48 || (XTAL_FREQ_AUTO && IDF_TARGET_ESP32C5)
        config EXAMPLE_MIN_CPU_FREQ_20M
            bool "20 MHz (use with 40MHz XTAL)"
            depends on XTAL_FREQ_40 || XTAL_FREQ_AUTO
        config EXAMPLE_MIN_CPU_FREQ_12M
            bool "12 MHz (use with 48MHz XTAL)"
            depends on XTAL_FREQ_48 || (XTAL_FREQ_AUTO && IDF_TARGET_ESP32C5)
        config EXAMPLE_MIN_CPU_FREQ_10M
            bool "10 MHz (use with 40MHz XTAL)"
            depends on XTAL_FREQ_40 || XTAL_FREQ_AUTO
        config EXAMPLE_MIN_CPU_FREQ_26M
            bool "26 MHz (use with 26MHz XTAL)"
            depends on XTAL_FREQ_26 || (XTAL_FREQ_AUTO && IDF_TARGET_ESP32C2)
        config EXAMPLE_MIN_CPU_FREQ_13M
            bool "13 MHz (use with 26MHz XTAL)"
            depends on XTAL_FREQ_26 || (XTAL_FREQ_AUTO && IDF_TARGET_ESP32C2)
    endchoice

    config EXAMPLE_MIN_CPU_FREQ_MHZ
        int
        default 48 if EXAMPLE_MIN_CPU_FREQ_48M
        default 40 if EXAMPLE_MIN_CPU_FREQ_40M
        default 24 if EXAMPLE_MIN_CPU_FREQ_24M
        default 20 if EXAMPLE_MIN_CPU_FREQ_20M
        default 12 if EXAMPLE_MIN_CPU_FREQ_12M
        default 10 if EXAMPLE_MIN_CPU_FREQ_10M
        default 26 if EXAMPLE_MIN_CPU_FREQ_26M
        default 13 if EXAMPLE_MIN_CPU_FREQ_13M

    config EXAMPLE_POWER_SAVE_RESAMPLE
        bool "Resample beacon when beacon loss is unstable"
        depends on ESP_WIFI_SLP_SAMPLE_BEACON_FEATURE

    config EXAMPLE_GPIO_KNOB_A
        int "Rotary Encoder A Pin"
        range 0 48
        default 2
        help
            GPIO number for rotary encoder A pin.

    config EXAMPLE_GPIO_KNOB_B
        int "Rotary Encoder B Pin"
        range 0 48
        default 3
        help
            GPIO number for rotary encoder B pin.

    config EXAMPLE_POWER_CTRL_IO_NUM
        int "Power Control Pin"
        range 0 48
        default 9
        help
            GPIO number for power control.

    config EXAMPLE_BUTTON_IO_NUM
        int "Button Pin"
        range 0 48
        default 0
        help
            GPIO number for button.

    config EXAMPLE_BUTTON_ACTIVE_LEVEL
        int "Button Active Level"
        range 0 1
        default 0
        help
            Button active level (0 for active low, 1 for active high).

endmenu
```

## examples/bluetooth/ble_adv/bthome/dimmer/sdkconfig.defaults
```kconfig
CONFIG_BOOTLOADER_LOG_LEVEL_ERROR=y
CONFIG_BOOTLOADER_SKIP_VALIDATE_ALWAYS=y

CONFIG_BT_ENABLED=y
CONFIG_BT_CONTROLLER_ONLY=y
CONFIG_BT_LE_SLEEP_ENABLE=y

CONFIG_PM_ENABLE=y
CONFIG_PM_DFS_INIT_AUTO=y
CONFIG_FREERTOS_HZ=1000
CONFIG_FREERTOS_USE_TICKLESS_IDLE=y

CONFIG_LOG_DEFAULT_LEVEL_WARN=y

CONFIG_OPENTHREAD_RX_ON_WHEN_IDLE=y
CONFIG_GPIO_BUTTON_SUPPORT_POWER_SAVE=y
```

## examples/bluetooth/ble_adv/bthome/dimmer/sdkconfig.defaults.esp32h4
```kconfig
CONFIG_BOOTLOADER_LOG_LEVEL_ERROR=y
CONFIG_BOOTLOADER_SKIP_VALIDATE_ALWAYS=y

CONFIG_BT_ENABLED=y
CONFIG_BT_CONTROLLER_ONLY=y
CONFIG_BT_LE_SLEEP_ENABLE=y

CONFIG_PM_ENABLE=y
CONFIG_PM_DFS_INIT_AUTO=y
CONFIG_FREERTOS_HZ=1000
CONFIG_FREERTOS_USE_TICKLESS_IDLE=y

CONFIG_LOG_DEFAULT_LEVEL_WARN=y

CONFIG_OPENTHREAD_RX_ON_WHEN_IDLE=y
CONFIG_GPIO_BUTTON_SUPPORT_POWER_SAVE=y

CONFIG_BT_CTRL_SLEEP_ENABLE=y
CONFIG_BT_CTRL_LP_CLK_SRC_DEFAULT=y
CONFIG_PM_POWER_DOWN_PERIPHERAL_IN_LIGHT_SLEEP=y
CONFIG_EXAMPLE_BUTTON_KNOB_USE_RTC_IO=y

# RTC slow clock: external 32 kHz crystal (lower sleep current than INT_RC)
CONFIG_RTC_CLK_SRC_EXT_CRYS=y
```

## examples/bluetooth/ble_conn_mgr/ble_ext_adv/sdkconfig.defaults
```kconfig
# Override some defaults so BT stack is enabled
# by default in this example
CONFIG_BT_ENABLED=y
CONFIG_BT_NIMBLE_ENABLED=y
CONFIG_BT_NIMBLE_EXT_ADV=y

CONFIG_BLE_CONN_MGR_ROLE_PERIPHERAL=y
CONFIG_BLE_CONN_MGR_EXTENDED_ADV=y
# Non-legacy extended: do not use connectable+scannable together (NimBLE returns BLE_HS_EINVAL).
CONFIG_BLE_CONN_MGR_EXTENDED_ADV_CAP=0
# This demo focuses on extended advertising only (no periodic train)
CONFIG_BLE_CONN_MGR_PERIODIC_ADV=n
```

## examples/bluetooth/ble_conn_mgr/ble_ext_scan/sdkconfig.defaults
```kconfig
# Override some defaults so BT stack is enabled
# by default in this example
CONFIG_BT_ENABLED=y
CONFIG_BT_NIMBLE_ENABLED=y
CONFIG_BT_NIMBLE_EXT_ADV=y

CONFIG_BLE_CONN_MGR_ROLE_CENTRAL=y
# Extended scan only (no periodic sync)
CONFIG_BLE_CONN_MGR_PERIODIC_SYNC=n
# Per-fragment buffer for extended reports (HCI fragment up to 255 B)
CONFIG_BLE_CONN_MGR_SCAN_RESULT_ADV_MAX_LEN=255
```

## examples/bluetooth/ble_conn_mgr/ble_periodic_adv/main/Kconfig.projbuild
```kconfig
menu "Example Configuration"
    config EXAMPLE_BLE_ADV_NAME
    string "Advertisement name"
    default "ESP_PERIODIC_ADV"
    help
      The device name inside advertisement.

    config EXAMPLE_BLE_SUB_ADV
    string "Subsequent advertisement data"
    default "SUB_ADV"
    help
      The data inside subsequent advertisements.

    config EXAMPLE_EXTENDED_ADV
        bool
        default n
        prompt "Enable Set Extended Adv Data"
        help
            Use this option to enable set extended advertising data in the example.
endmenu
```

## examples/bluetooth/ble_conn_mgr/ble_periodic_adv/sdkconfig.defaults
```kconfig
# Override some defaults so BT stack is enabled
# by default in this example
CONFIG_BT_ENABLED=y
CONFIG_BT_NIMBLE_ENABLED=y

CONFIG_BLE_CONN_MGR_ROLE_PERIPHERAL=y
CONFIG_BLE_CONN_MGR_EXT=y
CONFIG_BLE_CONN_MGR_EXTENDED_ADV=y
CONFIG_BLE_CONN_MGR_PERIODIC_ADV=y

CONFIG_EXAMPLE_EXTENDED_ADV=y
```

## examples/bluetooth/ble_conn_mgr/ble_periodic_sync/main/Kconfig.projbuild
```kconfig
menu "Example Configuration"
    config EXAMPLE_BLE_ADV_NAME
    string "Advertisement name"
    default "ESP_PERIODIC_ADV"
    help
      The device name inside advertisement.

    config EXAMPLE_BLE_SUB_ADV
    string "Subsequent advertisement data"
    default "SUB_ADV"
    help
      The data inside subsequent advertisements.
endmenu
```

## examples/bluetooth/ble_conn_mgr/ble_periodic_sync/sdkconfig.defaults
```kconfig
# Override some defaults so BT stack is enabled
# by default in this example
CONFIG_BT_ENABLED=y
CONFIG_BT_NIMBLE_ENABLED=y

CONFIG_BLE_CONN_MGR_ROLE_CENTRAL=y
CONFIG_BLE_CONN_MGR_EXT=y
CONFIG_BLE_CONN_MGR_PERIODIC_SYNC=y

CONFIG_EXAMPLE_EXTENDED_ADV=y
```
