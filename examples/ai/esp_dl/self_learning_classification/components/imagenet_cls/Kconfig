## examples/ai/esp_dl/self_learning_classification/components/imagenet_cls/Kconfig
```kconfig
menu "models: imagenet_cls"
    config FLASH_IMAGENET_CLS_MOBILENETV2_S8_V1
        bool "flash imagenet_cls_mobilenetv2_s8_v1"
        default y

    choice
        prompt "default model"
        default IMAGENET_CLS_MOBILENETV2_S8_V1
        help
            default imagenet_cls model
        config IMAGENET_CLS_MOBILENETV2_S8_V1
            bool "imagenet_cls_mobilenetv2_s8_v1"
            depends on IMAGENET_CLS_MODEL_IN_SDCARD || FLASH_IMAGENET_CLS_MOBILENETV2_S8_V1
    endchoice

    config DEFAULT_IMAGENET_CLS_MODEL
        int
        default 0 if IMAGENET_CLS_MOBILENETV2_S8_V1

    choice
        prompt "model location"
        default IMAGENET_CLS_MODEL_IN_FLASH_RODATA
        help
            imagenet_cls model location
        config IMAGENET_CLS_MODEL_IN_FLASH_RODATA
            bool "flash_rodata"
        config IMAGENET_CLS_MODEL_IN_FLASH_PARTITION
            bool "flash_partition"
    endchoice

    config IMAGENET_CLS_MODEL_LOCATION
        int
        default 0 if IMAGENET_CLS_MODEL_IN_FLASH_RODATA
        default 1 if IMAGENET_CLS_MODEL_IN_FLASH_PARTITION
endmenu
```

## examples/ai/esp_dl/self_learning_classification/main/Kconfig.projbuild
```kconfig
menu "Example Configuration"

    config EXAMPLE_CV_CONTOUR_FILTER_AREA_THRESHOLD
        int "Contour Filtering Area Threshold"
        default 5000
        help
            Contours with an area smaller than this value will be filtered out.
            Helps remove noise and small irrelevant shapes during image processing.

    config EXAMPLE_LCD_BUF_COUNT
        int "LCD Buffer Count"
        default 2
        range 2 3

    menu "Primary Color Range"
        config PRIMARY_COLOR_LOWER_H
            int "Primary Lower H (Hue)"
            range 0 255
            default 0
            help
                Specifies the minimum hue value for the primary color range.

        config PRIMARY_COLOR_LOWER_S
            int "Primary Lower S (Saturation)"
            range 0 255
            default 120
            help
                Specifies the minimum saturation value for the primary color range.

        config PRIMARY_COLOR_LOWER_V
            int "Primary Lower V (Value)"
            range 0 255
            default 70
            help
                Specifies the minimum value for the primary color range.

        config PRIMARY_COLOR_UPPER_H
            int "Primary Upper H (Hue)"
            range 0 255
            default 10
            help
                Specifies the maximum hue value for the primary color range.

        config PRIMARY_COLOR_UPPER_S
            int "Primary Upper S (Saturation)"
            range 0 255
            default 255
            help
                Specifies the maximum saturation value for the primary color range.

        config PRIMARY_COLOR_UPPER_V
            int "Primary Upper V (Value)"
            range 0 255
            default 255
            help
                Specifies the maximum value for the primary color range.
    endmenu

    menu "Secondary Color Range"
        config SECONDARY_COLOR_LOWER_H
            int "Secondary Lower H (Hue)"
            range 0 255
            default 170
            help
                Specifies the minimum hue value for the secondary color range.

        config SECONDARY_COLOR_LOWER_S
            int "Secondary Lower S (Saturation)"
            range 0 255
            default 120
            help
                Specifies the minimum saturation value for the secondary color range.

        config SECONDARY_COLOR_LOWER_V
            int "Secondary Lower V (Value)"
            range 0 255
            default 70
            help
                Specifies the minimum value for the secondary color range.

        config SECONDARY_COLOR_UPPER_H
            int "Secondary Upper H (Hue)"
            range 0 255
            default 180
            help
                Specifies the maximum hue value for the secondary color range.

        config SECONDARY_COLOR_UPPER_S
            int "Secondary Upper S (Saturation)"
            range 0 255
            default 255
            help
                Specifies the maximum saturation value for the secondary color range.

        config SECONDARY_COLOR_UPPER_V
            int "Secondary Upper V (Value)"
            range 0 255
            default 255
            help
                Specifies the maximum value for the secondary color range.
    endmenu
endmenu
```

## examples/ai/esp_dl/self_learning_classification/sdkconfig.defaults
```kconfig
# Common defaults shared by all targets.
CONFIG_BOOTLOADER_COMPILER_OPTIMIZATION_PERF=y
CONFIG_ESPTOOLPY_FLASHSIZE_16MB=y
CONFIG_PARTITION_TABLE_CUSTOM=y
CONFIG_PARTITION_TABLE_OFFSET=0x9000
CONFIG_SPIRAM=y
CONFIG_SPIRAM_XIP_FROM_PSRAM=y
CONFIG_FREERTOS_HZ=1000
CONFIG_LV_FONT_MONTSERRAT_20=y
CONFIG_LV_FONT_MONTSERRAT_30=y
CONFIG_IDF_EXPERIMENTAL_FEATURES=y
```

## examples/ai/esp_dl/self_learning_classification/sdkconfig.defaults.esp32p4
```kconfig
CONFIG_IDF_TARGET="esp32p4"
CONFIG_CACHE_L2_CACHE_256KB=y
CONFIG_CACHE_L2_CACHE_LINE_128B=y
CONFIG_BSP_LCD_DPI_BUFFER_NUMS=3
CONFIG_BSP_DISPLAY_LVGL_AVOID_TEAR=y
CONFIG_CAMERA_SC2336=y
CONFIG_ESP_VIDEO_ENABLE_ISP_PIPELINE_CONTROLLER=y
CONFIG_CAMERA_SC2336_MIPI_RAW10_640X480_50FPS=y
CONFIG_CAMERA_SC2336_MIPI_DEFAULT_FMT_RAW10_640X480_50FPS=y
```

## examples/ai/esp_dl/self_learning_classification/sdkconfig.defaults.esp32s31
```kconfig
CONFIG_IDF_TARGET="esp32s31"
CONFIG_SPIRAM_SPEED_250M=y
CONFIG_CAMERA_OV3660=y
CONFIG_CAMERA_OV3660_DVP_RGB565_BE_640X480_10FPS=y
CONFIG_CAMERA_OV3660_DVP_DEFAULT_FMT_RGB565_BE_640X480_10FPS=y
CONFIG_ESP_VIDEO_ENABLE_DVP_VIDEO_DEVICE=y
```

## examples/ai/esp_dl/touchpad_digit_recognition/sdkconfig.defaults
```kconfig
CONFIG_FREERTOS_HZ=1000

# Suppress Touch API deprecation warnings in IDF 5.5
CONFIG_TOUCH_SUPPRESS_DEPRECATE_WARN=y
```

## examples/ai/esp_dl/touchpad_digit_recognition/sdkconfig.defaults.esp32s3
```kconfig
CONFIG_IDF_TARGET="esp32s3"
CONFIG_BOOTLOADER_COMPILER_OPTIMIZATION_PERF=y
CONFIG_BOOTLOADER_LOG_LEVEL_NONE=y
CONFIG_ESPTOOLPY_FLASHSIZE_4MB=y
CONFIG_PARTITION_TABLE_CUSTOM=y
CONFIG_PARTITION_TABLE_CUSTOM_FILENAME="partitions.csv"
CONFIG_SPIRAM=y
CONFIG_SPIRAM_MODE_QUAD=y
CONFIG_ESP_DEFAULT_CPU_FREQ_MHZ_240=y
CONFIG_ESP32S3_INSTRUCTION_CACHE_32KB=y
CONFIG_ESP32S3_DATA_CACHE_64KB=y
CONFIG_ESP32S3_DATA_CACHE_LINE_64B=y
CONFIG_ESP_SYSTEM_ALLOW_RTC_FAST_MEM_AS_HEAP=n
CONFIG_ESP_INT_WDT=n
CONFIG_ESP_TASK_WDT_EN=n
```

## examples/ai/xiaozhi_chat/components/esp_board_manager_adapter/example/basic/sdkconfig.defaults
```kconfig
#
# Bootloader config
#
CONFIG_BOOTLOADER_OFFSET_IN_FLASH=0x1000
CONFIG_BOOTLOADER_COMPILER_OPTIMIZATION_SIZE=y

CONFIG_FREERTOS_ENABLE_BACKWARD_COMPATIBILITY=y

#
# Serial flasher config
#
CONFIG_ESPTOOLPY_HEADER_FLASHSIZE_UPDATE=y
CONFIG_ESPTOOLPY_BEFORE_RESET=y
# end of Serial flasher config

#
# Partition Table
#
CONFIG_PARTITION_TABLE_SINGLE_APP=y
CONFIG_PARTITION_TABLE_MD5=y
# end of Partition Table


CONFIG_FATFS_CODEPAGE_936=y
CONFIG_FATFS_CODEPAGE=936
CONFIG_FATFS_MAX_LFN=255
CONFIG_FATFS_API_ENCODING_UTF_8=y
CONFIG_FATFS_LFN_STACK=y
CONFIG_FATFS_SECTOR_4096=y

#
# SPI RAM config
#
CONFIG_SPIRAM=y
CONFIG_SPIRAM_ALLOW_BSS_SEG_EXTERNAL_MEMORY=y
CONFIG_SPIRAM_ALLOW_NOINIT_SEG_EXTERNAL_MEMORY=y

#
# ESP Board Manager Configuration
#
CONFIG_ESP_BOARD_MANAGER_AUTO_CONFIG_DEVICE_AND_PERIPHERAL=y
# end of ESP Board Manager Configuration

CONFIG_PARTITION_TABLE_CUSTOM=y
CONFIG_PARTITION_TABLE_CUSTOM_FILENAME="partitions_test_app.csv"
CONFIG_PARTITION_TABLE_FILENAME="partitions_test_app.csv"


CONFIG_ESPTOOLPY_FLASHSIZE_8MB=y
CONFIG_ESPTOOLPY_FLASHSIZE="8MB"
CONFIG_ESPTOOLPY_HEADER_FLASHSIZE_UPDATE=y


CONFIG_LV_COLOR_16_SWAP=y


CONFIG_ESP_LCD_TOUCH_CST816S_DISABLE_READ_ID=y
```

## examples/ai/xiaozhi_chat/components/esp_board_manager_adapter/example/basic/sdkconfig.defaults.esp32s3
```kconfig
CONFIG_IDF_CMAKE=y
CONFIG_IDF_TARGET_ARCH_XTENSA=y
CONFIG_IDF_TARGET="esp32s3"
CONFIG_IDF_TARGET_ESP32S3=y
CONFIG_IDF_FIRMWARE_CHIP_ID=0x0009

CONFIG_ESP32S3_DEFAULT_CPU_FREQ_240=y
CONFIG_ESP32S3_DEFAULT_CPU_FREQ_MHZ=240

CONFIG_SPIRAM_MODE_OCT=y
CONFIG_SPIRAM_TYPE_AUTO=y
CONFIG_SPIRAM_SPEED_80M=y
```

## examples/ai/xiaozhi_chat/main/Kconfig
```kconfig
menu "Xiaozhi Chat Application"
    choice XIAOZHI_CHAT_APP_TRANSPORT
        prompt "Preferred transport when both MQTT and WebSocket are supported"
        default XIAOZHI_CHAT_APP_TRANSPORT_AUTO
        help
            When the server provides both MQTT and WebSocket, this option selects which to use.
            If "Auto (prefer MQTT)" is selected, MQTT is used when both are available.

        config XIAOZHI_CHAT_APP_TRANSPORT_AUTO
            bool "Auto (prefer MQTT)"
        config XIAOZHI_CHAT_APP_TRANSPORT_MQTT
            bool "MQTT"
        config XIAOZHI_CHAT_APP_TRANSPORT_WEBSOCKET
            bool "WebSocket"
    endchoice
endmenu
```

## examples/ai/xiaozhi_chat/sdkconfig.defaults
```kconfig
CONFIG_COMPILER_CXX_EXCEPTIONS=y
CONFIG_COMPILER_CXX_EXCEPTIONS_EMG_POOL_SIZE=1024

CONFIG_BOOTLOADER_COMPILER_OPTIMIZATION_PERF=y
CONFIG_BOOTLOADER_LOG_LEVEL_NONE=y
CONFIG_BOOTLOADER_SKIP_VALIDATE_ALWAYS=y
CONFIG_BOOTLOADER_APP_ROLLBACK_ENABLE=y

CONFIG_HTTPD_MAX_REQ_HDR_LEN=2048
CONFIG_HTTPD_MAX_URI_LEN=2048

CONFIG_PARTITION_TABLE_CUSTOM=y
CONFIG_PARTITION_TABLE_CUSTOM_FILENAME="partitions.csv"
CONFIG_PARTITION_TABLE_OFFSET=0x8000

CONFIG_ESP_TASK_WDT_TIMEOUT_S=10
CONFIG_FREERTOS_GENERATE_RUN_TIME_STATS=y
CONFIG_FREERTOS_USE_STATS_FORMATTING_FUNCTIONS=y

CONFIG_ESP_MAIN_TASK_STACK_SIZE=8192
CONFIG_MBEDTLS_DYNAMIC_BUFFER=y
CONFIG_MBEDTLS_SSL_KEEP_PEER_CERTIFICATE=n
CONFIG_ESP_WIFI_IRAM_OPT=n
CONFIG_ESP_WIFI_RX_IRAM_OPT=n
CONFIG_ESP_WIFI_DYNAMIC_RX_MGMT_BUFFER=y

# These entries are copied from ESP-HI (ESP32C3) to reduce memory usage
CONFIG_ESP_WIFI_STATIC_RX_BUFFER_NUM=6
CONFIG_ESP_WIFI_DYNAMIC_RX_BUFFER_NUM=8
CONFIG_NEWLIB_NANO_FORMAT=y
CONFIG_ESP_WIFI_ENTERPRISE_SUPPORT=n

CONFIG_CODEC_I2C_BACKWARD_COMPATIBLE=n

# Fix ML307 FIFO Overflow
CONFIG_UART_ISR_IN_IRAM=y

# LVGL 9.2.2
# Enable LVGL adapter FS so EAF assets can be mounted (esp_lv_adapter_fs_mount)
CONFIG_ESP_LVGL_ADAPTER_ENABLE_FS=y

CONFIG_LV_OS_NONE=y
CONFIG_LV_USE_OS=0
CONFIG_LV_USE_CLIB_MALLOC=y
CONFIG_LV_USE_CLIB_STRING=y
CONFIG_LV_USE_CLIB_SPRINTF=y
CONFIG_LV_USE_IMGFONT=y

# Use compressed font
CONFIG_LV_FONT_FMT_TXT_LARGE=y
CONFIG_LV_USE_FONT_COMPRESSED=y
CONFIG_LV_USE_FONT_PLACEHOLDER=y

# Enable Chinese font support (Source Han Sans SC CJK)
CONFIG_LV_FONT_SOURCE_HAN_SANS_SC_14_CJK=y
CONFIG_LV_FONT_DEFAULT_SOURCE_HAN_SANS_SC_14_CJK=y

# Disable extra widgets to save flash size
CONFIG_LV_USE_ANIMIMG=n
CONFIG_LV_USE_CALENDAR=n
CONFIG_LV_USE_CALENDAR_HEADER_ARROW=n
CONFIG_LV_USE_CALENDAR_HEADER_DROPDOWN=n
CONFIG_LV_USE_CHART=n
CONFIG_LV_USE_KEYBOARD=n
CONFIG_LV_USE_LED=n
CONFIG_LV_USE_LIST=n
CONFIG_LV_USE_MENU=n
CONFIG_LV_USE_MSGBOX=n
CONFIG_LV_USE_SPAN=n
CONFIG_LV_USE_SPINBOX=n
CONFIG_LV_USE_SPINNER=n
CONFIG_LV_USE_TABVIEW=n
CONFIG_LV_USE_TILEVIEW=n
CONFIG_LV_USE_WIN=n

CONFIG_LV_BUILD_EXAMPLES=n

# ESP Board Manager Configuration - Select ESP-BOX-3 board
# CONFIG_BOARD_ECHOEAR_CORE_BOARD_V1_2 is not set
CONFIG_BOARD_ESP_BOX_3=y
CONFIG_BOARD_NAME="esp_box_3"

# ESP Board Manager - Device Support for esp_box_3
CONFIG_ESP_BOARD_DEV_AUDIO_CODEC_SUPPORT=y
CONFIG_ESP_BOARD_DEV_DISPLAY_LCD_SUPPORT=y
CONFIG_ESP_BOARD_DEV_DISPLAY_LCD_SUB_SPI_SUPPORT=y
CONFIG_ESP_BOARD_DEV_FS_FAT_SUPPORT=y
CONFIG_ESP_BOARD_DEV_FS_FAT_SUB_SDMMC_SUPPORT=y
CONFIG_ESP_BOARD_DEV_LCD_TOUCH_I2C_SUPPORT=y
CONFIG_ESP_BOARD_DEV_LEDC_CTRL_SUPPORT=y
CONFIG_ESP_BOARD_DEV_POWER_CTRL_SUPPORT=y
CONFIG_ESP_BOARD_DEV_POWER_CTRL_SUB_GPIO_SUPPORT=y

CONFIG_VOICE_WAKEUP_MODE=y
CONFIG_SR_WN_WN9_NIHAOXIAOZHI_TTS=y
CONFIG_SR_WN_WN9_HILEXIN=n
```

## examples/audio/wav_player/main/Kconfig.projbuild
```kconfig
menu "WAV Player Configuration"

    config STORAGE_SDCARD
        bool "STORAGE SDCARD"
        default n
        help
            Audio files in SD card, if it is not selected, the file in flash will be used

endmenu
```

## examples/audio/wav_player/sdkconfig.defaults
```kconfig
#
# SDK tool configuration
#
CONFIG_ESPTOOLPY_FLASHSIZE_4MB=y

CONFIG_PARTITION_TABLE_CUSTOM=y
CONFIG_PARTITION_TABLE_CUSTOM_FILENAME="partitions.csv"


CONFIG_FREERTOS_HZ=1000

#
# FAT Filesystem support
#
CONFIG_FATFS_CODEPAGE_437=y
CONFIG_FATFS_LFN_HEAP=y
CONFIG_FATFS_MAX_LFN=255
```

## examples/bluetooth/ble_adv/bthome/bulb/main/Kconfig.projbuild
```kconfig
menu "BTHome Bulb Configuration"

    config EXAMPLE_LED_STRIP_BLINK_GPIO
        int "LED Strip GPIO Pin"
        range 0 48
        default 8
        help
            GPIO number for LED strip data line.

    config EXAMPLE_LED_STRIP_LED_NUMBERS
        int "Number of LEDs in Strip"
        range 1 255
        default 1
        help
            Number of LEDs in the LED strip.

    config EXAMPLE_LED_STRIP_RMT_RES_HZ
        int "RMT Resolution Frequency (Hz)"
        range 1000000 10000000
        default 10000000
        help
            RMT counter clock frequency. 10MHz resolution means 1 tick = 0.1us.

endmenu
```
