## examples/motor/bldc_fan_rainmaker/main/Kconfig.projbuild
```kconfig
menu "ESP RainMaker App Wi-Fi Provisioning"

    config APP_WIFI_PROV_SHOW_QR
        bool "Show provisioning QR code"
        default y
        help
            Show the QR code for provisioning.

    choice APP_WIFI_PROV_TRANSPORT
        bool "Provisioning Transport method"
        default APP_WIFI_PROV_TRANSPORT_BLE
        help
            Wi-Fi provisioning component offers both, SoftAP and BLE transports. Choose any one.

        config APP_WIFI_PROV_TRANSPORT_SOFTAP
            bool "Soft AP"
        config APP_WIFI_PROV_TRANSPORT_BLE
            bool "BLE"
            select BT_ENABLED
            depends on !IDF_TARGET_ESP32S2
    endchoice

    config APP_WIFI_PROV_TRANSPORT
        int
        default 1 if APP_WIFI_PROV_TRANSPORT_SOFTAP
        default 2 if APP_WIFI_PROV_TRANSPORT_BLE

    config APP_WIFI_RESET_PROV_ON_FAILURE
        bool
        default y
        prompt "Reset provisioned credentials and state machine after session failure"
        help
            Enable reseting provisioned credentials and state machine after session failure.
            This will restart the provisioning service after retries are exhausted.

    config APP_WIFI_PROV_MAX_RETRY_CNT
        int
        default 5
        prompt "Max retries before reseting provisioning state machine"
        depends on APP_WIFI_RESET_PROV_ON_FAILURE
        help
            Set the Maximum retry to avoid reconnecting to an inexistent AP or if credentials
            are misconfigured. Provisioned credentials are erased and internal state machine
            is reset after this threshold is reached.

    config APP_WIFI_SHOW_DEMO_INTRO_TEXT
        bool "Show intro text for demos"
        default n
        help
            Show some intro text for demos in order to help users understand more about ESP RainMaker.

    config APP_WIFI_PROV_TIMEOUT_PERIOD
        int "Provisioning Timeout"
        default 30
        help
            Timeout (in minutes) after which the provisioning will auto stop. A reboot will be required
            to restart provisioning. It is always recommended to set this to some non zero value, especially
            if you are not using PoP. Set to 0 if you do not want provisioning to auto stop.

    config APP_WIFI_PROV_NAME_PREFIX
        string "Provisioning Name Prefix"
        default "PROV"
        help
            Provisioning Name Prefix.

endmenu
```

## examples/motor/bldc_fan_rainmaker/sdkconfig.defaults
```kconfig
CONFIG_ESPTOOLPY_FLASHSIZE_8MB=y
CONFIG_PARTITION_TABLE_SINGLE_APP=
CONFIG_PARTITION_TABLE_TWO_OTA=
CONFIG_PARTITION_TABLE_CUSTOM=y
CONFIG_PARTITION_TABLE_CUSTOM_FILENAME="partitions.csv"
CONFIG_PARTITION_TABLE_FILENAME="partitions.csv"
CONFIG_PARTITION_TABLE_OFFSET=0x8000
CONFIG_PARTITION_TABLE_MD5=y

# mbedtls
CONFIG_MBEDTLS_DYNAMIC_BUFFER=y
CONFIG_MBEDTLS_DYNAMIC_FREE_PEER_CERT=y
CONFIG_MBEDTLS_DYNAMIC_FREE_CONFIG_DATA=y
CONFIG_MBEDTLS_CERTIFICATE_BUNDLE_DEFAULT_CMN=y

# For BLE Provisioning using NimBLE stack (Not applicable for ESP32-S2)
CONFIG_BT_ENABLED=y
CONFIG_BTDM_CTRL_MODE_BLE_ONLY=y
CONFIG_BT_NIMBLE_ENABLED=y

# Temporary Fix for Timer Overflows
CONFIG_FREERTOS_TIMER_TASK_STACK_DEPTH=3120

# For additional security on reset to factory
CONFIG_ESP_RMAKER_USER_ID_CHECK=y

# Secure Local Control
CONFIG_ESP_RMAKER_LOCAL_CTRL_ENABLE=y
CONFIG_ESP_RMAKER_LOCAL_CTRL_SECURITY_1=y

# Application Rollback
CONFIG_BOOTLOADER_APP_ROLLBACK_ENABLE=y

CONFIG_ESP_RMAKER_SKIP_VERSION_CHECK=y
```

## examples/motor/drv10987/main/Kconfig.projbuild
```kconfig
menu "Example Configuration"

    config EXAMPLE_MOROT_SPEED
        int "MOTOR SPEED"
        range 0 511
        default 300
        help
            Configure the speed value. It must be an integer between 0 and 511.
endmenu
```

## examples/motor/drv10987/sdkconfig.defaults
```kconfig
CONFIG_ESP_DEFAULT_CPU_FREQ_MHZ_240=y
CONFIG_FREERTOS_HZ=1000
CONFIG_FREERTOS_TIMER_TASK_STACK_DEPTH=4096
```

## examples/motor/foc_knob_example/components/foc_knob/Kconfig
```kconfig
menu "FOC Knob"

    config FOC_KNOB_MAX_VELOCITY
        int "FOC Knob Max Velocity"
        range 1 100
        default 60
        help
            When the maximum velocity is smaller, the rebound velocity will also be smaller.

endmenu
```

## examples/oled_screen_module/main/Kconfig
```kconfig
menu "IoT Screen settings"
    config AP_SSID
        string "Enter SSID of router to connect to"
        default ""
        help
            "Enter SSID of router to connect to"

    config AP_PASSWORD
        string "Enter PASSWORD of router to connect to"
        default ""
        help
            "Enter PASSWORD of router to connect to"



endmenu
```

## examples/ota/simple_ota_example/sdkconfig.defaults
```kconfig
# Default sdkconfig parameters to use the OTA
# partition table layout, with a 4MB flash size
CONFIG_PARTITION_TABLE_CUSTOM=y
CONFIG_PARTITION_TABLE_CUSTOM_FILENAME="partition_for_compressed_ota.csv"
CONFIG_PARTITION_TABLE_FILENAME="partition_for_compressed_ota.csv"
CONFIG_PARTITION_TABLE_OFFSET=0xb000

# Certificate bundle configuration
CONFIG_MBEDTLS_CERTIFICATE_BUNDLE_DEFAULT_CMN=y
CONFIG_MBEDTLS_CUSTOM_CERTIFICATE_BUNDLE=y
CONFIG_MBEDTLS_CUSTOM_CERTIFICATE_BUNDLE_PATH="server_certs/ca_cert.pem"

#
# Bootloader config (Custom)
#
CONFIG_BOOTLOADER_COMPRESSED_ENABLED=y
CONFIG_BOOTLOADER_DECOMPRESSOR_XZ=y
```

## examples/quickjs-ng/sdkconfig.defaults
```kconfig
# QuickJS + quickjs-libc can use a deep C stack; 8K is a safe default for the example
CONFIG_ESP_MAIN_TASK_STACK_SIZE=8192
```

## examples/robot/ragtime_panthera/follower/main/Kconfig.projbuild
```kconfig
menu "Panthera Follower Configuration"

    orsource "$IDF_PATH/examples/common_components/env_caps/$IDF_TARGET/Kconfig.env_caps"

    config CONSOLE_CONTROL
        bool "Direct control robot arm via console"
        default y
        help
            When set to Y, you can forcibly perform basic operations on the robot arm through the terminal, including kinematics testing, joint movement, enabling, and other actions.

    menu "Hardware Configuration"
        config CAN_TX_NUM
            int "CAN TX Pin"
            range ENV_GPIO_RANGE_MIN ENV_GPIO_IN_RANGE_MAX
            default 24
            help
                TX Pin of the CAN Transceiver

        config CAN_RX_NUM
            int "CAN RX Pin"
            range ENV_GPIO_RANGE_MIN ENV_GPIO_IN_RANGE_MAX
            default 25
            help
                RX Pin of the CAN Transceiver
    endmenu

    menu "Leader and Follower Gripper Mapping"
        config LEADER_INPUT_MIN
            int "Leader Input Minimum (x100 radians)"
            default -58
            help
                Minimum input angle from leader for gripper mapping (in radians * 100, e.g., -58 for -0.58)

        config LEADER_INPUT_MAX
            int "Leader Input Maximum (x100 radians)"
            default 0
            help
                Maximum input angle from leader for gripper mapping (in radians * 100, e.g., 0 for 0.0)

        config FOLLOWER_OUTPUT_MIN
            int "Follower Output Minimum (x100 radians)"
            default 0
            help
                Minimum output angle for follower gripper mapping (in radians * 100, e.g., 0 for 0.0)

        config FOLLOWER_OUTPUT_MAX
            int "Follower Output Maximum (x100 radians)"
            default 500
            help
                Maximum output angle for follower gripper mapping (in radians * 100, e.g., 628 for 6.28)
    endmenu

    menu "Leader and Follower Angle Inversion"
        config SERVO0_JOINT0_INVERT
            int "Invert angle for Servo 0 (0x11)"
            range 0 1
            default 0
            help
                Set to 1 to invert the angle received from ESP-NOW for servo 0 (multiplied by -1), 0 to disable

        config SERVO1_JOINT1_INVERT
            int "Invert angle for Servo 1 (0x12)"
            range 0 1
            default 0
            help
                Set to 1 to invert the angle received from ESP-NOW for servo 1 (multiplied by -1), 0 to disable

        config SERVO2_JOINT2_INVERT
            int "Invert angle for Servo 2 (0x13)"
            range 0 1
            default 0
            help
                Set to 1 to invert the angle received from ESP-NOW for servo 2 (multiplied by -1), 0 to disable

        config SERVO3_JOINT3_INVERT
            int "Invert angle for Servo 3 (0x14)"
            range 0 1
            default 1
            help
                Set to 1 to invert the angle received from ESP-NOW for servo 3 (multiplied by -1), 0 to disable

        config SERVO4_JOINT4_INVERT
            int "Invert angle for Servo 4 (0x15)"
            range 0 1
            default 0
            help
                Set to 1 to invert the angle received from ESP-NOW for servo 4 (multiplied by -1), 0 to disable

        config SERVO5_JOINT5_INVERT
            int "Invert angle for Servo 5 (0x16)"
            range 0 1
            default 0
            help
                Set to 1 to invert the angle received from ESP-NOW for servo 5 (multiplied by -1), 0 to disable

        config SERVO6_JOINT6_INVERT
            int "Invert angle for Servo 6 (0x17 Gripper)"
            range 0 1
            default 0
            help
                Set to 1 to invert the angle received from ESP-NOW for servo 6 (gripper) (multiplied by -1), 0 to disable

    endmenu

    menu "Receiver Serial Flash Config"
        config ENABLE_UPDATE_C6_FLASH
        bool "Enable update C6 Flash"
        default n
        help
            Enable this option will update the C6 firmware via serial flash every time

        config SERIAL_FLASH_RX_NUM
            int "Serial Flash RX Pin"
            range ENV_GPIO_RANGE_MIN ENV_GPIO_IN_RANGE_MAX
            default 6
            help
                RX Pin of the Serial Flash

        config SERIAL_FLASH_TX_NUM
            int "Serial Flash Tx Pin"
            range ENV_GPIO_RANGE_MIN ENV_GPIO_IN_RANGE_MAX
            default 5
            help
                TX Pin of the Serial Flash

        config SERIAL_FLASH_RESET_NUM
            int "Serial Flash Reset Pin"
            range ENV_GPIO_RANGE_MIN ENV_GPIO_IN_RANGE_MAX
            default 54
            help
                Reset Pin of the Serial Flash

        config SERIAL_FLASH_BOOT_NUM
            int "Serial Flash Boot Pin"
            range ENV_GPIO_RANGE_MIN ENV_GPIO_IN_RANGE_MAX
            default 53
            help
                Boot Pin of the Serial Flash
    endmenu

endmenu
```

## examples/robot/ragtime_panthera/follower/receiver/main/Kconfig.projbuild
```kconfig
menu "Example Configuration"

    orsource "$IDF_PATH/examples/common_components/env_caps/$IDF_TARGET/Kconfig.env_caps"

    config ESPNOW_CHANNEL
        int "Channel"
        default 1
        range 0 14
        help
            The channel on which sending and receiving ESPNOW data.

    config ESPNOW_PMK
        string "ESPNOW primary master key"
        default "bot12345678901234"
        help
            ESPNOW primary master for the example to use. The length of ESPNOW primary master must be 16 bytes.

endmenu
```

## examples/robot/ragtime_panthera/leader/main/Kconfig.projbuild
```kconfig
menu "Example Configuration"

    orsource "$IDF_PATH/examples/common_components/env_caps/$IDF_TARGET/Kconfig.env_caps"

    menu "ESPNOW Configuration"
        config ESPNOW_CHANNEL
            int "Channel"
            default 1
            range 0 14
            help
                The channel on which sending and receiving ESPNOW data.

        config ESPNOW_PMK
            string "ESPNOW primary master key"
            default "bot12345678901234"
            help
                ESPNOW primary master for the example to use. The length of ESPNOW primary master must be 16 bytes.

        config ESPNOW_SLAVE_MAC
            string "ESPNOW slave MAC address"
            default "9c:9e:6e:52:f8:b8"
            help
                MAC address of the slave device in format "XX:XX:XX:XX:XX:XX" or "XXXXXXXXXXXX" (12 hex digits).
    endmenu

    menu "Hardware Configuration"
        config XL330_M077_BAUD_RATE
            int "XL330_M077 communication speed"
            range 1200 115200
            default 115200
            help
                XL330_M077 communication speed for the example.

        config XL330_M077_RXD
            int "XL330_M077 RXD pin number"
            range ENV_GPIO_RANGE_MIN ENV_GPIO_IN_RANGE_MAX
            default 5
            help
                GPIO number for XL330 M077 RX pin.

        config XL330_M077_TXD
            int "XL330_M077 TXD pin number"
            range ENV_GPIO_RANGE_MIN ENV_GPIO_IN_RANGE_MAX
            default 4
            help
                GPIO number for XL330 M077 TX pin.

        config XL330_M077_INIT_POSITION
            int "XL330_M077 init position"
            range 0 360
            default 180
            help
                XL330_M077 initial position. Please ensure to install the robotic arm at this initial position during assembly.

        config XL330_M077_POSITION_TOLERANCE
            int "XL330_M077 position tolerance"
            range 5 10
            default 5
            help
                XL330_M077 position tolerance. When the XL330_M077 is installed on the robotic arm, due to inertia issues, it may require several attempts to set the target position. If the difference between the target position and the current position is within the tolerance range, the position is considered successfully set.
    endmenu

endmenu
```

## examples/screen/sdkconfig.defaults
```kconfig
CONFIG_BOARD_ESP32_LCDKIT=y

CONFIG_FREERTOS_HZ=1000
CONFIG_ESP32_DEFAULT_CPU_FREQ_240=y

CONFIG_LCD_DRIVER_SCREEN_CONTROLLER_ILI9341=y
CONFIG_LCD_DRIVER_SCREEN_CONTROLLER_ILI9486=y
CONFIG_LCD_DRIVER_SCREEN_CONTROLLER_ILI9806=y
CONFIG_LCD_DRIVER_SCREEN_CONTROLLER_NT35510=y
CONFIG_LCD_DRIVER_SCREEN_CONTROLLER_RM68120=y
CONFIG_LCD_DRIVER_SCREEN_CONTROLLER_SSD1351=y
CONFIG_LCD_DRIVER_SCREEN_CONTROLLER_ST7789=y
CONFIG_LCD_DRIVER_SCREEN_CONTROLLER_ST7796=y
CONFIG_LCD_DRIVER_SCREEN_CONTROLLER_SSD1306=y
CONFIG_LCD_DRIVER_SCREEN_CONTROLLER_SSD1307=y
CONFIG_LCD_DRIVER_SCREEN_CONTROLLER_SSD1322=y
```

## examples/sensors/aht20_Sensor_Hub/main/Kconfig.projbuild
```kconfig
menu "Example Configuration"

    config I2C_MASTER_SCL
        int "SCL GPIO Num"
        default 22
        help
            GPIO number for I2C Master clock line.

    config I2C_MASTER_SDA
        int "SDA GPIO Num"
        default 21
        help
            GPIO number for I2C Master data line.

     config AHT20_SAMPLE_PERIOD
        int "AHT20 sampling time(ms)"
		default 2000
	range 2000 1000000
        help
            Sampling period for AHT20, in ms.

endmenu
```

## examples/sensors/sensor_control_led/main/Kconfig.projbuild
```kconfig
menu "Sensor Monitor Example"
    config SENSOR_EXAMPLE_PERIOD
        int "sensor min delay(ms)"
        range 0 65535
        default 200
    config SENSOR_EXAMPLE_THRESHOLD
        int "led state toggle threshold"
        range 0 100
        default 30
endmenu
```
