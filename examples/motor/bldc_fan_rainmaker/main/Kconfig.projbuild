## examples/smart_device/alink_smart_device_demo/main/Kconfig.projbuild
```kconfig
menu "IoT Example - smart_device"
        
    config DEMO_ENABLE
        bool
        default y
            
    choice SMART_DEVICE_TYPE
        bool "Device type"
        default SMART_LIGHT_DEVICE
        depends on DEMO_ENABLE
        help
          select the device type

        config SMART_LIGHT_DEVICE
        bool "smart light"

        config SMART_PLUG_DEVICE
        bool "smart plug"

    endchoice
    
    menu "Smart plug"
        depends on DEMO_ENABLE && SMART_PLUG_DEVICE
        menu "Socket parameter saving"
            config SMART_PLUG_NAME_SPACE
                string "smart plug parameter namespace"
                default "plug"
                help
                    To set the namespace for parameters of smart plug 
                    devices
            config SMART_PLUG_PARAM_KEY
                string "smart plug parameter key"
                default "plug_param"
                help
                    To set the key value for parameters of smart plug 
                    devices
        endmenu
                
        config SMART_PLUG_POWER_METER_ENABLE
            bool "Power meter device"
            default y
            help 
                To enable power meter device in iot smart plug demo, 
                We only support a power meter of "V-F converter" type.
            menu "Power Meter"
                depends on SMART_PLUG_POWER_METER_ENABLE
                config SMART_PLUG_PM_CF_IO
                    depends on SMART_PLUG_POWER_METER_ENABLE
                    int "GPIO number for power meter CF pin"
                    default 25
                    help
                        To set the GPIO number for CF pin of power meter.
                config SMART_PLUG_PM_CF_PCNT_UNIT_NUM
                    depends on SMART_PLUG_POWER_METER_ENABLE
                    int "PCNT uint number for CF pin"
                    range 0 7
                    default 0
                    help
                        To set PCNT uint number for CF pin of power meter.
                config SMART_PLUG_PM_CFI_IO
                    depends on SMART_PLUG_POWER_METER_ENABLE
                    int "GPIO number for power meter CFI pin"
                    default 26
                    help
                        To set the GPIO number for CFI pin of power meter.
                        This pin defines the output on CFI pin is current or voltage.
                config SMART_PLUG_PM_CFI_PCNT_UNIT_NUM
                    depends on SMART_PLUG_POWER_METER_ENABLE
                    int "PCNT uint number for CFI pin"
                    range 0 7
                    default 1
                    help
                        To set PCNT uint number for CFI pin of power meter.
                config SMART_PLUG_PM_POWER_COEF
                    depends on SMART_PLUG_POWER_METER_ENABLE
                    int "Power-frequency coefficient for power meter"
                    default 1293699
                    help
                        To set the power-frequency coefficient for power meter.
                        Power = frequency * coefficient
                config SMART_PLUG_PM_CURRENT_COEF
                    depends on SMART_PLUG_POWER_METER_ENABLE
                    int "current-frequency coefficient for current value read from power meter"
                    default 13670
                    help
                        current-frequency coefficient for current value read from power meter.
                        Current = frequency * coefficient 
                config SMART_PLUG_PM_VOLTAGE_COEF
                    depends on SMART_PLUG_POWER_METER_ENABLE
                    int "Voltage-frequency coefficient for voltage value read from power meter"
                    default 102961
                    help
                        Voltage-frequency coefficient for voltage value read from power meter.
                        Voltage = frequency * coefficient
                config SMART_PLUG_PM_MODE_SEL_PIN
                    depends on SMART_PLUG_POWER_METER_ENABLE
                    int "GPIO number for power meter mode select pin"
                    default 17
                    help
                        To set the GPIO number for select pin of power meter.
                config SMART_PLUG_PM_MODE_SEL_PIN_LEVEL
                    depends on SMART_PLUG_POWER_METER_ENABLE
                    int "Power meter mode select pin level"
                    range 0 1
                    default 0
                    help
                        To set the select pin level of power meter.
            endmenu
            
        menu "Main button"
            config SMART_PLUG_MAIN_BUTTON_IO
                int "The GPIO number to control all the units"
                range 0 39
                default 4
                help
                    The GPIO number to control all the units
            config SMART_PLUG_MAIN_BUTTON_ACT_LEVEL
                int "The GPIO active level"
                range 0 1
                default 0
                help
                    The GPIO level when pushing the button
        endmenu
                
        menu "Network status LED"
            config SMART_PLUG_NET_STATUS_LED_IO
                int "The GPIO of Net status LED"
                range 0 34
                default 19
                help 
                    The GPIO of Net status LED
            config SMART_PLUG_NET_STATUS_LED_OFF_LEVEL
                int "The Network status LED 'off' level"
                range 0 1
                default 0
                help
                    The Network status LED "off" level
            
        endmenu
        
        config SMART_PLUG_UNIT_NUM
            int "Socket unit number"
            range 1 4
            default 3
            help
                To set the number of plug unit,
                One unit has one relay controller, 
                one status LED and one button
        
        menu "Socket UNIT[0]"
            depends on  SMART_PLUG_UNIT_NUM>0
            config SMART_PLUG_UNIT0_BUTTON_IO
            int "UNIT[0] button IO"
            range 0 39
            default 5
            
            config SMART_PLUG_UNIT0_BUTTON_ACTIVE_LEVEL
            int "UNIT[0] button active level"
            range 0 1
            default 0
            
            config SMART_PLUG_UNIT0_LED_IO
            int "UNIT[0] led IO"
            range 0 34
            default 17
            
            config SMART_PLUG_UNIT0_LED_OFF_LEVEL
            int "UNIT[0] led off level"
            range 0 1
            default 0 
            
            config SMART_PLUG_UNIT0_RELAY_OFF_LEVEL
            int "UNIT[0] relay off level"
            range 0 1
            default 1
            
            choice SMART_PLUG_UNIT0_RELAY_CTRL_MODE
                bool "UNIT[0] relay control mode"
                    default SMART_PLUG_UNIT0_RELAY_SINGLE_IO
                config SMART_PLUG_UNIT0_RELAY_D_FLIPFLOP
                    bool "Relay mode: D flip-flop"
                config SMART_PLUG_UNIT0_RELAY_SINGLE_IO
                    bool "Relay mode: single IO"
                endchoice
            config SMART_PLUG_UNIT0_RELAY_CTRL_MODE
                int
                default 0 if SMART_PLUG_UNIT0_RELAY_D_FLIPFLOP
                default 1 if SMART_PLUG_UNIT0_RELAY_SINGLE_IO    
                
            choice SMART_PLUG_UNIT0_RELAY_IO_MODE
                bool "UNIT[0] relay IO mode"
                    default SMART_PLUG_UNIT0_RELAY_IO_DIG
                config SMART_PLUG_UNIT0_RELAY_IO_DIG
                    bool "Relay on digital IO"
                config SMART_PLUG_UNIT0_RELAY_IO_RTC
                    bool "Relay by RTC IO"
                endchoice
            config SMART_PLUG_UNIT0_RELAY_IO_MODE
                int
                default 0 if SMART_PLUG_UNIT0_RELAY_IO_DIG
                default 1 if SMART_PLUG_UNIT0_RELAY_IO_RTC   
                
                
            
            config SMART_PLUG_UNIT0_RELAY_CTL_IO
            int "UNIT[0] relay ctrl io"
            range 0 34
            default 12
            
            config SMART_PLUG_UNIT0_RELAY_CLK_IO
            depends on SMART_PLUG_UNIT0_RELAY_D_FLIPFLOP
            int "UNIT[0] relay clk io(in D-flip-flop mode)"
            range -1 34
            default -1
            
            config SMART_PLUG_UNIT0_RELAY_CLK_IO
            depends on SMART_PLUG_UNIT0_RELAY_SINGLE_IO
            int
            default -1
        endmenu
        
        menu "Socket UNIT[1]"
            depends on  SMART_PLUG_UNIT_NUM>1
            config SMART_PLUG_UNIT1_BUTTON_IO
            int "UNIT[1] button IO"
            range 0 39
            default 2
            
            config SMART_PLUG_UNIT1_BUTTON_ACTIVE_LEVEL
            int "UNIT[1] button active level"
            range 0 1
            default 0
            
            config SMART_PLUG_UNIT1_LED_IO
            int "UNIT[1] led IO"
            range 0 34
            default 18
            
            config SMART_PLUG_UNIT1_LED_OFF_LEVEL
            int "UNIT[1] led off level"
            range 0 1
            default 0 
            
            config SMART_PLUG_UNIT1_RELAY_OFF_LEVEL
            int "UNIT[1] relay off level"
            range 0 1
            default 1
                        
            choice SMART_PLUG_UNIT1_RELAY_CTRL_MODE
                bool "UNIT[1] relay control mode"
                    default SMART_PLUG_UNIT1_RELAY_SINGLE_IO
                config SMART_PLUG_UNIT1_RELAY_D_FLIPFLOP
                    bool "Relay mode: D flip-flop"
                config SMART_PLUG_UNIT1_RELAY_SINGLE_IO
                    bool "Relay mode: single IO"
                endchoice
            config SMART_PLUG_UNIT1_RELAY_CTRL_MODE
                int
                default 0 if SMART_PLUG_UNIT1_RELAY_D_FLIPFLOP
                default 1 if SMART_PLUG_UNIT1_RELAY_SINGLE_IO    
                
            choice SMART_PLUG_UNIT1_RELAY_IO_MODE
                bool "UNIT[1] relay IO mode"
                    default SMART_PLUG_UNIT1_RELAY_IO_DIG
                config SMART_PLUG_UNIT1_RELAY_IO_DIG
                    bool "Relay on digital IO"
                config SMART_PLUG_UNIT1_RELAY_IO_RTC
                    bool "Relay by RTC IO"
                endchoice
            config SMART_PLUG_UNIT1_RELAY_IO_MODE
                int
                default 0 if SMART_PLUG_UNIT1_RELAY_IO_DIG
                default 1 if SMART_PLUG_UNIT1_RELAY_IO_RTC 
                
                
                
                
                
            
            config SMART_PLUG_UNIT1_RELAY_CTL_IO
            int "UNIT[1] relay ctrl io"
            range 0 34
            default 13
            
            config SMART_PLUG_UNIT1_RELAY_CLK_IO
            depends on SMART_PLUG_UNIT1_RELAY_D_FLIPFLOP
            int "UNIT[1] relay clk io(in D-flip-flop mode)"
            range -1 34
            default -1
            
            config SMART_PLUG_UNIT1_RELAY_CLK_IO
            depends on SMART_PLUG_UNIT1_RELAY_SINGLE_IO
            int
            default -1
        endmenu
        
        menu "Socket UNIT[2]"
            depends on  SMART_PLUG_UNIT_NUM>2
            config SMART_PLUG_UNIT2_BUTTON_IO
            int "UNIT[2] button IO"
            range 0 39
            default 20
            
            config SMART_PLUG_UNIT2_BUTTON_ACTIVE_LEVEL
            int "UNIT[2] button active level"
            range 0 1
            default 0
            
            config SMART_PLUG_UNIT2_LED_IO
            int "UNIT[2] led IO"
            range 0 34
            default 21
            
            config SMART_PLUG_UNIT2_LED_OFF_LEVEL
            int "UNIT[2] led off level"
            range 0 1
            default 0 
            
            config SMART_PLUG_UNIT2_RELAY_OFF_LEVEL
            int "UNIT[2] relay off level"
            range 0 1
            default 1
                                    
            choice SMART_PLUG_UNIT2_RELAY_CTRL_MODE
                bool "UNIT[2] relay control mode"
                    default SMART_PLUG_UNIT2_RELAY_SINGLE_IO
                config SMART_PLUG_UNIT2_RELAY_D_FLIPFLOP
                    bool "Relay mode: D flip-flop"
                config SMART_PLUG_UNIT2_RELAY_SINGLE_IO
                    bool "Relay mode: single IO"
                endchoice
            config SMART_PLUG_UNIT2_RELAY_CTRL_MODE
                int
                default 0 if SMART_PLUG_UNIT2_RELAY_D_FLIPFLOP
                default 1 if SMART_PLUG_UNIT2_RELAY_SINGLE_IO    
                
            choice SMART_PLUG_UNIT2_RELAY_IO_MODE
                bool "UNIT[2] relay IO mode"
                    default SMART_PLUG_UNIT2_RELAY_IO_DIG
                config SMART_PLUG_UNIT2_RELAY_IO_DIG
                    bool "Relay on digital IO"
                config SMART_PLUG_UNIT2_RELAY_IO_RTC
                    bool "Relay by RTC IO"
                endchoice
            config SMART_PLUG_UNIT2_RELAY_IO_MODE
                int
                default 0 if SMART_PLUG_UNIT2_RELAY_IO_DIG
                default 1 if SMART_PLUG_UNIT2_RELAY_IO_RTC 
                
                
            
            config SMART_PLUG_UNIT2_RELAY_CTL_IO
            int "UNIT[2] relay ctrl io"
            range 0 34
            default 22
            
            config SMART_PLUG_UNIT2_RELAY_CLK_IO
            depends on SMART_PLUG_UNIT2_RELAY_D_FLIPFLOP
            int "UNIT[2] relay clk io(in D-flip-flop mode)"
            range -1 34
            default -1
            
            config SMART_PLUG_UNIT2_RELAY_CLK_IO
            depends on SMART_PLUG_UNIT2_RELAY_SINGLE_IO
            int
            default -1
        endmenu
        
        menu "Socket UNIT[3]"
            depends on  SMART_PLUG_UNIT_NUM>3
            config SMART_PLUG_UNIT3_BUTTON_IO
            int "UNIT[3] button IO"
            range 0 39
            default 23
            
            config SMART_PLUG_UNIT3_BUTTON_ACTIVE_LEVEL
            int "UNIT[3] button active level"
            range 0 1
            default 0
            
            config SMART_PLUG_UNIT3_LED_IO
            int "UNIT[3] led IO"
            range 0 34
            default 24
            
            config SMART_PLUG_UNIT3_LED_OFF_LEVEL
            int "UNIT[3] led off level"
            range 0 1
            default 0 
            
            config SMART_PLUG_UNIT3_RELAY_OFF_LEVEL
            int "UNIT[3] relay off level"
            range 0 1
            default 1
                              
            choice SMART_PLUG_UNIT3_RELAY_CTRL_MODE
                bool "UNIT[3] relay control mode"
                    default SMART_PLUG_UNIT3_RELAY_SINGLE_IO
                config SMART_PLUG_UNIT3_RELAY_D_FLIPFLOP
                    bool "Relay mode: D flip-flop"
                config SMART_PLUG_UNIT3_RELAY_SINGLE_IO
                    bool "Relay mode: single IO"
                endchoice
            config SMART_PLUG_UNIT3_RELAY_CTRL_MODE
                int
                default 0 if SMART_PLUG_UNIT3_RELAY_D_FLIPFLOP
                default 1 if SMART_PLUG_UNIT3_RELAY_SINGLE_IO    
                
            choice SMART_PLUG_UNIT3_RELAY_IO_MODE
                bool "UNIT[3] relay IO mode"
                    default SMART_PLUG_UNIT3_RELAY_IO_DIG
                config SMART_PLUG_UNIT3_RELAY_IO_DIG
                    bool "Relay on digital IO"
                config SMART_PLUG_UNIT3_RELAY_IO_RTC
                    bool "Relay by RTC IO"
                endchoice
            config SMART_PLUG_UNIT3_RELAY_IO_MODE
                int
                default 0 if SMART_PLUG_UNIT3_RELAY_IO_DIG
                default 1 if SMART_PLUG_UNIT3_RELAY_IO_RTC 
                
            
            config SMART_PLUG_UNIT3_RELAY_CTL_IO
            int "UNIT[3] relay ctrl io"
            range 0 34
            default 27
            
            config SMART_PLUG_UNIT3_RELAY_CLK_IO
            depends on SMART_PLUG_UNIT3_RELAY_D_FLIPFLOP
            int "UNIT[3] relay clk io(in D-flip-flop mode)"
            range -1 34
            default -1
            
            config SMART_PLUG_UNIT3_RELAY_CLK_IO
            depends on SMART_PLUG_UNIT3_RELAY_SINGLE_IO
            int
            default -1
        endmenu
    endmenu
    
    
    
    menu "Smart Light"
        depends on DEMO_ENABLE && SMART_LIGHT_DEVICE
        menu "Light parameter namespace"
            config SMART_LIGHT_NAME_SPACE
            string "Set light param namespace"
            default "light"
            help
                To set the namespace for light parameters
                It's fine to just use the default value.
                
            config SMART_LIGHT_PARAM_KEY
            string "Set light param key"
            default "light_param"
            help 
                To set the key value for light parameters
                It's fine to just use the default value
        endmenu
        menu "LEDC settings"
            config SMART_LIGHT_PWM_FREQ_HZ
            int "LEDC frequency"
            range 1000 5000
            default 1000
            help 
                To set the PWM frequency of light
               
            #config SMART_LIGHT_PWM_BIT_NUM
            #int "LEDC bit number"
            #range 10 15
            #default 13
            #help
            #    To set the resolution for PWM channels
            #    So the duty range will 0 ~ (2 ^ bit_num) - 1
            
            choice SMART_LIGHT_PWM_BIT_NUM
                bool "LEDC bit number"
                    default SMART_LIGHT_LEDC_13_BIT
                config SMART_LIGHT_LEDC_10_BIT
                    bool "LEDC 10-bit counter"
                config SMART_LIGHT_LEDC_11_BIT
                    bool "LEDC 11-bit counter"
                config SMART_LIGHT_LEDC_12_BIT
                    bool "LEDC 12-bit counter"
                config SMART_LIGHT_LEDC_13_BIT
                    bool "LEDC 13-bit counter"
                config SMART_LIGHT_LEDC_14_BIT
                    bool "LEDC 14-bit counter"
                config SMART_LIGHT_LEDC_15_BIT
                    bool "LEDC 15-bit counter"
                endchoice
            config SMART_LIGHT_PWM_BIT_NUM
                int
                default 10 if SMART_LIGHT_LEDC_10_BIT
                default 11 if SMART_LIGHT_LEDC_11_BIT 
                default 12 if SMART_LIGHT_LEDC_12_BIT 
                default 13 if SMART_LIGHT_LEDC_13_BIT 
                default 14 if SMART_LIGHT_LEDC_14_BIT 
                default 15 if SMART_LIGHT_LEDC_15_BIT 
            
            
            
            
            
            
            
            #config SMART_LIGHT_PWM_SPEED_MODE
            #int "LEDC hw mode"
            #range 0 1
            #default 0
            #help 
            #    To set the speed mode of PWM hw
            #    0: high-speed mode
            #    1: low-speed mode
            #    Usually we use default value(0)
                
            choice SMART_LIGHT_PWM_SPEED_MODE
                bool "LEDC CHANNEL MODE"
                    default SMART_LIGHT_LEDC_HIGH_SPEED_CHANNELS
                config SMART_LIGHT_LEDC_HIGH_SPEED_CHANNELS
                    bool "LEDC high speed channels"
                config SMART_LIGHT_LEDC_LOW_SPEED_CHANNELS
                    bool "LEDC low speed channels"
                endchoice
            config SMART_LIGHT_PWM_SPEED_MODE
                int
                default 0 if SMART_LIGHT_LEDC_HIGH_SPEED_CHANNELS
                default 1 if SMART_LIGHT_LEDC_LOW_SPEED_CHANNELS 
            
            
            
            #config SMART_LIGHT_PWM_TIMER_IDX
            #int "LEDC hw timer"
            #range 0 3
            #default 0
            #help
            #    To set the timer index of LEDC
            #    Chosen from TIME[0 - 3]
            
            
            choice SMART_LIGHT_PWM_TIMER_IDX
                bool "LEDC TIMER IDX"
                    default SMART_LIGHT_LEDC_TIMER_0
                config SMART_LIGHT_LEDC_TIMER_0
                    bool "LEDC TIMER_0"
                config SMART_LIGHT_LEDC_TIMER_1
                    bool "LEDC TIMER_1"
                config SMART_LIGHT_LEDC_TIMER_2
                    bool "LEDC TIMER_2"
                config SMART_LIGHT_LEDC_TIMER_3
                    bool "LEDC TIMER_3"
                endchoice
            config SMART_LIGHT_PWM_TIMER_IDX
                int
                default 0 if SMART_LIGHT_LEDC_TIMER_0
                default 1 if SMART_LIGHT_LEDC_TIMER_1
                default 2 if SMART_LIGHT_LEDC_TIMER_2
                default 3 if SMART_LIGHT_LEDC_TIMER_3 
        endmenu
        
        config SMART_LIGHT_PWM_CHANNEL_NUM
        int "LEDC channel number"
        range 3 5
        default 5
        help
            To set the number of PWM channel
        
        menu "SMART LIGHT CHANNEL[0](RED)"
            depends on SMART_LIGHT_PWM_CHANNEL_NUM>0
            config SMART_LIGHT_PWM_UNIT0_LEDC_CHANNEL
            int "LEDC channel for PWM unit[0]"
            range 0 7
            default 0
            help
                To set the LEDC hw channel for PWM[0]
            config SMART_LIGHT_PWM_UNIT0_LEDC_IO
            int "GPIO number for PWM unit[0]"
            range 0 34
            default 25
            help
                To set the output GPIO number for LEDC
        endmenu
        menu "SMART LIGHT CHANNEL[1](GREEN)"
            depends on SMART_LIGHT_PWM_CHANNEL_NUM>1
            config SMART_LIGHT_PWM_UNIT1_LEDC_CHANNEL
            int "LEDC channel for PWM unit[1]"
            range 0 7
            default 1
            help
                To set the LEDC hw channel for PWM[1]
            config SMART_LIGHT_PWM_UNIT1_LEDC_IO
            int "GPIO number for PWM unit[1]"
            range 0 34
            default 26
            help
                To set the output GPIO number for LEDC
        endmenu
        menu "SMART LIGHT CHANNEL[2](BLUE)"
            depends on SMART_LIGHT_PWM_CHANNEL_NUM>2
            config SMART_LIGHT_PWM_UNIT2_LEDC_CHANNEL
            int "LEDC channel for PWM unit[2]"
            range 0 7
            default 2
            help
                To set the LEDC hw channel for PWM[2]
            config SMART_LIGHT_PWM_UNIT2_LEDC_IO
            int "GPIO number for PWM unit[2]"
            range 0 34
            default 27
            help
                To set the output GPIO number for LEDC
        endmenu
        menu "SMART LIGHT CHANNEL[3](CW)"
            depends on SMART_LIGHT_PWM_CHANNEL_NUM>3
            config SMART_LIGHT_PWM_UNIT3_LEDC_CHANNEL
            int "LEDC channel for PWM unit[3]"
            range 0 7
            default 3
            help
                To set the LEDC hw channel for PWM[3]
            config SMART_LIGHT_PWM_UNIT3_LEDC_IO
            int "GPIO number for PWM unit[3]"
            range 0 34
            default 21
            help
                To set the output GPIO number for LEDC
        endmenu        
        
        menu "SMART LIGHT CHANNEL[4](WW)"
            depends on SMART_LIGHT_PWM_CHANNEL_NUM>4
            config SMART_LIGHT_PWM_UNIT4_LEDC_CHANNEL
            int "LEDC channel for PWM unit[4]"
            range 0 7
            default 4
            help
                To set the LEDC hw channel for PWM[4]
            config SMART_LIGHT_PWM_UNIT4_LEDC_IO
            int "GPIO number for PWM unit[4]"
            range 0 34
            default 22
            help
                To set the output GPIO number for LEDC
        endmenu    
        
    endmenu
       

    choice CLOUD_TYPE
        bool "cloud type"
        default CLOUD_ALINK
        depends on DEMO_ENABLE
        help
          select the cloud type

    config CLOUD_ALINK
        bool "alink cloud"
    #config CLOUD_JOYLINK
    #    bool "joylink cloud"
    endchoice
    
    #source "../platforms/alink_v2.0/Kconfig_alink" 
    menu "Alink"
    depends on DEMO_ENABLE && CLOUD_ALINK
    
        menu "Smart Light Product Info"
        depends on SMART_LIGHT_DEVICE

        config ALINK_INFO_LIGHT_NAME
        string "NAME"
        default "ESP-LIGHT-DEMO-V5"
        
        config ALINK_INFO_LIGHT_VERSION
        string "VERSION"
        default 1.0.0
        
        config ALINK_INFO_LIGHT_MODEL
        string "MODEL"
        default ESPRESSIF_LIVING_LIGHT_ESP_LIGHT_DEMO_V5
        
        config ALINK_INFO_LIGHT_KEY
        string "KEY"
        default cQuVDLWcZGQQ0DhTnxdw
        
        config ALINK_INFO_LIGHT_SECRET
        string "SECRET"
        default 015ZCHua82UtbZSOJBalB9LUIZonvvgT1ePdzNis
        
        config ALINK_INFO_LIGHT_KEY_SANDBOX
        string "KEY SANDBOX"
        default 10n0NikaekN0IZ0fAcD0
        
        config ALINK_INFO_LIGHT_SECRET_SANDBOX
        string "SECRET SANDBOX"
        default 19n2KDP5TYW7nKY5Bw9ArE4VBzU4IO6RpuiIFQdA
        
        config ALINK_INFO_LIGHT_KEY_DEVICE
        depends on ALINK_VERSION_SDS
        string "KEY DEVICE"
        default vfyjJdC0O6b2P3UZXq4g
        
        config ALINK_INFO_LIGHT_SECRET_DEVICE
        depends on ALINK_VERSION_SDS
        string "SECRET DEVICE"
        default puAxGjMbb4gd2beaapvMPZN4akedB3Xk 
        endmenu

        menu "Smart Plug Product Info"
        depends on SMART_PLUG_DEVICE
        
        config ALINK_INFO_PLUG_NAME
        string "NAME"
        default ESP-PLUG-DEMO-V5
        
        config ALINK_INFO_PLUG_VERSION
        string "VERSION"
        default 1.0.0
        
        config ALINK_INFO_PLUG_MODEL
        string "MODEL"
        default ESPRESSIF_LIVING_OUTLET_ESP_PLUG_DEMO_V5
        
        config ALINK_INFO_PLUG_KEY
        string "KEY"
        default lsNZzj06bWVj8dvnuNMT
        
        config ALINK_INFO_PLUG_SECRET
        string "SECRET"
        default SVNc0z7tSFSlgDtzY4hWRfMAw7rKXoH6jQcTdghK
        
        config ALINK_INFO_PLUG_KEY_SANDBOX
        string "KEY SANDBOX"
        default 10n0NikaekN0IZ0fAcD0
        
        config ALINK_INFO_PLUG_SECRET_SANDBOX
        string "SECRET SANDBOX"
        default 19n2KDP5TYW7nKY5Bw9ArE4VBzU4IO6RpuiIFQdA

        config ALINK_INFO_PLUG_KEY_DEVICE
        depends on ALINK_VERSION_SDS
        string "KEY DEVICE"
        default vfyjJdC0O6b2P3UZXq4g

        config ALINK_INFO_PLUG_SECRET_DEVICE
        depends on ALINK_VERSION_SDS
        string "SECRET DEVICE"
        default puAxGjMbb4gd2beaapvMPZN4akedB3Xk
        endmenu

    endmenu
    
    #source "../platforms/joylink/Kconfig_joylink"
    menu "Joylink"
    depends on DEMO_ENABLE && CLOUD_JOYLINK
    
    menu "Product Info"
        config JOYLINK_AES_KEY
            string "JOYLINK AES KEY"
            default DNWXVNMPGRZB7DC5
        config JOYLINK_VERSION
            int "JOYLINK VERSION"
            default 1
        config JOYLINK_ACCESSKEY
            string "JOYLINK_ACCESSKEY"
            default ""
        config JOYLINK_LOCAL_KEY
            string "JOYLINK LOCAL KEY"
            default ""
        config JOYLINK_FEEDID
            string "JOYLINK FEEDID"
            default ""
            
        choice JOYLINK_DEVTYPE
        bool "JOYLINK DEV TYPE"
            default JOYLINK_DEV_TYPE_NORMAL
        config JOYLINK_DEV_TYPE_NORMAL
            bool "DEV TYPE NORMAL"
        config JOYLINK_DEV_TYPE_GW
            bool "DEV TYPE GW"
        config JOYLINK_DEV_TYPE_SUB
            bool "DEV TYPE SUB"
        endchoice
    
        config JOYLINK_DEVTYPE
            int
            default 0 if JOYLINK_DEV_TYPE_NORMAL
            default 1 if JOYLINK_DEV_TYPE_GW
            default 2 if JOYLINK_DEV_TYPE_SUB

        config JOYLINK_SERVER
            string "JOYLINK SERVER"
            default "live.smart.jd.com"
        config JOYLINK_SERVER_PORT
            int "JOYLINK SERVER PORT"
            default 2002
        config JOYLINK_CID
            string "JOYLINK CID"
            default "011c022b"
        config JOYLINK_FW_VERSION
            string "JOYLINK FIRMWARE VERSION"
            default "001"
        config JOYLINK_MODEL_CODE
            string "JOYLINK MODEL CODE"
            default "a1"
        config JOYLINK_UUID
            string "JOYLINK UUID"
            default "GNQIYS"
        

        choice JOYLINK_LAN_CTRL
            bool "JOYLINK LAN CTRL"
                default JOYLINK_LAN_CTRL_ENABLE
            config JOYLINK_LAN_CTRL_DISABLE
                bool "DEV LAN CTRL DISABLE"
            config JOYLINK_LAN_CTRL_ENABLE
                bool "DEV LAN CTRL ENABLE"
            endchoice
        config JOYLINK_LAN_CTRL
            int
            default 0 if JOYLINK_LAN_CTRL_DISABLE
            default 1 if JOYLINK_LAN_CTRL_ENABLE
           
        choice JOYLINK_CMD_TYPE
            bool "JOYLINK CMD TYPE"
                default JOYLINK_CMD_TYPE_JSON
            config JOYLINK_CMD_TYPE_JSON
                bool "DEV CMD TYPE JSON"
            config JOYLINK_CMD_TYPE_LUA
                bool "DEV CMD TYPE LUA SCRIPT"
            endchoice
        config JOYLINK_CMD_TYPE
            int
            default 0 if JOYLINK_CMD_TYPE_JSON
            default 1 if JOYLINK_CMD_TYPE_LUA 
    
    endmenu
    
    config JOYLINK_SMNT_BUTTON_NUM
        int "the io number for one key configuration network"
        default 14

    config JOYLINK_RESET_BUTTON_NUM
        int "the io number for reset"
        default 15
endmenu
endmenu
```
