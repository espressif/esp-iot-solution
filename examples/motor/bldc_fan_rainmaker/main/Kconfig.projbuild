## examples/smart_device/main/Kconfig
```kconfig
menu "IoT Example - smart_device"
        
    config DEMO_ENABLE
        bool
        default y
            
    choice SMART_DEVICE_TYPE
        bool "Device type"
        default SMART_SOCKET_DEVICE
        depends on DEMO_ENABLE
        help
          select the device type

    #config SMART_SOCKET_DEVICE
    #    bool "smart socket"
    config SMART_LIGHT_DEVICE
        bool "smart light"
    endchoice
    menu "Smart Light"
        depends on DEMO_ENABLE && SMART_LIGHT_DEVICE
        menu "Light parameter namespace"
            config SMART_LIGHT_NAME_SPACE
            string "Set light param namespace"
            default "light"
            help
                To set the namespace for light parameters
                It's fine to just use the default value.
                
            config SMART_LIGHT_PARAM_KEY
            string "Set light param key"
            default "light_param"
            help 
                To set the key value for light parameters
                It's fine to just use the default value
        endmenu
        menu "LEDC settings"
            config SMART_LIGHT_PWM_FREQ_HZ
            int "LEDC frequency"
            range 1000 5000
            default 1000
            help 
                To set the PWM frequency of light
               
            #config SMART_LIGHT_PWM_BIT_NUM
            #int "LEDC bit number"
            #range 10 15
            #default 13
            #help
            #    To set the resolution for PWM channels
            #    So the duty range will 0 ~ (2 ^ bit_num) - 1
            
            choice SMART_LIGHT_PWM_BIT_NUM
                bool "LEDC bit number"
                    default SMART_LIGHT_LEDC_13_BIT
                config SMART_LIGHT_LEDC_10_BIT
                    bool "LEDC 10-bit counter"
                config SMART_LIGHT_LEDC_11_BIT
                    bool "LEDC 11-bit counter"
                config SMART_LIGHT_LEDC_12_BIT
                    bool "LEDC 12-bit counter"
                config SMART_LIGHT_LEDC_13_BIT
                    bool "LEDC 13-bit counter"
                config SMART_LIGHT_LEDC_14_BIT
                    bool "LEDC 14-bit counter"
                config SMART_LIGHT_LEDC_15_BIT
                    bool "LEDC 15-bit counter"
                endchoice
            config SMART_LIGHT_PWM_BIT_NUM
                int
                default 10 if SMART_LIGHT_LEDC_10_BIT
                default 11 if SMART_LIGHT_LEDC_11_BIT 
                default 12 if SMART_LIGHT_LEDC_12_BIT 
                default 13 if SMART_LIGHT_LEDC_13_BIT 
                default 14 if SMART_LIGHT_LEDC_14_BIT 
                default 15 if SMART_LIGHT_LEDC_15_BIT 
            
            
            
            
            
            
            
            #config SMART_LIGHT_PWM_SPEED_MODE
            #int "LEDC hw mode"
            #range 0 1
            #default 0
            #help 
            #    To set the speed mode of PWM hw
            #    0: high-speed mode
            #    1: low-speed mode
            #    Usually we use default value(0)
                
            choice SMART_LIGHT_PWM_SPEED_MODE
                bool "LEDC CHANNEL MODE"
                    default SMART_LIGHT_LEDC_HIGH_SPEED_CHANNELS
                config SMART_LIGHT_LEDC_HIGH_SPEED_CHANNELS
                    bool "LEDC high speed channels"
                config SMART_LIGHT_LEDC_LOW_SPEED_CHANNELS
                    bool "LEDC low speed channels"
                endchoice
            config SMART_LIGHT_PWM_SPEED_MODE
                int
                default 0 if SMART_LIGHT_LEDC_HIGH_SPEED_CHANNELS
                default 1 if SMART_LIGHT_LEDC_LOW_SPEED_CHANNELS 
            
            
            
            #config SMART_LIGHT_PWM_TIMER_IDX
            #int "LEDC hw timer"
            #range 0 3
            #default 0
            #help
            #    To set the timer index of LEDC
            #    Chosen from TIME[0 - 3]
            
            
            choice SMART_LIGHT_PWM_TIMER_IDX
                bool "LEDC TIMER IDX"
                    default SMART_LIGHT_LEDC_TIMER_0
                config SMART_LIGHT_LEDC_TIMER_0
                    bool "LEDC TIMER_0"
                config SMART_LIGHT_LEDC_TIMER_1
                    bool "LEDC TIMER_1"
                config SMART_LIGHT_LEDC_TIMER_2
                    bool "LEDC TIMER_2"
                config SMART_LIGHT_LEDC_TIMER_3
                    bool "LEDC TIMER_3"
                endchoice
            config SMART_LIGHT_PWM_TIMER_IDX
                int
                default 0 if SMART_LIGHT_LEDC_TIMER_0
                default 1 if SMART_LIGHT_LEDC_TIMER_1
                default 2 if SMART_LIGHT_LEDC_TIMER_2
                default 3 if SMART_LIGHT_LEDC_TIMER_3 
        endmenu
        
        config SMART_LIGHT_PWM_CHANNEL_NUM
        int "LEDC channel number"
        range 3 5
        default 3
        help
            To set the number of PWM channel
        
        menu "SMART LIGHT CHANNEL[0](RED)"
            depends on SMART_LIGHT_PWM_CHANNEL_NUM>0
            config SMART_LIGHT_PWM_UNIT0_LEDC_CHANNEL
            int "LEDC channel for PWM unit[0]"
            range 0 7
            default 0
            help
                To set the LEDC hw channel for PWM[0]
            config SMART_LIGHT_PWM_UNIT0_LEDC_IO
            int "GPIO number for PWM unit[0]"
            range 0 34
            default 17
            help
                To set the output GPIO number for LEDC
        endmenu
        menu "SMART LIGHT CHANNEL[1](GREEN)"
            depends on SMART_LIGHT_PWM_CHANNEL_NUM>1
            config SMART_LIGHT_PWM_UNIT1_LEDC_CHANNEL
            int "LEDC channel for PWM unit[1]"
            range 0 7
            default 1
            help
                To set the LEDC hw channel for PWM[1]
            config SMART_LIGHT_PWM_UNIT1_LEDC_IO
            int "GPIO number for PWM unit[1]"
            range 0 34
            default 18
            help
                To set the output GPIO number for LEDC
        endmenu
        menu "SMART LIGHT CHANNEL[2](BLUE)"
            depends on SMART_LIGHT_PWM_CHANNEL_NUM>2
            config SMART_LIGHT_PWM_UNIT2_LEDC_CHANNEL
            int "LEDC channel for PWM unit[2]"
            range 0 7
            default 2
            help
                To set the LEDC hw channel for PWM[2]
            config SMART_LIGHT_PWM_UNIT2_LEDC_IO
            int "GPIO number for PWM unit[2]"
            range 0 34
            default 19
            help
                To set the output GPIO number for LEDC
        endmenu
        menu "SMART LIGHT CHANNEL[3](CW)"
            depends on SMART_LIGHT_PWM_CHANNEL_NUM>3
            config SMART_LIGHT_PWM_UNIT3_LEDC_CHANNEL
            int "LEDC channel for PWM unit[3]"
            range 0 7
            default 3
            help
                To set the LEDC hw channel for PWM[3]
            config SMART_LIGHT_PWM_UNIT3_LEDC_IO
            int "GPIO number for PWM unit[3]"
            range 0 34
            default 20
            help
                To set the output GPIO number for LEDC
        endmenu        
        
        menu "SMART LIGHT CHANNEL[4](WW)"
            depends on SMART_LIGHT_PWM_CHANNEL_NUM>4
            config SMART_LIGHT_PWM_UNIT4_LEDC_CHANNEL
            int "LEDC channel for PWM unit[4]"
            range 0 7
            default 4
            help
                To set the LEDC hw channel for PWM[4]
            config SMART_LIGHT_PWM_UNIT4_LEDC_IO
            int "GPIO number for PWM unit[4]"
            range 0 34
            default 21
            help
                To set the output GPIO number for LEDC
        endmenu    
        
    endmenu
       

	choice CLOUD_TYPE
        bool "cloud type"
        default CLOUD_ALINK
        depends on DEMO_ENABLE
        help
          select the cloud type

    config CLOUD_ALINK
        bool "alink cloud"
    #config CLOUD_JOYLINK
    #    bool "joylink cloud"
    endchoice
    
    menu "Alink"
    depends on DEMO_ENABLE && CLOUD_ALINK
    
    menu "Product Info"
    config ALINK_INFO_NAME
    string "NAME"
    default alink_product
    
    config ALINK_INFO_VERSION
    string "VERSION"
    default 1.0.0
    
    config ALINK_INFO_MODEL
    string "MODEL"
    default ALINKTEST_LIVING_LIGHT_ALINK_TEST
    
    config ALINK_INFO_KEY
    string "KEY"
    default 5gPFl8G4GyFZ1fPWk20m
    
    config ALINK_INFO_SECRET
    string "SECRET"
    default ngthgTlZ65bX5LpViKIWNsDPhOf2As9ChnoL9gQb
    
    config ALINK_INFO_KEY_SANDBOX
    string "KEY SANDBOX"
    default dpZZEpm9eBfqzK7yVeLq
    
    config ALINK_INFO_SECRET_SANDBOX
    string "SECRET SANDBOX"
    default THnfRRsU5vu6g6m9X6uFyAjUWflgZ0iyGjdEneKm
 
    config ALINK_INFO_KEY_DEVICE
    string "KEY DEVICE"
    default vfyjJdC0O6b2P3UZXq4g
    
    config ALINK_INFO_SECRET_DEVICE
    string "SECRET DEVICE"
    default puAxGjMbb4gd2beaapvMPZN4akedB3Xk
    
    endmenu
    endmenu

endmenu
```

## examples/touch_pad_evb/main/Kconfig.projbuild
```kconfig
menu "IoT Example - Touch Sensor settings"
    choice TOUCH_EB_VERSION
        bool "Select ESP32-Sense Kit version"
        default TOUCH_EB_V3
        help
          select the Touch EB(ESP32-Sense Kit) hardware version
          
    config TOUCH_EB_V3
        bool "TOUCH EB V3"
    config TOUCH_EB_V2
        bool "TOUCH EB V2"
    endchoice
			
 	menu "Plastic cover thickness setting"
		config COVER_THICK_SPRING_BUTTON
			int "Spring button plastic cover thickness (0 mm~3 mm)"
			range 0 3
			default 3
			help 
			    Supports plastic cover from 0 mm to 3 mm thickness
			    
		config COVER_THICK_LINEAR_SLIDER
			int "Linear slider plastic cover thickness (0 mm~1 mm)"
			range 0 1
			default 0
			help
			    Supports plastic cover from 0 mm to 1 mm thickness
		
		config COVER_THICK_DUPLEX_SLIDER
			int "Duplex slider plastic cover thickness (0 mm~1 mm)"
			range 0 1
			default 0
			help
			    Supports plastic cover from 0 mm to 1 mm thickness
			    
        config COVER_THICK_TOUCH_WHEEL
			int "Touch wheel plastic cover thickness (0 mm~1 mm)"
			range 0 1
			default 0
			help
			    Supports plastic cover from 0 mm to 1 mm thickness
        
        config COVER_THICK_MATRIX_BUTTON
        	int "Matrix button plastic cover thickness (0 mm~1 mm)"
        	range 0 1
        	default 0
        	help
        		Supports plastic cover from 0 mm to 1 mm thickness
      	help
          	Please select the daughter board plastic cover thickness that be used.
    endmenu
endmenu
```
