## examples/hmi/lvgl_coffee/sdkconfig.defaults
```kconfig
#
# IoT Solution settings
#


#
# SPI devices
#
CONFIG_IOT_LCD_ENABLE=y
CONFIG_IOT_EINK_ENABLE=y
CONFIG_IOT_TOUCH_SCREEN_ENABLE=y

#
# I2S devices
#
CONFIG_IOT_LCD_NT35510_ENABLE=y
CONFIG_IOT_LCD_ILI9806_ENABLE=y
CONFIG_BIT_MODE_16BIT=y
CONFIG_BIT_MODE_8BIT=

#
# HMI Components
#
CONFIG_LVGL_GUI_ENABLE=y
CONFIG_UGFX_GUI_ENABLE=
CONFIG_SELECT_NONE=

#
# LVGL settings
#
CONFIG_LVGL_USE_CUSTOM_DRIVER=
CONFIG_LVGL_USE_CONFIGURED_OPTIONS=y
CONFIG_LVGL_DRIVER_TOUCH_SCREEN_ENABLE=y
CONFIG_LVGL_LCD_DRIVER_FRAMEBUFFER_MODE=y
CONFIG_LVGL_LCD_DRIVER_API_MODE=
CONFIG_LVGL_DRIVER_AUTO_FLUSH_INTERVAL=50
CONFIG_LVGL_DRIVER_DOUBLE_BUFFER_ENABLE=
CONFIG_LVGL_DISP_ROTATE_0=
CONFIG_LVGL_DISP_ROTATE_90=y
CONFIG_LVGL_DISP_ROTATE_180=
CONFIG_LVGL_DISP_ROTATE_270=

#
# Config Driver
#
CONFIG_LVGL_DRIVER_TOUCH_XPT2046=y
CONFIG_LVGL_DRIVER_TOUCH_FT5X06=

#
# XPT2046 Touch Screen Pin Configuration
#
CONFIG_LVGL_TOUCH_CS_GPIO=32
CONFIG_LVGL_TOUCH_IRQ_GPIO=33
CONFIG_LVGL_DRIVER_ILI9341=
CONFIG_LVGL_DRIVER_SSD1306=
CONFIG_LVGL_DRIVER_ST7789=y
CONFIG_LVGL_DRIVER_NT35510=

#
# ST7789 Screen Pin Configuration
#
CONFIG_LVGL_LCD_HSPI=y
CONFIG_LVGL_LCD_VSPI=
CONFIG_LVGL_LCD_SPI_NUM=1
CONFIG_LVGL_LCD_SPI_CLOCK=20000000
CONFIG_LVGL_LCD_MISO_GPIO=27
CONFIG_LVGL_LCD_MOSI_GPIO=21
CONFIG_LVGL_LCD_CLK_GPIO=22
CONFIG_LVGL_LCD_CS_GPIO=5
CONFIG_LVGL_LCD_DC_GPIO=19
CONFIG_LVGL_LCD_RESET_GPIO=18
CONFIG_LVGL_LCD_BL_GPIO=23
CONFIG_ST7789_LVGL_DRIVER_SCREEN_WIDTH=240
CONFIG_ST7789_LVGL_DRIVER_SCREEN_HEIGHT=320
CONFIG_LVGL_DRIVER_SCREEN_WIDTH=240
CONFIG_LVGL_DRIVER_SCREEN_HEIGHT=320

#
# FreeRTOS
#
CONFIG_FREERTOS_HZ=1000
CONFIG_TIMER_TASK_STACK_DEPTH=4096
```

## examples/hmi/lvgl_example/main/Kconfig.projbuild
```kconfig
menu "Example Configuration"

    choice SELECT_LVGL_DEMO
        bool "Choose LVGL Demo to Run"
            default LV_DEMO_WIDGETS

        config LV_DEMO_BENCHMARK
            bool "LV_DEMO_BENCHMARK"
        config LV_DEMO_PRINTER
            bool "LV_DEMO_PRINTER"
        config LV_DEMO_WIDGETS
            bool "LV_DEMO_WIDGETS"
        config LV_EX_GET_STARTED
            bool "LV_EX_GET_STARTED"
        config LV_DEMO_STRESS
            bool "LV_DEMO_STRESS"
        config LV_EX_STYLE
            bool "LV_EX_STYLE"
    endchoice

endmenu
```

## examples/hmi/lvgl_example/sdkconfig.defaults
```kconfig
CONFIG_BOARD_ESP32_LCDKIT=y

CONFIG_LCD_DRIVER_SCREEN_CONTROLLER_ILI9341=y
CONFIG_LCD_DRIVER_SCREEN_CONTROLLER_ILI9806=y
CONFIG_LCD_DRIVER_SCREEN_CONTROLLER_RM68120=y
CONFIG_LCD_DRIVER_SCREEN_CONTROLLER_ST7789=y
CONFIG_LCD_DRIVER_SCREEN_CONTROLLER_ST7796=y
CONFIG_TOUCH_DRIVER_XPT2046=y
CONFIG_TOUCH_DRIVER_FT5X06=y
CONFIG_TOUCH_DRIVER_NS2016=y
CONFIG_LVGL_DRIVER_TOUCH_SCREEN_ENABLE=y
#
# FreeRTOS
#
CONFIG_FREERTOS_HZ=1000

CONFIG_ESPTOOLPY_FLASHSIZE_4MB=y
CONFIG_PARTITION_TABLE_CUSTOM=y
CONFIG_PARTITION_TABLE_CUSTOM_FILENAME="partitions_example.csv"

CONFIG_LVGL_FONT_MONTSERRAT_16=y
CONFIG_LVGL_FONT_MONTSERRAT_14=y
CONFIG_LVGL_FONT_MONTSERRAT_22=y
CONFIG_LVGL_FONT_MONTSERRAT_28=y
CONFIG_LVGL_FONT_MONTSERRAT_32=y
```

## examples/hmi/lvgl_freetype/sdkconfig.defaults
```kconfig
CONFIG_IDF_TARGET="esp32s3"
CONFIG_ESPTOOLPY_FLASHMODE_QIO=y
CONFIG_ESPTOOLPY_FLASHFREQ_80M=y
CONFIG_ESPTOOLPY_FLASHSIZE_16MB=y
CONFIG_PARTITION_TABLE_CUSTOM=y

CONFIG_COMPILER_OPTIMIZATION_PERF=y
CONFIG_LCD_RGB_RESTART_IN_VSYNC=y
CONFIG_ESP32S3_DEFAULT_CPU_FREQ_240=y
CONFIG_ESP32S3_DATA_CACHE_LINE_64B=y

#
# ESP PSRAM
#
CONFIG_SPIRAM=y
CONFIG_SPIRAM_MODE_OCT=y
CONFIG_SPIRAM_SPEED_80M=y
CONFIG_SPIRAM_FETCH_INSTRUCTIONS=y
CONFIG_SPIRAM_RODATA=y
CONFIG_ESP_DEFAULT_CPU_FREQ_MHZ_240=y

CONFIG_FREERTOS_HZ=1000

CONFIG_LCD_AVOID_TEAR=y
CONFIG_LCD_LVGL_DIRECT_MODE=y
CONFIG_BSP_LCD_SUB_BOARD_480_480=y
CONFIG_BSP_LCD_RGB_BUFFER_NUMS=2
CONFIG_BSP_LCD_RGB_BOUNCE_BUFFER_MODE=y
CONFIG_BSP_DISPLAY_LVGL_TASK_STACK_SIZE_KB=40
CONFIG_BSP_DISPLAY_LVGL_AVOID_TEAR=y
CONFIG_BSP_DISPLAY_LVGL_DIRECT_MODE=y

CONFIG_LV_MEM_CUSTOM=y
CONFIG_LV_MEMCPY_MEMSET_STD=y
CONFIG_LV_FONT_FMT_TXT_LARGE=y
CONFIG_LV_USE_FREETYPE=y
CONFIG_LV_FREETYPE_SBIT_CACHE=y
```

## examples/hmi/lvgl_thermostat/sdkconfig.defaults
```kconfig
CONFIG_BOARD_ESP32_LCDKIT=y

CONFIG_LCD_DRIVER_SCREEN_CONTROLLER_ILI9341=y
CONFIG_LCD_DRIVER_SCREEN_CONTROLLER_ILI9806=y
CONFIG_LCD_DRIVER_SCREEN_CONTROLLER_RM68120=y
CONFIG_LCD_DRIVER_SCREEN_CONTROLLER_ST7789=y
CONFIG_LCD_DRIVER_SCREEN_CONTROLLER_ST7796=y
CONFIG_TOUCH_DRIVER_XPT2046=y
CONFIG_TOUCH_DRIVER_FT5X06=y
CONFIG_TOUCH_DRIVER_NS2016=y
CONFIG_LVGL_DRIVER_TOUCH_SCREEN_ENABLE=y
#
# FreeRTOS
#
CONFIG_FREERTOS_HZ=1000

CONFIG_ESPTOOLPY_FLASHSIZE_4MB=y

CONFIG_LVGL_THEME_DEFAULT_PRIMARY_COLOR_BLUE=y
CONFIG_LVGL_FONT_MONTSERRAT_32=y
```

## examples/hmi/mp3_example/main/Kconfig.projbuild
```kconfig
menu "IoT Example - LittlevGL MP3 Example"

config USE_ADF_PLAY
    bool "Use esp-adf to play song"
    default n
    help
        use esp-adf to play song.

endmenu
```
