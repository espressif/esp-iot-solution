## examples/elf_loader/elf_console_example/sdkconfig.defaults.esp32s3
```kconfig
CONFIG_ESPTOOLPY_FLASHMODE_QIO=y
CONFIG_ESPTOOLPY_FLASHSIZE_8MB=y

CONFIG_PARTITION_TABLE_CUSTOM=y
CONFIG_PARTITION_TABLE_CUSTOM_FILENAME="partitions.8mb.csv"
```

## examples/elf_loader/elf_embed_example/main/Kconfig.projbuild
```kconfig
menu "Embedded ELF Example Configuration"

    config ELF_LOADER_MAIN_ARGS
        bool "Support arguments for ELF main"
        default n

    config ELF_LOADER_MAIN_ARGS_STRING
        string "Arguments of ELF main"
        default ""
        depends on ELF_LOADER_MAIN_ARGS
        help
            Specify the arguments to pass to the main function of the loaded ELF file.
            The arguments should be provided as a space-separated string, e.g., "arg1 arg2 arg3".

endmenu
```

## examples/elf_loader/elf_loader_example/main/Kconfig.projbuild
```kconfig
menu "ELF Loader Example Configuration"

    config ELF_LOADER_MAIN_ARGS
        bool "Support arguments for ELF main"
        default n

    config ELF_LOADER_MAIN_ARGS_STRING
        string "Arguments of ELF main"
        default "main"
        depends on ELF_LOADER_MAIN_ARGS

endmenu
```

## examples/eth2wifi/main/Kconfig.projbuild
```kconfig
menu "IoT Example - Ethernet to WiFi Demo Configuration"

choice PHY_MODEL
    prompt "Ethernet PHY"
    default CONFIG_PHY_IP101
    help
        Select the PHY driver to use for the example.

config PHY_IP101
    bool "IP101"
    help
        IP101 is a single port 10/100 MII/RMII/TP/Fiber Fast Ethernet Transceiver.
        Goto http://www.icplus.com.tw/pp-IP101G.html for more information about it.

config PHY_LAN8720
    bool "Microchip LAN8720 PHY"
    help
        LAN8720A is a small footprint RMII 10/100 Ethernet Transceiver with HP Auto-MDIX Support.
        Goto https://www.microchip.com/LAN8720A for more information about it.

config PHY_RTL8201
    bool "RTL8201/SR8201"
    help
        RTL8201F/SR8201F is a single port 10/100Mb Ethernet Transceiver with auto MDIX.
        Goto http://www.corechip-sz.com/productsview.asp?id=22 for more information about it.

config PHY_DP83848
    bool "DP83848"
    help
        DP83848 is a single port 10/100Mb/s Ethernet Physical Layer Transceiver.
        Goto http://www.ti.com/product/DP83848J for more information about it.
endchoice

config PHY_ADDRESS
    int "PHY Address (0-31)"
    default 31
    range 0 31
    help
        Select the PHY Address (0-31) for the hardware configuration and PHY model.

config PHY_POWER_PIN
    int "PHY Power GPIO"
    default 17
    help
        GPIO number to use for powering on/off the PHY.

config PHY_SMI_MDC_PIN
    int "SMI MDC Pin"
    default 23
    help
        GPIO number to use for SMI clock output MDC to PHY.

config PHY_SMI_MDIO_PIN
    int "SMI MDIO Pin"
    default 18
    help
       GPIO number to use for SMI data pin MDIO to/from PHY.

config ETH_TO_STATION_MODE
    bool "WiFi station mode"
    default n
    help
        If set, it is ethernet to wifi station forwarding data; 
        otherwise,it is ethernet to wifi softap forwarding data.

config DEMO_SSID
    string "The SSID for demo"
    default "ESP32-ETH2WiFi"
       
config DEMO_PASSWORD
    string "The PASSWORD for demo"
    default "1234567890"

endmenu
```

## examples/eth2wifi/sdkconfig.defaults
```kconfig
#
# Compiler options
#
CONFIG_OPTIMIZATION_LEVEL_RELEASE=y

#
# IoT Example - Ethernet to WiFi Demo Configuration
#
CONFIG_PHY_IP101=y
CONFIG_PHY_ADDRESS=1
CONFIG_PHY_USE_POWER_PIN=y
CONFIG_PHY_POWER_PIN=5
CONFIG_PHY_SMI_MDC_PIN=23
CONFIG_PHY_SMI_MDIO_PIN=18
CONFIG_ETH_TO_STATION_MODE=n

#
# Wi-Fi
#
CONFIG_ESP32_WIFI_STATIC_RX_BUFFER_NUM=16
CONFIG_ESP32_WIFI_DYNAMIC_RX_BUFFER_NUM=64

CONFIG_ESP32_WIFI_DYNAMIC_TX_BUFFER_NUM=64
CONFIG_ESP32_WIFI_TX_BA_WIN=16
CONFIG_ESP32_WIFI_RX_BA_WIN=16

#
# ESP32-specific
#
CONFIG_ESP32_DEFAULT_CPU_FREQ_240=y

#
# Ethernet
#
CONFIG_EMAC_TASK_PRIORITY=5


#
# FreeRTOS
#
CONFIG_FREERTOS_HZ=1000
```

## examples/extended_vfs/gpio/gpio_simple/main/Kconfig.projbuild
```kconfig
menu "Example Configuration"

    config GPIO_SIMPLE_GPIO_PIN_NUM
        int "GPIO Pin Number"
        default 9

    config GPIO_SIMPLE_TEST_COUNT
        int "GPIO Pin Testing count"
        default 10

endmenu
```

## examples/extended_vfs/i2c/i2c_bh1750/main/Kconfig.projbuild
```kconfig
menu "Example Configuration"

    config I2C_SDA_PIN_NUM
        int "I2C SDA Pin Number"
        default 25

    config I2C_SCL_PIN_NUM
        int "I2C SCL Pin Number"
        default 26
    
    config I2C_TEST_COUNT
        int "I2C Testing Count of Reading Sensor's Data"
        default 10

    choice I2C_READ_HB1750_METHOD
        prompt "I2C Read BH1750 Method"
        default I2C_READ_BH1750_BY_WRRD

        config I2C_READ_BH1750_BY_WRRD
            bool "Write then Read"
            help
                Select this option, application sends data frame to BH1750,
                then waits for some time, at last reads data from BH1750, there
                are totally 3 steps.

        config I2C_READ_BH1750_BY_EXCHANGE
            bool "Exchange"
            help
                Select this option, application just needs to configure a I2C
                exchange message, pass this to I2C low-level driver by ioctl,
                there is totally 1 step. 
    endchoice

    menu "BH1750 Sensor"
        choice BH1750_ADDR
            prompt "BH1750 I2C Address"
            default BH1750_I2C_ADDRESS_LOW
            help
                Hardware address of BH1750, which is 2 types, and determined by ADDR terminal.

            config BH1750_I2C_ADDRESS_LOW
                bool "BH1750 I2C Address(ADDR=0)"
                help
                    I2C Address of BH1750 Sensor according to your schemetic configuration.

            config BH1750_I2C_ADDRESS_High
                bool "BH1750 I2C Address(ADDR=1)"
                help
                    I2C Address of BH1750 Sensor according to your schemetic configuration.
        endchoice

        config BH1750_ADDR
            hex
            default 0x5C if BH1750_I2C_ADDRESS_High
            default 0x23 if BH1750_I2C_ADDRESS_LOW

        choice BH1750_MODE
            prompt "BH1750 Operation Mode"
            default BH1750_ONETIME_L_RESOLUTION
            help
                Operation Mode of BH1750.
                Different mode means different resolution and measurement time.
            config BH1750_CONTINU_H_RESOLUTION
                bool "Continuously H-Resolution Mode"
                help
                    Resolution is 1lx, measurement time is typically 120ms.
            config BH1750_CONTINU_H_RESOLUTION2
                bool "Continuously H-Resolution Mode2"
                help
                    Resolution is 0.5lx, measurement time is typically 120ms.
            config BH1750_CONTINU_L_RESOLUTION
                bool "Continuously L-Resolution Mode"
                help
                    Resolution is 4lx, measurement time is typically 16ms.
            config BH1750_ONETIME_H_RESOLUTION
                bool "One Time H-Resolution Mode"
                help
                    Resolution is 1lx, measurement time is typically 120ms.
                    It is automatically set to Power Down mode after measurement.
            config BH1750_ONETIME_H_RESOLUTION2
                bool "One Time H-Resolution Mode2"
                help
                    Resolution is 0.5lx, measurement time is typically 120ms.
                    It is automatically set to Power Down mode after measurement.
            config BH1750_ONETIME_L_RESOLUTION
                bool "One Time L-Resolution Mode"
                help
                    Resolution is 4lx, measurement time is typically 16ms.
                    It is automatically set to Power Down mode after measurement.
        endchoice

        config BH1750_OPMODE
            hex
            default 0x10 if BH1750_CONTINU_H_RESOLUTION
            default 0x11 if BH1750_CONTINU_H_RESOLUTION2
            default 0x13 if BH1750_CONTINU_L_RESOLUTION
            default 0x20 if BH1750_ONETIME_H_RESOLUTION
            default 0x21 if BH1750_ONETIME_H_RESOLUTION2
            default 0x23 if BH1750_ONETIME_L_RESOLUTION

    endmenu

endmenu
```

## examples/extended_vfs/i2c/i2c_tt21100/main/Kconfig.projbuild
```kconfig
menu "Example Configuration"

    config I2C_SDA_PIN_NUM
        int "I2C SDA Pin Number"
        default 8

    config I2C_SCL_PIN_NUM
        int "I2C SCL Pin Number"
        default 18
    
    config TT21100_READY_PIN_NUM
        int "TT21100 Ready Pin Number"
        default 3        
    
    config I2C_TEST_COUNT
        int "I2C Testing Count of Reading Sensor's Data"
        default 100
    
    config I2C_SDA_SCL_PIN_PULLUP
        bool "Set I2C SDA & SCL Pin Pull-Up"
        default n
endmenu
```

## examples/extended_vfs/ledc/ledc_simple/main/Kconfig.projbuild
```kconfig
menu "Example Configuration"

    choice LEDC_DEVICE
        prompt "Select LEDC Device"
        default LEDC_DEVICE_LEDC0
        help
            Select LEDC Device for exmaple.
            please note that not all developemnt boards support all following
            devices.

        config LEDC_DEVICE_LEDC0
            bool "LEDC0"
        config LEDC_DEVICE_LEDC1
            bool "LEDC1"
        config LEDC_DEVICE_LEDC2
            bool "LEDC2"
    endchoice

    config LEDC_FREQUENCY
        int "LEDC Frequency(Hz)"
        default 1000  

    config LEDC_CHANNEL_OUPUT_PIN
        int "LEDC Output Pin"
        default 4
endmenu
```

## examples/extended_vfs/spi/spi_master_simple/main/Kconfig.projbuild
```kconfig
menu "Example Configuration"

    choice SPI_DEVICE
        prompt "Select SPI Device"
        default SPI_DEVICE_SPI2
        help
            Select SPI Device for exmaple.
            please note that not all developemnt boards support all following
            devices.

        config SPI_DEVICE_SPI2
            bool "SPI2"

        config SPI_DEVICE_SPI3
            bool "SPI3"
    endchoice

    config SPI_CS_PIN_NUM
        int "SPI CS Pin Number"
        default 10

    config SPI_SCLK_PIN_NUM
        int "SPI SCLK Pin Number"
        default 12

    config SPI_MOSI_PIN_NUM
        int "SPI MOSI Pin Number"
        default 11

    config SPI_MISO_PIN_NUM
        int "SPI MISO Pin Number"
        default 13
endmenu
```

## examples/extended_vfs/spi/spi_slave_simple/main/Kconfig.projbuild
```kconfig
menu "Example Configuration"

    choice SPI_DEVICE
        prompt "Select SPI Device"
        default SPI_DEVICE_SPI2
        help
            Select SPI Device for exmaple.
            please note that not all developemnt boards support all following
            devices.

        config SPI_DEVICE_SPI2
            bool "SPI2"

        config SPI_DEVICE_SPI3
            bool "SPI3"
    endchoice

    config SPI_CS_PIN_NUM
        int "SPI CS Pin Number"
        default 14 if IDF_TARGET_ESP32 || IDF_TARGET_ESP32S2
        default 10 if IDF_TARGET_ESP32C3 || IDF_TARGET_ESP32S3

    config SPI_SCLK_PIN_NUM
        int "SPI SCLK Pin Number"
        default 15 if IDF_TARGET_ESP32 || IDF_TARGET_ESP32S2
        default 6 if IDF_TARGET_ESP32C3
        default 12 if IDF_TARGET_ESP32S3

    config SPI_MOSI_PIN_NUM
        int "SPI MOSI Pin Number"
        default 12 if IDF_TARGET_ESP32 || IDF_TARGET_ESP32S2
        default 7 if IDF_TARGET_ESP32C3
        default 11 if IDF_TARGET_ESP32S3

    config SPI_MISO_PIN_NUM
        int "SPI MISO Pin Number"
        default 13 if IDF_TARGET_ESP32 || IDF_TARGET_ESP32S2 || IDF_TARGET_ESP32S3
        default 2 if IDF_TARGET_ESP32C3
endmenu
```

## examples/get-started/button_power_save/main/Kconfig.projbuild
```kconfig
menu "Example Configuration"

    choice ENTER_LIGHT_SLEEP_MODE
        prompt "Enter light sleep mode"
        default ENTER_LIGHT_SLEEP_AUTO
        depends on PM_ENABLE
        help
            Enable light sleep mode to save power.

        config ENTER_LIGHT_SLEEP_AUTO
            bool "Auto enter Light Sleep"
        config ENTER_LIGHT_SLEEP_MODE_MANUALLY
            bool "Manually enter Light Sleep"
    endchoice

    choice EXAMPLE_MAX_CPU_FREQ
        prompt "Maximum CPU frequency"
        default EXAMPLE_MAX_CPU_FREQ_80 if !IDF_TARGET_ESP32H2
        default EXAMPLE_MAX_CPU_FREQ_96 if IDF_TARGET_ESP32H2
        depends on PM_ENABLE
        help
            Maximum CPU frequency to use for dynamic frequency scaling.

        config EXAMPLE_MAX_CPU_FREQ_80
            bool "80 MHz"
        config EXAMPLE_MAX_CPU_FREQ_96
            bool "96 MHz"
            depends on IDF_TARGET_ESP32H2
        config EXAMPLE_MAX_CPU_FREQ_120
            bool "120 MHz"
            depends on IDF_TARGET_ESP32C2
        config EXAMPLE_MAX_CPU_FREQ_160
            bool "160 MHz"
            depends on !IDF_TARGET_ESP32C2
        config EXAMPLE_MAX_CPU_FREQ_240
            bool "240 MHz"
            depends on IDF_TARGET_ESP32 || IDF_TARGET_ESP32S2 || IDF_TARGET_ESP32S3
    endchoice

    config EXAMPLE_MAX_CPU_FREQ_MHZ
        int
        default 80 if EXAMPLE_MAX_CPU_FREQ_80
        default 96 if EXAMPLE_MAX_CPU_FREQ_96
        default 120 if EXAMPLE_MAX_CPU_FREQ_120
        default 160 if EXAMPLE_MAX_CPU_FREQ_160
        default 240 if EXAMPLE_MAX_CPU_FREQ_240

    choice EXAMPLE_MIN_CPU_FREQ
        prompt "Minimum CPU frequency"
        default EXAMPLE_MIN_CPU_FREQ_10M if !IDF_TARGET_ESP32H2
        default EXAMPLE_MIN_CPU_FREQ_32M if IDF_TARGET_ESP32H2
        depends on PM_ENABLE
        help
            Minimum CPU frequency to use for dynamic frequency scaling.
            Should be set to XTAL frequency or XTAL frequency divided by integer.

        config EXAMPLE_MIN_CPU_FREQ_40M
            bool "40 MHz (use with 40MHz XTAL)"
            depends on XTAL_FREQ_40 || XTAL_FREQ_AUTO || ESP32_XTAL_FREQ_40 || ESP32_XTAL_FREQ_AUTO || !IDF_TARGET_ESP32
        config EXAMPLE_MIN_CPU_FREQ_20M
            bool "20 MHz (use with 40MHz XTAL)"
            depends on XTAL_FREQ_40 || XTAL_FREQ_AUTO || ESP32_XTAL_FREQ_40 || ESP32_XTAL_FREQ_AUTO || !IDF_TARGET_ESP32
        config EXAMPLE_MIN_CPU_FREQ_10M
            bool "10 MHz (use with 40MHz XTAL)"
            depends on XTAL_FREQ_40 || XTAL_FREQ_AUTO || ESP32_XTAL_FREQ_40 || ESP32_XTAL_FREQ_AUTO || !IDF_TARGET_ESP32
        config EXAMPLE_MIN_CPU_FREQ_26M
            bool "26 MHz (use with 26MHz XTAL)"
            depends on XTAL_FREQ_26 || XTAL_FREQ_AUTO || ESP32_XTAL_FREQ_26 || ESP32_XTAL_FREQ_AUTO
        config EXAMPLE_MIN_CPU_FREQ_13M
            bool "13 MHz (use with 26MHz XTAL)"
            depends on XTAL_FREQ_26 || XTAL_FREQ_AUTO || ESP32_XTAL_FREQ_26 || ESP32_XTAL_FREQ_AUTO
        config EXAMPLE_MIN_CPU_FREQ_32M
            bool "32 MHz (use with 32MHz XTAL)"
            depends on IDF_TARGET_ESP32H2
            depends on XTAL_FREQ_32 || XTAL_FREQ_AUTO
    endchoice

    config EXAMPLE_MIN_CPU_FREQ_MHZ
        int
        default 40 if EXAMPLE_MIN_CPU_FREQ_40M
        default 20 if EXAMPLE_MIN_CPU_FREQ_20M
        default 10 if EXAMPLE_MIN_CPU_FREQ_10M
        default 26 if EXAMPLE_MIN_CPU_FREQ_26M
        default 13 if EXAMPLE_MIN_CPU_FREQ_13M
        default 32 if EXAMPLE_MIN_CPU_FREQ_32M

endmenu
```

## examples/get-started/button_power_save/sdkconfig.defaults
```kconfig
# Enable support for power management
CONFIG_PM_ENABLE=y
# Enable tickless idle mode
CONFIG_FREERTOS_USE_TICKLESS_IDLE=y
# Put related source code in IRAM
CONFIG_PM_SLP_IRAM_OPT=y
CONFIG_PM_RTOS_IDLE_OPT=y
# Use 1000Hz freertos tick to lower sleep time threshold
CONFIG_FREERTOS_HZ=1000
# For button power save
CONFIG_GPIO_BUTTON_SUPPORT_POWER_SAVE=y
```

## examples/gprof/gprof_simple/sdkconfig.defaults
```kconfig
CONFIG_GPROF_ENABLE=y
CONFIG_GPROF_COMPONENTS="test_func;espressif__cjson"
CONFIG_PARTITION_TABLE_CUSTOM=y
CONFIG_PARTITION_TABLE_CUSTOM_FILENAME="partitions.csv"
CONFIG_PARTITION_TABLE_FILENAME="partitions.csv"
```
