## examples/sensors/airmouse/sdkconfig.defaults.esp-spot-c5
```kconfig
CONFIG_AIRMOUSE_BOARD_PRESET_ESP_SPOT_C5=y
# CONFIG_AIRMOUSE_BOARD_PRESET_SENSAIR_SHUTTLE is not set
# CONFIG_AIRMOUSE_BOARD_PRESET_CUSTOM is not set

CONFIG_IMU_I2C_SCL=26
CONFIG_IMU_I2C_SDA=25
# CONFIG_IMU_SDO_GPIO_CONTROL is not set
CONFIG_RESET_BUTTON=28
```

## examples/sensors/airmouse/sdkconfig.defaults.sensair-shuttle
```kconfig
# CONFIG_AIRMOUSE_BOARD_PRESET_ESP_SPOT_C5 is not set
CONFIG_AIRMOUSE_BOARD_PRESET_SENSAIR_SHUTTLE=y
# CONFIG_AIRMOUSE_BOARD_PRESET_CUSTOM is not set

CONFIG_IMU_I2C_SCL=3
CONFIG_IMU_I2C_SDA=2
CONFIG_IMU_SDO_GPIO_CONTROL=y
CONFIG_IMU_SDO_PIN=9
CONFIG_RESET_BUTTON=28

CONFIG_AIRMOUSE_ENABLE_BMM350=y
CONFIG_MAG_I2C_SCL=3
CONFIG_MAG_I2C_SDA=2
```
