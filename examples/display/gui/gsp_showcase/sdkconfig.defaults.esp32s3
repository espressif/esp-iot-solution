## examples/display/gui/gsp_showcase/sdkconfig.defaults.esp32s3
```kconfig
CONFIG_EXAMPLE_LCD_INTERFACE_SPI_WITH_PSRAM=y
CONFIG_ESPTOOLPY_FLASHFREQ_80M=y
CONFIG_SPIRAM=y
CONFIG_SPIRAM_MODE_OCT=y
CONFIG_SPIRAM_SPEED_80M=y
CONFIG_SPIRAM_XIP_FROM_PSRAM=y
CONFIG_SPIRAM_MEMTEST=n
CONFIG_ESP_DEFAULT_CPU_FREQ_MHZ_240=y
```

## examples/display/gui/gsp_showcase/sdkconfig.defaults.esp32s31
```kconfig
CONFIG_EXAMPLE_LCD_INTERFACE_RGB=y
CONFIG_SPIRAM=y
CONFIG_SPIRAM_MODE_OCT=y
CONFIG_SPIRAM_SPEED_250M=y
CONFIG_SPIRAM_XIP_FROM_PSRAM=y
```

## examples/display/gui/lvgl_present_benchmark/main/Kconfig.projbuild
```kconfig
# SPDX-FileCopyrightText: 2026 Espressif Systems (Shanghai) CO LTD
#
# SPDX-License-Identifier: Apache-2.0

menu "Present LVGL benchmark"

    config APP_LVGL_BENCH_LOOP
        bool "Loop the runtime benchmark matrix"
        default n
        help
            Run the complete mode/rotation matrix repeatedly. When disabled,
            the benchmark runs the matrix once and then stops its worker task.

    config APP_LVGL_BENCH_TIMEOUT_SECONDS
        int "Timeout for each mode/rotation benchmark"
        range 70 600
        default 120
        help
            Maximum time allowed for LVGL's complete benchmark (currently
            about 69 seconds) and its final summary callback. Each matrix case
            advances as soon as the callback supplies the statistics.

endmenu
```

## examples/elf_loader/elf_console_example/sdkconfig.defaults.esp32s31
```kconfig
CONFIG_ESP_SYSTEM_PMP_IDRAM_SPLIT=n

CONFIG_ESPTOOLPY_FLASHSIZE_16MB=y

CONFIG_PARTITION_TABLE_CUSTOM=y
CONFIG_PARTITION_TABLE_CUSTOM_FILENAME="partitions.8mb.csv"
```

## examples/esp_file_transfer/receiver_demo/sdkconfig.defaults
```kconfig
CONFIG_BT_ENABLED=y
CONFIG_BT_NIMBLE_ENABLED=y
CONFIG_BT_NIMBLE_ROLE_PERIPHERAL=y
CONFIG_BT_NIMBLE_ROLE_BROADCASTER=y
CONFIG_BT_NIMBLE_ATT_PREFERRED_MTU=517
CONFIG_BT_NIMBLE_TRANSPORT_ACL_FROM_LL_COUNT=20
CONFIG_BT_NIMBLE_TRANSPORT_EVT_SIZE=255
CONFIG_BT_NIMBLE_MSYS_1_BLOCK_COUNT=50

CONFIG_PARTITION_TABLE_CUSTOM=y
CONFIG_PARTITION_TABLE_CUSTOM_FILENAME="partitions.csv"
CONFIG_ESPTOOLPY_FLASHSIZE_4MB=y

CONFIG_ESP_GMP_MAX_PAYLOAD=4096
CONFIG_ESP_GMP_TX_QUEUE_DEPTH=8
CONFIG_ESP_GMP_PROFILE_OS=y
CONFIG_ESP_GMP_PROFILE_FILE_TRANSFER=y
CONFIG_ESP_GMP_PROFILE_OTA=n
CONFIG_MBEDTLS_HARDWARE_SHA=y

CONFIG_FREERTOS_HZ=1000
CONFIG_FREERTOS_TIMER_TASK_STACK_DEPTH=3072

# Part files use names like 00000001_demo.txt.part (need LFN; 8.3 rejects them).
CONFIG_FATFS_LFN_HEAP=y
CONFIG_FATFS_MAX_LFN=255
```

## examples/esp_flux/ble_spp_client/sdkconfig.defaults
```kconfig
# Override some defaults so BT stack is enabled
# in this example

#
# BT config
#
CONFIG_BT_ENABLED=y
CONFIG_BTDM_CTRL_MODE_BLE_ONLY=y
CONFIG_BTDM_CTRL_MODE_BR_EDR_ONLY=n
CONFIG_BTDM_CTRL_MODE_BTDM=n
CONFIG_BT_BLUEDROID_ENABLED=n
CONFIG_BT_NIMBLE_ENABLED=y
CONFIG_BT_NIMBLE_TRANSPORT_ACL_FROM_LL_COUNT=20
CONFIG_BT_NIMBLE_TRANSPORT_EVT_SIZE=255
CONFIG_BT_NIMBLE_MSYS_1_BLOCK_COUNT=50
CONFIG_BT_NIMBLE_MAX_CONNECTIONS=1

CONFIG_FREERTOS_HZ=1000
CONFIG_FREERTOS_TIMER_TASK_STACK_DEPTH=3072

CONFIG_BLE_CONN_MGR_ROLE_CENTRAL=y
CONFIG_BLE_CONN_MGR_MAX_CONNECTIONS=1
```

## examples/esp_flux/common_components/ble_session_manager/Kconfig
```kconfig
menu "BLE Session Manager Configuration"

config BLE_MANAGER_MAX_CONNECTIONS
    int "Maximum BLE connections"
    range 1 BT_NIMBLE_MAX_CONNECTIONS if BT_NIMBLE_ENABLED
    range 1 BT_NIMBLE_MAX_CONNECTIONS
    default 2 if IDF_TARGET_ESP32C2
    default 3
    help
        Maximum number of simultaneous BLE connections.

endmenu
```

## examples/esp_gmp/gmp_ota/ble_gmp_ota_server/sdkconfig.defaults
```kconfig
CONFIG_BT_ENABLED=y
CONFIG_BT_NIMBLE_ENABLED=y
CONFIG_BT_NIMBLE_ROLE_PERIPHERAL=y
CONFIG_BT_NIMBLE_ROLE_BROADCASTER=y
CONFIG_BT_NIMBLE_ATT_PREFERRED_MTU=517
CONFIG_BT_NIMBLE_TRANSPORT_ACL_FROM_LL_COUNT=20
CONFIG_BT_NIMBLE_TRANSPORT_EVT_SIZE=255
CONFIG_BT_NIMBLE_MSYS_1_BLOCK_COUNT=50

CONFIG_PARTITION_TABLE_CUSTOM=y
CONFIG_PARTITION_TABLE_CUSTOM_FILENAME="partitions.csv"

CONFIG_ESPTOOLPY_FLASHSIZE_4MB=y

CONFIG_ESP_GMP_MAX_PAYLOAD=4096
CONFIG_ESP_GMP_TX_QUEUE_DEPTH=8
CONFIG_ESP_GMP_PROFILE_OS=y
CONFIG_ESP_GMP_PROFILE_OTA=y
CONFIG_ESP_GMP_OTA_DEVICE=y
# CONFIG_ESP_GMP_OTA_HOST is not set

CONFIG_FREERTOS_HZ=1000
```

## examples/esp_local_controller/main/Kconfig.projbuild
```kconfig
menu "ESP Local Controller Example"

    config EXAMPLE_SUPPORT_HTTP
        bool "Build HTTP transport"
        default y
        depends on ESP_WIFI_ENABLED
        help
            Connect STA to the same Wi-Fi as the device, then talk over HTTP.

    config EXAMPLE_SUPPORT_BLE
        bool "Build BLE transport"
        default y
        depends on BT_NIMBLE_ENABLED && BT_NIMBLE_ROLE_CENTRAL && BT_NIMBLE_ROLE_OBSERVER
        help
            Control properties over BLE (NimBLE central + observer).

    config EXAMPLE_SUPPORT_CONSOLE
        bool "Build UART console transport"
        default n
        help
            Debug transport using protocomm_ext console pipe. Device side needs
            a matching protocomm_console server (not in stock esp_local_ctrl).

    config EXAMPLE_WIFI_SSID
        string "Wi-Fi SSID (HTTP mode STA)"
        default "myssid"
        depends on EXAMPLE_SUPPORT_HTTP

    config EXAMPLE_WIFI_PASSWORD
        string "Wi-Fi password (HTTP mode STA)"
        default "mypassword"
        depends on EXAMPLE_SUPPORT_HTTP

    config EXAMPLE_HTTP_URL
        string "Device local-ctrl HTTP base URL"
        default "http://192.168.1.100:80"
        depends on EXAMPLE_SUPPORT_HTTP
        help
            Host part used by protocomm_ext HTTP client. Paths are appended
            as /esp_local_ctrl/{version,session,control}.

    config EXAMPLE_CTRL_POP
        string "Default Proof of Possession (Sec1, TEST ONLY)"
        default "abcd1234"
        help
            Test-only default when peer sec_ver=1 and the console prompt is left empty.

    config EXAMPLE_CTRL_SEC2_USERNAME
        string "Default Sec2 username (TEST ONLY)"
        default "wifiprov"
        help
            Align with IDF esp_local_ctrl example Sec2 DEV mode.

    config EXAMPLE_CTRL_SEC2_PASSWORD
        string "Default Sec2 password (TEST ONLY)"
        default "abcd1234"
        help
            Align with IDF esp_local_ctrl example Sec2 DEV mode.

    config EXAMPLE_BLE_NAME_PREFIX
        string "Device BLE name filter prefix"
        default "my_esp_ctrl"
        depends on EXAMPLE_SUPPORT_BLE
        help
            IDF example default device name is my_esp_ctrl_device. Matching names
            are marked in the scan menu; selection is interactive.

endmenu
```

## examples/esp_local_controller/sdkconfig.defaults
```kconfig
CONFIG_ESPTOOLPY_FLASHSIZE_4MB=y
CONFIG_PARTITION_TABLE_CUSTOM=y
CONFIG_PARTITION_TABLE_CUSTOM_FILENAME="partitions.csv"

CONFIG_EXAMPLE_SUPPORT_HTTP=y
CONFIG_EXAMPLE_CTRL_POP="abcd1234"
CONFIG_EXAMPLE_CTRL_SEC2_USERNAME="wifiprov"
CONFIG_EXAMPLE_CTRL_SEC2_PASSWORD="abcd1234"

CONFIG_ESP_WIFI_ENABLED=y
CONFIG_ESP_WIFI_IRAM_OPT=n
CONFIG_ESP_WIFI_RX_IRAM_OPT=n
CONFIG_FREERTOS_PLACE_FUNCTIONS_INTO_FLASH=y

CONFIG_BT_ENABLED=y
CONFIG_BT_NIMBLE_ENABLED=y
CONFIG_BT_NIMBLE_ROLE_CENTRAL=y
CONFIG_BT_NIMBLE_ROLE_OBSERVER=y
CONFIG_BT_NIMBLE_ATT_PREFERRED_MTU=512
CONFIG_EXAMPLE_SUPPORT_BLE=y
```

## examples/network_provisioner/main/Kconfig.projbuild
```kconfig
menu "Network Provisioner Example"

    config EXAMPLE_SUPPORT_SOFTAP_WIFI
        bool "Build SoftAP (HTTP) + Wi-Fi provisioning"
        default y
        depends on ESP_WIFI_ENABLED
        help
            Join the device SoftAP then provision Wi-Fi credentials over HTTP.
            Can be combined with BLE modes in the same firmware; pick at runtime.

    config EXAMPLE_SUPPORT_BLE_WIFI
        bool "Build BLE + Wi-Fi provisioning"
        default y
        depends on BT_NIMBLE_ENABLED && BT_NIMBLE_ROLE_CENTRAL && BT_NIMBLE_ROLE_OBSERVER
        help
            Provision Wi-Fi credentials over BLE (NimBLE central + observer).
            Can be combined with SoftAP / Thread.

    config EXAMPLE_SUPPORT_BLE_THREAD
        bool "Build BLE + Thread provisioning"
        default y
        depends on BT_NIMBLE_ENABLED && BT_NIMBLE_ROLE_CENTRAL && BT_NIMBLE_ROLE_OBSERVER
        help
            Provision Thread Active Operational Dataset over BLE.
            The peer device needs IEEE 802.15.4 (e.g. ESP32-H2 / C6); the
            controller only needs NimBLE.

    config EXAMPLE_PROV_POP
        string "Default Proof of Possession (Sec1, TEST ONLY)"
        default "abcd1234"
        help
            Test-only default when peer sec_ver=1 and the console prompt is left empty.
            Do not ship production firmware with a fixed PoP. Align with the device
            example for lab bring-up; prefer typing a fresh PoP at the prompt.

    config EXAMPLE_PROV_SEC2_USERNAME
        string "Default Sec2 username (TEST ONLY)"
        default "wifiprov"
        help
            Test-only default when peer sec_ver=2 and the username prompt is left empty.

    config EXAMPLE_PROV_SEC2_PASSWORD
        string "Default Sec2 password (TEST ONLY)"
        default "abcd1234"
        help
            Test-only default when peer sec_ver=2 and the password prompt is left empty.
            Do not ship production firmware with fixed Sec2 credentials.

    config EXAMPLE_PROV_NAME_PREFIX
        string "Device BLE name / SoftAP SSID prefix"
        default "PROV_"
        depends on EXAMPLE_SUPPORT_SOFTAP_WIFI || EXAMPLE_SUPPORT_BLE_WIFI || EXAMPLE_SUPPORT_BLE_THREAD
        help
            Filter hint for listing peers. After a scan the example prints every
            discovered SoftAP / BLE device name; selection is interactive.
            Matching devices (prefix) are marked in the menu.

    config EXAMPLE_PROV_SOFTAP_PASSWORD
        string "Device SoftAP password"
        default ""
        depends on EXAMPLE_SUPPORT_SOFTAP_WIFI

    config EXAMPLE_PROV_HTTP_URL
        string "Device provisioning HTTP URL (host part used after SoftAP join)"
        default "http://192.168.4.1:80"
        depends on EXAMPLE_SUPPORT_SOFTAP_WIFI

    config EXAMPLE_THREAD_DATASET_HEX
        string "Optional default Thread dataset hex (TEST ONLY)"
        default ""
        depends on EXAMPLE_SUPPORT_BLE_THREAD
        help
            Optional lab default for the console prompt. Prefer entering the
            Active Operational Dataset hex at runtime; do not bake real network
            keys into released firmware.

endmenu
```

## examples/robot/ragtime_panthera/main/Kconfig.projbuild
```kconfig
menu "Ragtime Panthera Configuration"

    orsource "$IDF_PATH/examples/common_components/env_caps/$IDF_TARGET/Kconfig.env_caps"

    config CONSOLE_CONTROL
        bool "Direct control robot arm via console"
        default y
        help
            When set to Y, you can forcibly perform basic operations on the robot arm through the terminal, including kinematics testing, joint movement, enabling, and other actions.

    menu "Hardware Configuration"
        config CAN_TX_NUM
            int "CAN TX Pin"
            range ENV_GPIO_RANGE_MIN ENV_GPIO_IN_RANGE_MAX
            default 21
            help
                TX Pin of the CAN Transceiver

        config CAN_RX_NUM
            int "CAN RX Pin"
            range ENV_GPIO_RANGE_MIN ENV_GPIO_IN_RANGE_MAX
            default 22
            help
                RX Pin of the CAN Transceiver
    endmenu

    menu "Grasp Tuning"
        config GRIPPER_HOLD_SQUEEZE
            int "Hold squeeze past contact (x1000 radians)"
            default 30
            help
                How far past the contact point the gripper squeezes to hold, in radians * 1000 (e.g. 30 = 0.030 rad).
                Larger values grip harder but risk crushing soft objects.

        config LIFT_M
            int "Lift height after grasp (x1000 metres)"
            default 100
            help
                How high the arm lifts straight up after closing the gripper, in metres * 1000 (e.g. 100 = 0.100 m).
    endmenu

endmenu
```
