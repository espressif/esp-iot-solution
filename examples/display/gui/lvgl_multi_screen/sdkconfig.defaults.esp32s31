## examples/display/lcd/rgb_avoid_tearing/main/Kconfig
```kconfig
menu "Example Config"

    menu "Touch Controller"
        config EXAMPLE_LCD_TOUCH_CONTROLLER_GT911
            bool "Enable LCD GT911 Touch"
            default n
            help
                Enable this option if you wish to use display touch.
    endmenu

    menu "Display"
        config EXAMPLE_LVGL_PORT_TASK_MAX_DELAY_MS
            int "LVGL timer task maximum delay (ms)"
            default 500
            range 2 2000  # Example range, adjust as needed
            help
            The maximum delay of the LVGL timer task, in milliseconds.

        config EXAMPLE_LVGL_PORT_TASK_MIN_DELAY_MS
            int "LVGL timer task minimum delay (ms)"
            default 10
            range 1 100  # Example range, adjust as needed
            help
            The minimum delay of the LVGL timer task, in milliseconds.

        config EXAMPLE_LVGL_TASK_PRIORITY
            int "LVGL task priority"
            default 2
            help
                The Board Support Package will create a task that will periodically handle LVGL operation in lv_timer_handler().

        config EXAMPLE_LVGL_TASK_STACK_SIZE_KB
            int "LVGL task stack size (KB)"
            default 4
            help
                Size(KB) of LVGL task stack.

        config EXAMPLE_LVGL_PORT_TASK_CORE
            int "LVGL timer task core"
            default -1
            range -1 1
            help
            The core of the LVGL timer task.
            Set to -1 to not specify the core.
            Set to 1 only if the SoCs support dual-core, otherwise set to -1 or 0.

        config EXAMPLE_LVGL_TICK
            int "LVGL tick period"
            default 5
            range 1 100
            help
                Period of LVGL tick timer.

        config EXAMPLE_LCD_RGB_BOUNCE_BUFFER_HEIGHT
            int "Bounce buffer height"
            default 10
            help
                Height of bounce buffer. The width of the buffer is the same as that of the LCD.

        config EXAMPLE_LVGL_AVOID_TEAR
            bool "Avoid tearing effect"
            default "n"
            help
                Avoid tearing effect through LVGL buffer mode and double frame buffers of RGB LCD. This feature is only available for RGB LCD.

        config EXAMPLE_LVGL_PORT_AVOID_TEARING_MODE
            int "Select Avoid Tearing Mode"
            default 0
            range 0 3
            help
                The current tearing prevention mode supports both full refresh mode and direct mode. Tearing prevention mode may consume more PSRAM space

        choice EXAMPLE_LVGL_ROTATION
            depends on EXAMPLE_LVGL_AVOID_TEAR
            prompt "Select rotation"
            default EXAMPLE_LVGL_ROTATION_NONE
            config EXAMPLE_LVGL_ROTATION_NONE
                bool "Rotation 0"
            config EXAMPLE_LVGL_ROTATION_90
                bool "Rotation 90"
            config EXAMPLE_LVGL_ROTATION_180
                bool "Rotation 180"
            config EXAMPLE_LVGL_ROTATION_270
                bool "Rotation 270"
            help
                Rotate screen when avoid tearing effect is enabled. Need to set EXAMPLE_LCD_RGB_BUFFER_NUMS to 3.
        endchoice

        config EXAMPLE_LVGL_ROTATION_DEGREE
            int
            default 0 if EXAMPLE_LVGL_ROTATION_NONE
            default 1 if EXAMPLE_LVGL_ROTATION_90
            default 2 if EXAMPLE_LVGL_ROTATION_180
            default 3 if EXAMPLE_LVGL_ROTATION_270

        choice EXAMPLE_LVGL_BUF_CAPS
            depends on !EXAMPLE_LVGL_AVOID_TEAR
            prompt "Select LVGL buffer memory capability"
            default EXAMPLE_LVGL_INTERNAL
            config EXAMPLE_LVGL_PSRAM
                bool "PSRAM memory"
            config EXAMPLE_LVGL_INTERNAL
                bool "Internal memory"
        endchoice

        config EXAMPLE_LVGL_BUF_HEIGHT
            depends on !EXAMPLE_LVGL_AVOID_TEAR
            int "LVGL buffer height"
            default 100
            help
                Height of LVGL buffer. The width of the buffer is the same as that of the LCD.
    endmenu

endmenu
```

## examples/display/lcd/rgb_avoid_tearing/main/Kconfig.projbuild
```kconfig
menu "Example Configuration"
    menu "Touch Controller"
        config EXAMPLE_LCD_TOUCH_CONTROLLER_GT911
            bool "Enable LCD GT911 Touch"
            default n
            help
                Enable this option if you wish to use display touch.
    endmenu

    menu "Display"
        config EXAMPLE_LCD_RGB_BOUNCE_BUFFER_HEIGHT
            int "RGB Bounce buffer height"
            default 10
            help
                Height of bounce buffer. The width of the buffer is the same as that of the LCD.

        config EXAMPLE_LVGL_PORT_TASK_MAX_DELAY_MS
            int "LVGL timer task maximum delay (ms)"
            default 500
            range 2 2000  # Example range, adjust as needed
            help
            The maximum delay of the LVGL timer task, in milliseconds.

        config EXAMPLE_LVGL_PORT_TASK_MIN_DELAY_MS
            int "LVGL timer task minimum delay (ms)"
            default 10
            range 1 100  # Example range, adjust as needed
            help
            The minimum delay of the LVGL timer task, in milliseconds.

        config EXAMPLE_LVGL_PORT_TASK_PRIORITY
            int "LVGL task priority"
            default 2
            help
                The Board Support Package will create a task that will periodically handle LVGL operation in lv_timer_handler().

        config EXAMPLE_LVGL_PORT_TASK_STACK_SIZE_KB
            int "LVGL task stack size (KB)"
            default 6
            help
                Size(KB) of LVGL task stack.

        config EXAMPLE_LVGL_PORT_TASK_CORE
            int "LVGL timer task core"
            default -1
            range -1 1
            help
            The core of the LVGL timer task.
            Set to -1 to not specify the core.
            Set to 1 only if the SoCs support dual-core, otherwise set to -1 or 0.

        config EXAMPLE_LVGL_PORT_TICK
            int "LVGL tick period"
            default 2
            range 1 100
            help
                Period of LVGL tick timer.

        config EXAMPLE_LVGL_PORT_AVOID_TEAR_ENABLE
            bool "Avoid tearing effect"
            default "n"
            help
                Avoid tearing effect through LVGL buffer mode and double frame buffers of RGB LCD. This feature is only available for RGB LCD.

        choice
            depends on EXAMPLE_LVGL_PORT_AVOID_TEAR_ENABLE
            prompt "Select Avoid Tearing Mode"
            default EXAMPLE_LVGL_PORT_AVOID_TEAR_MODE_3
            config EXAMPLE_LVGL_PORT_AVOID_TEAR_MODE_1
                bool "Mode1: LCD double-buffer & LVGL full-refresh"
            config EXAMPLE_LVGL_PORT_AVOID_TEAR_MODE_2
                bool "Mode2: LCD triple-buffer & LVGL full-refresh"
            config EXAMPLE_LVGL_PORT_AVOID_TEAR_MODE_3
                bool "Mode3: LCD double-buffer & LVGL direct-mode"
            help
                The current tearing prevention mode supports both full refresh mode and direct mode. Tearing prevention mode may consume more PSRAM space
        endchoice

        config EXAMPLE_LVGL_PORT_AVOID_TEAR_MODE
            depends on EXAMPLE_LVGL_PORT_AVOID_TEAR_ENABLE
            int
            default 1 if EXAMPLE_LVGL_PORT_AVOID_TEAR_MODE_1
            default 2 if EXAMPLE_LVGL_PORT_AVOID_TEAR_MODE_2
            default 3 if EXAMPLE_LVGL_PORT_AVOID_TEAR_MODE_3

        choice
            depends on EXAMPLE_LVGL_PORT_AVOID_TEAR_ENABLE
            prompt "Select rotation"
            default EXAMPLE_LVGL_PORT_ROTATION_0
            config EXAMPLE_LVGL_PORT_ROTATION_0
                bool "Rotation 0"
            config EXAMPLE_LVGL_PORT_ROTATION_90
                bool "Rotation 90"
            config EXAMPLE_LVGL_PORT_ROTATION_180
                bool "Rotation 180"
            config EXAMPLE_LVGL_PORT_ROTATION_270
                bool "Rotation 270"
        endchoice

        config EXAMPLE_LVGL_PORT_ROTATION_DEGREE
            int
            default 0 if EXAMPLE_LVGL_PORT_ROTATION_0
            default 90 if EXAMPLE_LVGL_PORT_ROTATION_90
            default 180 if EXAMPLE_LVGL_PORT_ROTATION_180
            default 270 if EXAMPLE_LVGL_PORT_ROTATION_270

        choice
            depends on !EXAMPLE_LVGL_PORT_AVOID_TEAR_ENABLE
            prompt "Select LVGL buffer memory capability"
            default EXAMPLE_LVGL_PORT_BUF_INTERNAL
            config EXAMPLE_LVGL_PORT_BUF_PSRAM
                bool "PSRAM memory"
            config EXAMPLE_LVGL_PORT_BUF_INTERNAL
                bool "Internal memory"
        endchoice

        config EXAMPLE_LVGL_PORT_BUF_HEIGHT
            depends on !EXAMPLE_LVGL_PORT_AVOID_TEAR_ENABLE
            int "LVGL buffer height"
            default 100
            help
                Height of LVGL buffer. The width of the buffer is the same as that of the LCD.
    endmenu
endmenu
```

## examples/elf_loader/build_shared_library_example/sdkconfig.defaults
```kconfig
CONFIG_ESP_SYSTEM_MEMPROT_FEATURE_LOCK=n
CONFIG_ELF_DYNAMIC_LOAD_SHARED_OBJECT=y
```

## examples/elf_loader/elf_console_example/components/shell/Kconfig.projbuild
```kconfig
menu "Shell"
    config ELF_SHELL
        bool "Enable ELF shell command"
        default y
        help
            Enable the ELF shell command interface for interactive
            command execution in the console example.

    if ELF_SHELL
        config SHELL_PROMPT
            string "Shell prompt"
            default "ELF>"

        menu "Shell Command List"
            config SHELL_CMD_FREE
                bool "free"
                default y

            config SHELL_CMD_LS
                bool "ls"
                default y

            if ELF_DYNAMIC_LOAD_SHARED_OBJECT
                config SHELL_CMD_EXEC
                    bool "exec"
                    default y
                config SHELL_CMD_MOD_LOAD
                    bool "mod_load"
                    default y
                config SHELL_CMD_MOD_UNLOAD
                    bool "mod_unload"
                    default y
                config SHELL_CMD_LIST
                    bool "list"
                    default y
            endif
        endmenu
    endif
endmenu
```

## examples/elf_loader/elf_console_example/sdkconfig.defaults
```kconfig
CONFIG_ESP_SYSTEM_MEMPROT_FEATURE=n

CONFIG_EXTENDED_VFS_SPI=n

CONFIG_LITTLEFS_FCNTL_GET_PATH=y
CONFIG_LITTLEFS_OPEN_DIR=y
CONFIG_LITTLEFS_SPIFFS_COMPAT=y

CONFIG_ELF_SHELL=y
CONFIG_ELF_DYNAMIC_LOAD_SHARED_OBJECT=y
```

## examples/elf_loader/elf_console_example/sdkconfig.defaults.esp32c5
```kconfig
CONFIG_ESP_SYSTEM_PMP_IDRAM_SPLIT=n

CONFIG_ESPTOOLPY_FLASHMODE_QIO=y
CONFIG_ESPTOOLPY_FLASHSIZE_4MB=y

CONFIG_PARTITION_TABLE_CUSTOM=y
CONFIG_PARTITION_TABLE_CUSTOM_FILENAME="partitions.4mb.single_app.csv"
```

## examples/elf_loader/elf_console_example/sdkconfig.defaults.esp32s2
```kconfig
CONFIG_ESPTOOLPY_FLASHMODE_QIO=y
CONFIG_ESPTOOLPY_FLASHSIZE_4MB=y

CONFIG_PARTITION_TABLE_CUSTOM=y
CONFIG_PARTITION_TABLE_CUSTOM_FILENAME="partitions.4mb.single_app.csv"
```
