## examples/display/gui/lvgl_multi_screen/sdkconfig.defaults.esp32s31
```kconfig
# ESP32-S31 default configuration

CONFIG_IDF_TARGET="esp32s31"

# Default LCD interface: RGB
CONFIG_EXAMPLE_LCD_INTERFACE_RGB=y

# PSRAM configuration
CONFIG_SPIRAM=y
CONFIG_SPIRAM_SPEED_250M=y
CONFIG_SPIRAM_XIP_FROM_PSRAM=y
CONFIG_SPIRAM_MEMTEST=n
```

## examples/display/lcd/hdmi_video_renderer/components/esp_extractor/Kconfig
```kconfig
menu "Extractor Configuration"

    config WAV_EXTRACTOR_SUPPORT
        bool "Support WAV Extractor"
        default y
        help
            Enable this option to register WAV Extractor

    config MP4_EXTRACTOR_SUPPORT
        bool "Support MP4 Extractor"
        default y
        help
            Enable this option to register MP4 Extractor

    config TS_EXTRACTOR_SUPPORT
        bool "Support TS Extractor"
        default y
        help
            Enable this option to register TS Extractor

    config HLS_EXTRACTOR_SUPPORT
        bool "Support HLS (m3u8) Extractor"
        default y
        help
            Enable this option to register HLS Extractor

    config OGG_EXTRACTOR_SUPPORT
        bool "Support OGG Extractor"
        default y
        help
            Enable this option to register OGG extractor

    config AVI_EXTRACTOR_SUPPORT
        bool "Support AVI Extractor"
        default y
        help
            Enable this option to register AVI Extractor

    config AUDIO_ES_EXTRACTOR_SUPPORT
        bool "Support Audio ES Extractor"
        default y
        help
            Enable this option to register (aac, mp3, flac, amr etc) Extractor

    config CAF_EXTRACTOR_SUPPORT
        bool "Support CALF Extractor"
        default y
        help
            Enable this option to register CALF Extractor

    config FLV_EXTRACTOR_SUPPORT
        bool "Support FLV Extractor"
        default y
        help
            Enable this option to register FLV Extractor
 endmenu
```

## examples/display/lcd/hdmi_video_renderer/main/Kconfig.projbuild
```kconfig
menu "HDMI MP4 Player Configuration"

    menu "Video File Configuration"
        config MP4_FILENAME
            string "Video File Name"
            default "test_video.mp4"
            help
                Name of the video file to be played.
    endmenu

    menu "Display Configuration"

        config USE_LCD_BUFFER
            bool "Use LCD Internal Buffer"
            default y
            help
                Use the internal LCD buffer for frame rendering.
                When enabled, uses the DPI panel's built-in frame buffer for efficient rendering.
                When disabled, allocates separate frame buffers in external memory.

                Important notes when using LCD internal buffer:
                1. MP4 video resolution must match the HDMI output resolution
                2. This mode provides the highest possible frame rate

    endmenu

    menu "Audio Decoder Configuration"

        config AUDIO_DEC_FLAC_ENABLE
            bool "Enable FLAC Decoder"
            default n
            help
                Enable FLAC audio decoder support.
                FLAC (Free Lossless Audio Codec) is a lossless audio compression format.

        config AUDIO_DEC_OPUS_ENABLE
            bool "Enable OPUS Decoder"
            default n
            help
                Enable OPUS audio decoder support.
                Opus is a lossy audio coding format developed for internet streaming.

        config AUDIO_DEC_VORBIS_ENABLE
            bool "Enable VORBIS Decoder"
            default n
            help
                Enable Vorbis audio decoder support.
                Vorbis is a free and open-source lossy audio compression format.

        config AUDIO_DEC_ADPCM_ENABLE
            bool "Enable ADPCM Decoder"
            default n
            help
                Enable ADPCM (Adaptive Differential Pulse Code Modulation) audio decoder support.
                ADPCM is a variant of PCM that encodes the differences between samples.

    endmenu

    menu "Video Synchronization Configuration"

        config HDMI_VIDEO_SYNC_ENABLED
            bool "Enable Audio-Video Synchronization"
            default y
            help
                Enable synchronization between audio and video playback.
                This ensures audio and video tracks are played in sync.
                When disabled, audio and video will play independently without timing coordination.

    endmenu

endmenu
```

## examples/display/lcd/lcd_with_te/components/esp_bsp/Kconfig
```kconfig
menu "Board Support Package"
    choice BSP_LCD_SUB_BOARD
        prompt "Select Target Sub board"
        default BSP_LCD_BOARD_I80_170_560
        help
            Select the board of the LCD.

        config BSP_LCD_BOARD_I80_170_560
            bool "Board with 170x560 I80 LCD"
        config BSP_LCD_BOARD_QSPI_480_320
            bool "Board with 480x320 QSPI LCD"
    endchoice
endmenu
```

## examples/display/lcd/lcd_with_te/main/Kconfig.projbuild
```kconfig
menu "Example Configuration"

    choice EXAMPLE_DISPLAY_ROTATION
        prompt "Select rotation"
        default EXAMPLE_DISPLAY_ROTATION_NONE
        config EXAMPLE_DISPLAY_ROTATION_NONE
            bool "Rotation 0"
        config EXAMPLE_DISPLAY_ROTATION_90
            bool "Rotation 90"
        config EXAMPLE_DISPLAY_ROTATION_180
            bool "Rotation 180"
        config EXAMPLE_DISPLAY_ROTATION_270
            bool "Rotation 270"
    endchoice

    choice EXAMPLE_DISPLAY_SHOW_UI
        prompt "Select UI example"
        default EXAMPLE_DISPLAY_SHOW_SCROLL
        config EXAMPLE_DISPLAY_SHOW_SCROLL
            bool "scroll"
        config EXAMPLE_DISPLAY_SHOW_WIDGET
            bool "lvgl widget"
    endchoice

endmenu
```

## examples/display/lcd/lcd_with_te/sdkconfig.defaults
```kconfig
CONFIG_IDF_TARGET="esp32s3"
CONFIG_APP_RETRIEVE_LEN_ELF_SHA=9
CONFIG_ESPTOOLPY_FLASHMODE_QIO=y
CONFIG_GDMA_CTRL_FUNC_IN_IRAM=y
CONFIG_ESP32S3_DEFAULT_CPU_FREQ_240=y
CONFIG_ESP32S3_DATA_CACHE_64KB=y
CONFIG_ESP32S3_SPIRAM_SUPPORT=y
CONFIG_SPIRAM_MODE_OCT=y
CONFIG_SPIRAM_FETCH_INSTRUCTIONS=y
CONFIG_SPIRAM_RODATA=y
CONFIG_SPIRAM_SPEED_120M=y
CONFIG_FREERTOS_HZ=1000
CONFIG_FREERTOS_PLACE_SNAPSHOT_FUNS_INTO_FLASH=y
CONFIG_LV_COLOR_16_SWAP=y
CONFIG_LV_MEM_CUSTOM=y
CONFIG_LV_USE_PERF_MONITOR=y
CONFIG_LV_USE_DEMO_WIDGETS=y
CONFIG_LV_USE_USER_DATA=y
CONFIG_LV_COLOR_16_SWAP=y
```

## examples/display/lcd/mipi_dsi_avoid_tearing/main/Kconfig.projbuild
```kconfig
menu "Example LCD Configuration"

    choice EXAMPLE_LCD_ROTATION
        prompt "LCD Rotation Angle"
        default EXAMPLE_LCD_ROTATION_0
        help
            Select the rotation angle of the LCD display.
            Note: Rotation of 90 or 270 degrees requires 3 frame buffers.

        config EXAMPLE_LCD_ROTATION_0
            bool "0 degree (No rotation)"
        config EXAMPLE_LCD_ROTATION_90
            bool "90 degree (Clockwise)"
        config EXAMPLE_LCD_ROTATION_180
            bool "180 degree"
        config EXAMPLE_LCD_ROTATION_270
            bool "270 degree (Counter-clockwise)"
    endchoice

    config EXAMPLE_LCD_ROTATION
        int
        default 0 if EXAMPLE_LCD_ROTATION_0
        default 90 if EXAMPLE_LCD_ROTATION_90
        default 180 if EXAMPLE_LCD_ROTATION_180
        default 270 if EXAMPLE_LCD_ROTATION_270

endmenu
```

## examples/display/lcd/qspi_with_ram/main/Kconfig.projbuild
```kconfig
menu "Example Configuration"
    menu "LCD Controller"
        choice EXAMPLE_LCD_CONTROLLER
            prompt "Select LCD Controller Model"
            default EXAMPLE_LCD_CONTROLLER_SPD2010
            help
                Select the LCD controller model for your display.

            config EXAMPLE_LCD_CONTROLLER_SPD2010
                bool "SPD2010 (412x412)"

            config EXAMPLE_LCD_CONTROLLER_GC9B71
                bool "GC9B71 (320x386)"

            config EXAMPLE_LCD_CONTROLLER_SH8601
                bool "SH8601 (454x454)"
        endchoice
    endmenu

    menu "Touch Controller"
        config EXAMPLE_LCD_TOUCH_ENABLED
            bool "Enable Touch Controller"
            default n
            help
                Enable this option if your display has a touch panel.

        choice EXAMPLE_LCD_TOUCH_CONTROLLER
            prompt "Select Touch Controller Model"
            depends on EXAMPLE_LCD_TOUCH_ENABLED
            default EXAMPLE_LCD_TOUCH_CONTROLLER_CST816S if EXAMPLE_LCD_CONTROLLER_GC9B71
            default EXAMPLE_LCD_TOUCH_CONTROLLER_SPD2010 if EXAMPLE_LCD_CONTROLLER_SPD2010
            help
                Select the touch controller model.

            config EXAMPLE_LCD_TOUCH_CONTROLLER_SPD2010
                depends on EXAMPLE_LCD_CONTROLLER_SPD2010
                bool "SPD2010"

            config EXAMPLE_LCD_TOUCH_CONTROLLER_CST816S
                bool "CST816S"
        endchoice
    endmenu
endmenu
```

## examples/display/lcd/qspi_with_ram/sdkconfig.defaults
```kconfig
# Flash and Partition Configuration
CONFIG_ESPTOOLPY_FLASHSIZE_4MB=y
CONFIG_PARTITION_TABLE_CUSTOM=y

# Performance Optimization
CONFIG_COMPILER_OPTIMIZATION_PERF=y

# FreeRTOS Configuration
CONFIG_FREERTOS_HZ=1000

# LVGL Configuration
CONFIG_LV_USE_CLIB_MALLOC=y
CONFIG_LV_USE_CLIB_STRING=y
CONFIG_LV_USE_CLIB_SPRINTF=y
CONFIG_LV_DEF_REFR_PERIOD=15
CONFIG_LV_DPI_DEF=60
CONFIG_LV_OS_FREERTOS=y
CONFIG_LV_DRAW_LAYER_SIMPLE_BUF_SIZE=48000
CONFIG_LV_DRAW_THREAD_PRIO=4
CONFIG_LV_DRAW_SW_SHADOW_CACHE_SIZE=4
CONFIG_LV_GRADIENT_MAX_STOPS=4
CONFIG_LV_OBJ_STYLE_CACHE=y

CONFIG_LV_FONT_MONTSERRAT_12=y
CONFIG_LV_FONT_MONTSERRAT_16=y

# LVGL Demos
CONFIG_LV_USE_DEMO_WIDGETS=y
CONFIG_LV_USE_DEMO_BENCHMARK=y
CONFIG_LV_USE_DEMO_MUSIC=y
CONFIG_LV_DEMO_MUSIC_AUTO_PLAY=y
```

## examples/display/lcd/qspi_with_ram/sdkconfig.defaults.esp32p4
```kconfig
# ESP32-P4 default configuration

CONFIG_IDF_TARGET="esp32p4"
CONFIG_PARTITION_TABLE_OFFSET=0x10000
```

## examples/display/lcd/qspi_without_ram/main/Kconfig.projbuild
```kconfig
menu "Example Configuration"
    menu "LCD"
        config EXAMPLE_LCD_BUFFER_NUMS
            int "Set number of frame buffers"
            default 1
            range 1 3
            help
                Let LCD driver create a specified number of frame-size buffers. Only when it is set to multiple can the avoiding tearing be turned on.
    endmenu

    menu "Display"
        config EXAMPLE_DISPLAY_LVGL_AVOID_TEAR
            bool "Avoid tearing effect"
            depends on EXAMPLE_LCD_BUFFER_NUMS > 1
            default "n"
            help
                Avoid tearing effect through LVGL buffer mode and double frame buffers of RGB LCD. This feature is only available for RGB LCD.

        choice EXAMPLE_DISPLAY_LVGL_MODE
            depends on EXAMPLE_DISPLAY_LVGL_AVOID_TEAR
            prompt "Select LVGL buffer mode"
            default EXAMPLE_DISPLAY_LVGL_FULL_REFRESH
            config EXAMPLE_DISPLAY_LVGL_FULL_REFRESH
                bool "Full refresh"
            config EXAMPLE_DISPLAY_LVGL_DIRECT_MODE
                bool "Direct mode"
        endchoice

        choice EXAMPLE_DISPLAY_LVGL_ROTATION
            depends on EXAMPLE_DISPLAY_LVGL_AVOID_TEAR
            depends on EXAMPLE_LCD_BUFFER_NUMS = 3
            prompt "Select rotation"
            default EXAMPLE_DISPLAY_LVGL_ROTATION_NONE
            config EXAMPLE_DISPLAY_LVGL_ROTATION_NONE
                bool "Rotation 0"
            config EXAMPLE_DISPLAY_LVGL_ROTATION_90
                bool "Rotation 90"
            config EXAMPLE_DISPLAY_LVGL_ROTATION_180
                bool "Rotation 180"
            config EXAMPLE_DISPLAY_LVGL_ROTATION_270
                bool "Rotation 270"
            help
                Rotate screen when avoid tearing effect is enabled. Need to set EXAMPLE_LCD_BUFFER_NUMS to 3.
                The rotation is software-based and will substantially reduce FPS if enabled.
        endchoice

        config EXAMPLE_DISPLAY_LVGL_ROTATION_DEGREE
            int
            default 0 if EXAMPLE_DISPLAY_LVGL_ROTATION_NONE
            default 1 if EXAMPLE_DISPLAY_LVGL_ROTATION_90
            default 2 if EXAMPLE_DISPLAY_LVGL_ROTATION_180
            default 3 if EXAMPLE_DISPLAY_LVGL_ROTATION_270

        choice EXAMPLE_DISPLAY_LVGL_BUF_CAPS
            depends on !EXAMPLE_DISPLAY_LVGL_AVOID_TEAR
            prompt "Select LVGL buffer memory capability"
            default EXAMPLE_DISPLAY_LVGL_INTERNAL
            config EXAMPLE_DISPLAY_LVGL_PSRAM
                bool "PSRAM memory"
            config EXAMPLE_DISPLAY_LVGL_INTERNAL
                bool "Internal memory"
        endchoice

        config EXAMPLE_DISPLAY_LVGL_BUF_HEIGHT
            depends on !EXAMPLE_DISPLAY_LVGL_AVOID_TEAR
            int "LVGL buffer height"
            default 100
            help
                Height of LVGL buffer. The width of the buffer is the same as that of the LCD.
    endmenu
endmenu
```
