## examples/usb/device/usb_uart_bridge/main/Kconfig.projbuild
```kconfig
menu "USB UART Bridge Example"

    config UART_AUTO_DOWNLOAD
        bool "Enable auto download, if enable please attach io0 and rst"
        default y
    config BOARD_AUTODLD_EN_PIN
        int "Auto download EN(RST) pin"
        range 0 46 if IDF_TARGET_ESP32S2
        range 0 48 if IDF_TARGET_ESP32S3
        range 0 54 if IDF_TARGET_ESP32P4
        default 3 if IDF_TARGET_ESP32S2 || IDF_TARGET_ESP32S3
        default 5 if IDF_TARGET_ESP32P4
        depends on UART_AUTO_DOWNLOAD
    config BOARD_AUTODLD_BOOT_PIN
        int "Auto download BOOT pin"
        range 0 46 if IDF_TARGET_ESP32S2
        range 0 48 if IDF_TARGET_ESP32S3
        range 0 54 if IDF_TARGET_ESP32P4
        default 26 if IDF_TARGET_ESP32S2 || IDF_TARGET_ESP32S3
        default 6 if IDF_TARGET_ESP32P4
        depends on UART_AUTO_DOWNLOAD
    config BOARD_UART_TXD_PIN
        int "UART TXD pin"
        range 0 46 if IDF_TARGET_ESP32S2
        range 0 48 if IDF_TARGET_ESP32S3
        range 0 54 if IDF_TARGET_ESP32P4
        default 45 if IDF_TARGET_ESP32S2 || IDF_TARGET_ESP32S3
        default 46 if IDF_TARGET_ESP32P4
    config BOARD_UART_RXD_PIN
        int "UART RXD pin"
        range 0 46 if IDF_TARGET_ESP32S2
        range 0 48 if IDF_TARGET_ESP32S3
        range 0 54 if IDF_TARGET_ESP32P4
        default 46 if IDF_TARGET_ESP32S2 || IDF_TARGET_ESP32S3
        default 27 if IDF_TARGET_ESP32P4
    config UART_RX_BUF_SIZE
        int "UART RX buffer size (Bytes)"
        default 256 if IDF_TARGET_ESP32S2 || IDF_TARGET_ESP32S3
        default 512 if IDF_TARGET_ESP32P4
    config UART_TX_BUF_SIZE
        int "UART TX buffer size (Bytes)"
        default 1024
    config USB_RX_BUF_SIZE
        int "USB RX buffer size (Bytes)"
        default 256 if IDF_TARGET_ESP32S2 || IDF_TARGET_ESP32S3
        default 512 if IDF_TARGET_ESP32P4
    config USB_TX_BUF_SIZE
        int "USB TX buffer size (Bytes)"
        default 1024

endmenu
```

## examples/usb/device/usb_uf2_ota/sdkconfig.defaults
```kconfig
#
# Serial flasher config
#
CONFIG_ESPTOOLPY_FLASHSIZE_4MB=y
CONFIG_ESPTOOLPY_FLASHSIZE_DETECT=y

#
# Partition Table
#
CONFIG_PARTITION_TABLE_CUSTOM=y
CONFIG_PARTITION_TABLE_CUSTOM_FILENAME="partitions_two_ota_4m.csv"
CONFIG_PARTITION_TABLE_FILENAME="partitions_two_ota_4m.csv"
CONFIG_PARTITION_TABLE_OFFSET=0x8000
CONFIG_PARTITION_TABLE_MD5=y
# end of Partition Table
CONFIG_ENABLE_UF2_USB_CONSOLE=y
```

## examples/usb/device/usb_webcam/main/Kconfig.projbuild
```kconfig
menu "USB WebCam config"

    choice CAMERA_DEFAULT_FORMAT
        bool "Camera Default Format"
        default FORMAT_MJPEG
        config FORMAT_MJPEG
            bool "MJPEG"
    endchoice

    choice CAMERA_UVC_MODE
        bool "UVC transfer mode"
        default UVC_MODE_ISOC
        config UVC_MODE_ISOC
            bool "Isochronous"
        config UVC_MODE_BULK
            bool "Bulk"
    endchoice

    config CAMERA_QUALITY_JPEG
        int "JPEG Quality"
        depends on FORMAT_MJPEG
        default 14
        range 0 63

    choice CAMERA_DEFAULT_FRAMESIZE
        bool "Camera Default Resolution"
        default FRAMESIZE_HD
        config FRAMESIZE_QVGA
            bool "QVGA 320x240"
        config FRAMESIZE_HVGA
            bool "HVGA 480x320"
        config FRAMESIZE_VGA
            bool "VGA 640x480"
        config FRAMESIZE_SVGA
            bool "SVGA 800x600"
        config FRAMESIZE_HD
            bool "HD 1280x720"
        config FRAMESIZE_FHD
            bool "FHD 1920x1080"
    endchoice

    config CAMERA_DEFAULT_FRAMERATE
        int "Camera Frame Rate (FPS)"
        default 30 if FRAMESIZE_QVGA
        default 30 if FRAMESIZE_HVGA
        default 15 if FRAMESIZE_VGA
        default 15 if FRAMESIZE_SVGA
        default 15 if FRAMESIZE_HD
        default 15 if FRAMESIZE_FHD

    config CAMERA_DEFAULT_FRAMESIZE_WIDTH
        int
        default 320 if FRAMESIZE_QVGA
        default 480 if FRAMESIZE_HVGA
        default 640 if FRAMESIZE_VGA
        default 800 if FRAMESIZE_SVGA
        default 1280 if FRAMESIZE_HD
        default 1920 if FRAMESIZE_FHD

    config CAMERA_DEFAULT_FRAMESIZE_HEIGT
        int
        default 240 if FRAMESIZE_QVGA
        default 320 if FRAMESIZE_HVGA
        default 480 if FRAMESIZE_VGA
        default 600 if FRAMESIZE_SVGA
        default 720 if FRAMESIZE_HD
        default 1080 if FRAMESIZE_FHD

    config CAMERA_DEFAULT_FRAMESIZE_SIZE
        int "Frame Buffer Size (KB)"
        default 70 if FRAMESIZE_HD
        default 80 if FRAMESIZE_FHD
        default 60 if IDF_TARGET_ESP32S3
        default 45 if IDF_TARGET_ESP32S2

    config CAMERA_MULTI_FRAMESIZE
        bool "Enable multiple frames sizes"
        default y
        help
            If enable, add VGA and HVGA to list

    menu "Camera Pin Configuration"

        choice CAMERA_MODULE
            bool "Select Camera Pinout"
            default CAMERA_MODULE_ESP_S3_EYE if IDF_TARGET_ESP32S3
            default CAMERA_MODULE_ESP_S2_KALUGA if IDF_TARGET_ESP32S2
            help
                Select Camera Pinout.

            config CAMERA_MODULE_ESP_S2_KALUGA
                bool "ESP32-S2-Kaluga-1 V1.3"
            config CAMERA_MODULE_ESP_S3_EYE
                bool "ESP-S3-EYE DevKit"
            config CAMERA_MODULE_ESP_S3_KORVO2
                bool "ESP-S3-Korvo-2"
            config CAMERA_MODULE_CUSTOM
                bool "Custom Camera Pinout"
        endchoice

        config CAMERA_PIN_PWDN
            depends on CAMERA_MODULE_CUSTOM
            int "Power Down pin"
            range -1 33
            default -1
            help
                Select Power Down pin or -1 for unmanaged.

        config CAMERA_PIN_RESET
            depends on CAMERA_MODULE_CUSTOM
            int "Reset pin"
            range -1 33
            default -1
            help
                Select Camera Reset pin or -1 for software reset.

        config CAMERA_PIN_XCLK
            depends on CAMERA_MODULE_CUSTOM
            int "XCLK pin"
            range 0 33
            default 21
            help
                Select Camera XCLK pin.

        config CAMERA_PIN_SIOD
            depends on CAMERA_MODULE_CUSTOM
            int "SIOD pin"
            range 0 33
            default 26
            help
                Select Camera SIOD pin.

        config CAMERA_PIN_SIOC
            depends on CAMERA_MODULE_CUSTOM
            int "SIOC pin"
            range 0 33
            default 27
            help
                Select Camera SIOC pin.

        config CAMERA_PIN_VSYNC
            depends on CAMERA_MODULE_CUSTOM
            int "VSYNC pin"
            range 0 39
            default 25
            help
                Select Camera VSYNC pin.

        config CAMERA_PIN_HREF
            depends on CAMERA_MODULE_CUSTOM
            int "HREF pin"
            range 0 39
            default 23
            help
                Select Camera HREF pin.

        config CAMERA_PIN_PCLK
            depends on CAMERA_MODULE_CUSTOM
            int "PCLK pin"
            range 0 39
            default 25
            help
                Select Camera PCLK pin.

        config CAMERA_PIN_Y2
            depends on CAMERA_MODULE_CUSTOM
            int "Y2 pin"
            range 0 39
            default 4
            help
                Select Camera Y2 pin.

        config CAMERA_PIN_Y3
            depends on CAMERA_MODULE_CUSTOM
            int "Y3 pin"
            range 0 39
            default 5
            help
                Select Camera Y3 pin.

        config CAMERA_PIN_Y4
            depends on CAMERA_MODULE_CUSTOM
            int "Y4 pin"
            range 0 39
            default 18
            help
                Select Camera Y4 pin.

        config CAMERA_PIN_Y5
            depends on CAMERA_MODULE_CUSTOM
            int "Y5 pin"
            range 0 39
            default 19
            help
                Select Camera Y5 pin.

        config CAMERA_PIN_Y6
            depends on CAMERA_MODULE_CUSTOM
            int "Y6 pin"
            range 0 39
            default 36
            help
                Select Camera Y6 pin.

        config CAMERA_PIN_Y7
            depends on CAMERA_MODULE_CUSTOM
            int "Y7 pin"
            range 0 39
            default 39
            help
                Select Camera Y7 pin.

        config CAMERA_PIN_Y8
            depends on CAMERA_MODULE_CUSTOM
            int "Y8 pin"
            range 0 39
            default 34
            help
                Select Camera Y8 pin.

        config CAMERA_PIN_Y9
            depends on CAMERA_MODULE_CUSTOM
            int "Y9 pin"
            range 0 39
            default 35
            help
                Select Camera Y9 pin.
    endmenu
endmenu
```

## examples/usb/host/usb_camera_lcd_display/main/Kconfig.projbuild
```kconfig
menu "USB Camera Demo"

    config USE_PSRAM
        bool "Use Psram As Picture Buffer"
        default n

    choice DEVELOP_BOARD
        prompt "Develop Board"
        default BOARD_KALUGA_1

        config BOARD_KALUGA_1
            bool "esp32-s2 kaluga with st7789"

        config BOARD_EXPERIMENT
            bool "experiment board with ili9341"
        config BOARD_EXPERIMENT_S3
            bool "experiment board S3 with st7789"
    endchoice

    choice PIC_SIZE
        prompt "Picture Size"
        default SIZE_320_240

        config SIZE_320_240
            bool "320*240"
        config SIZE_160_120
            bool "160*120"
    endchoice

    config LCD_BUF_WIDTH
        int "LCD buffer width"
        default 320 if SIZE_320_240
        default 160 if SIZE_160_120

    config LCD_BUF_HIGHT
        int "LCD buffer height"
        default 48 if SIZE_320_240
        default 120 if SIZE_160_120

    config BOOT_ANIMATION
        depends on SIZE_320_240
        bool "enable boot animation"
        default n

endmenu
```

## examples/usb/host/usb_camera_lcd_display/sdkconfig.defaults
```kconfig
#
# ESP System Settings
#
CONFIG_ESP_DEFAULT_CPU_FREQ_MHZ_240=y
CONFIG_PARTITION_TABLE_OFFSET=0x9000
CONFIG_PARTITION_TABLE_CUSTOM=y
CONFIG_FREERTOS_HZ=1000
CONFIG_COMPILER_OPTIMIZATION_PERF=y

CONFIG_SPIRAM=y
CONFIG_SPIRAM_MODE_OCT=y
CONFIG_SPIRAM_SPEED_80M=y
CONFIG_SPIRAM_FETCH_INSTRUCTIONS=y
CONFIG_SPIRAM_RODATA=y

CONFIG_ESPTOOLPY_FLASHMODE_QIO=y
CONFIG_ESPTOOLPY_FLASHFREQ_80M=y

CONFIG_BSP_LCD_DPI_BUFFER_NUMS=2
CONFIG_BSP_LCD_RGB_BUFFER_NUMS=2
CONFIG_BSP_LCD_RGB_BOUNCE_BUFFER_MODE=y

CONFIG_USB_HOST_CONTROL_TRANSFER_MAX_SIZE=4096
CONFIG_USB_HOST_HW_BUFFER_BIAS_IN=y
CONFIG_USB_HOST_HUBS_SUPPORTED=y

CONFIG_UVC_CHECK_PAYLOAD_HEADER_EOH=n
```

## examples/usb/host/usb_camera_mic_spk/components/xfer_http/Kconfig
```kconfig
menu "HTTP Transfer Settings"
    config ESP_WIFI_SSID
        string "WiFi STA SSID"
        default ""
        help
        WiFi SSID (network name) to connect to or empty for Off.

    config ESP_WIFI_PASSWORD
        string "WiFi STA Password"
        default ""
        help
        WiFi Password if WEP/WPA/WPA2 or empty if Open.

    config ESP_WIFI_AP_SSID
        string "WiFi AP SSID"
        default "ESP32S3-UVC"
        help
        AP SSID (network name) to create or empty for Off.

    config ESP_WIFI_AP_PASSWORD
        string "WiFi AP Password"
        default ""
        help
        AP password for WPA2 or empty for Open.

    config MAX_STA_CONN
        int "Maximal STA connections"
        default 1
        help
        Max number of the STA connects to AP.

    config ESP_WIFI_AP_CHANNEL
        string "WiFi AP Channel"
        default ""
        help
        AP channel for better connection performance.

    config SERVER_IP
        string "WiFi AP IP Address"
        default "192.168.4.1"
        help
            IP address that the ESP will assign to it's AP interface. You can use this IP to connect to the camera after flashing.

    config ESP_MAXIMUM_RETRY
        int "Maximum retry"
        default 5
        help
        Set the Maximum retry to avoid station reconnecting to the AP unlimited when the AP is really inexistent.
endmenu
```

## examples/usb/host/usb_camera_mic_spk/main/Kconfig.projbuild
```kconfig
menu "Example Configuration"

    choice DEVELOPMENT_BOARD_SELECTION
        prompt "Select the development board you are using"
        default BOARD_GENERIC
        help
            Select this option to choose the board for this example.

        config ESP32_S3_USB_OTG
            bool "ESP32 S3 USB OTG"

        config BOARD_GENERIC
            bool "BOARD GENERIC"

    endchoice

    menu "WiFi Settings"
        config ESP_WIFI_SOFTAP_SSID
            string "WiFi SoftAP SSID"
            default "usb-uac-demo"
            help
                SoftAP SSID created by this example.

        config ESP_WIFI_SOFTAP_PASSWORD
            string "WiFi SoftAP Password"
            default ""
            help
                SoftAP password. Leave empty to use an open network.

        config ESP_WIFI_SOFTAP_MAX_STA
            int "Maximal STA connections"
            default 4
            range 1 10
            help
                Maximum number of stations that can connect to the SoftAP.

        config ESP_WIFI_AP_CHANNEL
            int "WiFi SoftAP Channel"
            default 1
            range 1 13
            help
                SoftAP Wi-Fi channel.
    endmenu

endmenu
```

## examples/usb/host/usb_camera_sd_card/main/Kconfig.projbuild
```kconfig
menu "USB Camera Demo"

    config USE_PSRAM
        bool "Use Psram As Picture Buffer"
        default n

    choice PIC_SIZE
        prompt "Picture Size"
        default SIZE_320_240

        config SIZE_320_240
            bool "320*240"
        config SIZE_160_120
            bool "160*120"
    endchoice

endmenu
```

## examples/usb/host/usb_camera_wifi_transfer/main/Kconfig.projbuild
```kconfig
menu "USB Camera Demo"

    config USE_PSRAM
        bool "Use Psram As Picture Buffer"
        default y

    choice PIC_SIZE
        prompt "Picture Size"
        default SIZE_320_240

        config SIZE_320_240
            bool "320*240"
        config SIZE_640_480
            bool "640*480"
    endchoice

endmenu
```
