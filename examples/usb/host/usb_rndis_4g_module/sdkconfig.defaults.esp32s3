## examples/weaver/imu_gesture/main/Kconfig.projbuild
```kconfig
menu "Example Configuration"

    config EXAMPLE_NODE_NAME
        string "Node name"
        default "ESP Weaver Device"
        help
            Name of the Weaver node, used for device identification.

    config EXAMPLE_NODE_TYPE
        string "Node type"
        default "IMU Gesture"
        help
            Type of the Weaver node (e.g. Lightbulb, Sensor, Switch).

    config EXAMPLE_DEVICE_NAME
        string "Device display name"
        default "IMU Gesture"
        help
            Display name advertised via mDNS TXT record for local discovery.

    choice BOARD_SELECTION
        prompt "Select Development Board"
        default BOARD_ESP_SPOT_C5 if IDF_TARGET_ESP32C5
        default BOARD_ESP_SPOT_S3 if IDF_TARGET_ESP32S3
        default BOARD_CUSTOM
        help
            Select the development board you are using.

        config BOARD_ESP_SPOT_C5
            depends on IDF_TARGET_ESP32C5
            bool "ESP SPOT C5"
        config BOARD_ESP_SPOT_S3
            depends on IDF_TARGET_ESP32S3
            bool "ESP SPOT S3"
        config BOARD_ESP_ASTOM_S3
            depends on IDF_TARGET_ESP32S3
            bool "ESP ASTOM S3"
        config BOARD_ESP_ECHOEAR_S3
            depends on IDF_TARGET_ESP32S3
            bool "ESP ECHOEAR S3"
        config BOARD_CUSTOM
            bool "Other Boards"
    endchoice

    menu "Custom Board Configuration"
        depends on BOARD_CUSTOM
        help
            Configure GPIO pins and I2C settings for custom board.

        config I2C_INT_IO
            int "Interrupt GPIO Num"
            default 21
            range 0 48
            help
                GPIO number for interrupt line.

        config I2C_MASTER_SCL_IO
            int "SCL GPIO Num"
            default 1
            range 0 48
            help
                GPIO number for I2C Master clock line.

        config I2C_MASTER_SDA_IO
            int "SDA GPIO Num"
            default 2
            range 0 48
            help
                GPIO number for I2C Master data line.

        config I2C_USE_SOFTWARE
            bool "Use Software I2C"
            default n
            help
                Enable software I2C implementation instead of hardware I2C.

    endmenu

endmenu
```

## examples/weaver/led_light/main/Kconfig.projbuild
```kconfig
menu "Example Configuration"

    config EXAMPLE_NODE_NAME
        string "Node name"
        default "ESP Weaver Device"
        help
            Name of the Weaver node, used for device identification.

    config EXAMPLE_NODE_TYPE
        string "Node type"
        default "Lightbulb"
        help
            Type of the Weaver node (e.g. Lightbulb, Sensor, Switch).

    config EXAMPLE_DEVICE_NAME
        string "Device display name"
        default "Light"
        help
            Display name advertised via mDNS TXT record for local discovery.

    config EXAMPLE_BOARD_BUTTON_GPIO
        int "Boot Button GPIO"
        default 28 if IDF_TARGET_ESP32C5
        default 9 if IDF_TARGET_ESP32C3 || IDF_TARGET_ESP32C6 || IDF_TARGET_ESP32C2 || IDF_TARGET_ESP32C61
        default 0
        help
            GPIO number on which the "Boot" button is connected. This is generally used
            by the application for custom operations like toggling states, resetting to defaults, etc.

    choice LED_TYPE
        prompt "LED Type"
        default LED_TYPE_RGB if IDF_TARGET_ESP32 || IDF_TARGET_ESP32C2
        default LED_TYPE_WS2812
        help
            Select the type of LED to use.
            - ESP32 DevKit: No built-in LED, use external 3-pin RGB LED module
            - ESP8684-DevKitM-1 (ESP32-C2): Built-in 3-pin RGB LED (not WS2812)
            - Other DevKits (S3, C3, C6, C61, etc.): Built-in WS2812 addressable LED

        config LED_TYPE_RGB
            bool "RGB LED (3-pin RGB LED)"
            help
                Use a 3-pin RGB LED with separate GPIO pins for red, green, and blue.

        config LED_TYPE_WS2812
            bool "WS2812 LED Strip"
            help
                Use WS2812 addressable LED strip.

        config LED_TYPE_NONE
            bool "No LED"
            help
                Disable LED hardware. Useful for testing without LED hardware connected.
    endchoice

    config RGB_LED_RED_GPIO
        int "RGB LED Red GPIO"
        default 25 if IDF_TARGET_ESP32
        default 0
        depends on LED_TYPE_RGB
        help
            GPIO number for the red channel of the RGB LED.
            ESP32 DevKit has no built-in RGB LED. Default pins (25, 26, 27)
            are for external 3-pin RGB LED module (active high/common cathode).

    config RGB_LED_GREEN_GPIO
        int "RGB LED Green GPIO"
        default 26 if IDF_TARGET_ESP32
        default 1
        depends on LED_TYPE_RGB
        help
            GPIO number for the green channel of the RGB LED.

    config RGB_LED_BLUE_GPIO
        int "RGB LED Blue GPIO"
        default 27 if IDF_TARGET_ESP32
        default 8
        depends on LED_TYPE_RGB
        help
            GPIO number for the blue channel of the RGB LED.

    config RGB_LED_ACTIVE_LEVEL_HIGH
        bool "RGB LED Active Level High"
        default y if IDF_TARGET_ESP32
        default n
        depends on LED_TYPE_RGB
        help
            Set to y if the RGB LED is active high (common cathode), n if active low (common anode).
            ESP32 defaults to active high for external common cathode RGB LED module.

    config WS2812_LED_GPIO
        int "WS2812 LED GPIO"
        default 27 if IDF_TARGET_ESP32C5
        default 8 if IDF_TARGET_ESP32C61 || IDF_TARGET_ESP32C2 || IDF_TARGET_ESP32C3 || IDF_TARGET_ESP32C6
        default 38 if IDF_TARGET_ESP32S3
        default 18
        depends on LED_TYPE_WS2812
        help
            GPIO number for the WS2812 RGB LED strip.
            Default values are based on official DevKit boards:
            - ESP32-S3: GPIO38
            - ESP32-C2/C3/C6/C61: GPIO8
            - ESP32-C5: GPIO27
            - Others: GPIO18

    config WS2812_LED_COUNT
        int "Number of WS2812 LEDs"
        default 1
        range 1 256
        depends on LED_TYPE_WS2812
        help
            Number of LEDs in the WS2812 strip.

endmenu
```

## examples/zero_cross_detection/main/Kconfig.projbuild
```kconfig
menu "Example Configuration"

    orsource "$IDF_PATH/examples/common_components/env_caps/$IDF_TARGET/Kconfig.env_caps"

    config ZERO_DETECT_INPUT_GPIO
        int "ZERO CROSS DETCETION INPUT GPIO"
        range 0 48
        default 2
        help
            "ZERO CROSS DETCETION INPUT GPIO"

    config ZERO_DETECT_OUTPUT_GPIO
        int "ZERO CROSS DETCETION OUTPUT GPIO"
        range 0 48
        default 5
        help
            "ZERO CROSS DETCETION INPUT GPIO"

    choice ZERO_DETECT_SIGNAL_TYPE
        prompt "SIGNAL TYPE"
        default SQUARE_WAVE
        help
            ZERO DETECT SIGNAL TYPE

        config SQUARE_WAVE
            bool "SQUARE WAVE"
        config PULSE_WAVE
            bool "PULSE WAVE"
    endchoice

    config ZERO_DETECT_SIGNAL_TYPE
        int
        default 0 if SQUARE_WAVE
        default 1 if PULSE_WAVE
        default 0

endmenu
```
