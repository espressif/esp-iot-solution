## examples/usb/host/usb_rndis_4g_module/sdkconfig.defaults.esp32s3
```kconfig
#
# ESP32S3-Specific
#
CONFIG_ESP32S3_DEFAULT_CPU_FREQ_240=y
CONFIG_ESP32S3_DEFAULT_CPU_FREQ_MHZ=240

CONFIG_USBH_TASK_CORE_ID=1
CONFIG_ESP32S3_INSTRUCTION_CACHE_32KB=y
CONFIG_USBH_CDC_CONTROL_TRANSFER_BUFFER_SIZE=512
```

## examples/usb/otg/usb_host_device_mode_manual_switch/main/Kconfig.projbuild
```kconfig
menu "Example Configuration"

    config TUSB_VID
        hex "USB Device VID"
        default 0x303A
    config TUSB_PID
        hex "USB Device PID"
        default 0x5678
    config TUSB_MANUFACTURER
        string "USB Device Manufacture"
        default "Espressif"
    config TUSB_PRODUCT
        string "Product Name"
        default "CDC ACM"

    choice TINYUSB_RHPORT
        depends on IDF_TARGET_ESP32P4
        prompt "TinyUSB PHY"
        default TINYUSB_RHPORT_HS
        help
            Allows set the USB PHY Controller for TinyUSB: HS (USB OTG2.0 PHY for HighSpeed)

        config TINYUSB_RHPORT_HS
            bool "HS"
    endchoice

endmenu
```

## examples/usb/usb_camera_sd_card/sdkconfig.defaults
```kconfig
#
# FreeRTOS
#
CONFIG_FREERTOS_SUPPORT_STATIC_ALLOCATION=y
CONFIG_FREERTOS_TIMER_TASK_STACK_DEPTH=4096
CONFIG_FREERTOS_USE_TRACE_FACILITY=y
CONFIG_FREERTOS_GENERATE_RUN_TIME_STATS=y
CONFIG_FREERTOS_RUN_TIME_STATS_USING_ESP_TIMER=y

#
# Compiler options
#
# CONFIG_COMPILER_OPTIMIZATION_DEFAULT is not set
# CONFIG_COMPILER_OPTIMIZATION_SIZE is not set
CONFIG_COMPILER_OPTIMIZATION_PERF=y
# CONFIG_COMPILER_OPTIMIZATION_NONE is not set
CONFIG_COMPILER_OPTIMIZATION_ASSERTIONS_ENABLE=y
# CONFIG_COMPILER_OPTIMIZATION_ASSERTIONS_SILENT is not set
# CONFIG_COMPILER_OPTIMIZATION_ASSERTIONS_DISABLE is not set
# CONFIG_COMPILER_CXX_EXCEPTIONS is not set
# CONFIG_COMPILER_CXX_RTTI is not set
CONFIG_COMPILER_STACK_CHECK_MODE_NONE=y
# CONFIG_COMPILER_STACK_CHECK_MODE_NORM is not set
# CONFIG_COMPILER_STACK_CHECK_MODE_STRONG is not set
# CONFIG_COMPILER_STACK_CHECK_MODE_ALL is not set
# CONFIG_COMPILER_WARN_WRITE_STRINGS is not set
# CONFIG_COMPILER_DISABLE_GCC8_WARNINGS is not set
# CONFIG_COMPILER_DUMP_RTL_FILES is not set
# end of Compiler options

#
# Serial flasher config
#
CONFIG_ESPTOOLPY_BAUD_OTHER_VAL=115200
# CONFIG_ESPTOOLPY_NO_STUB is not set
CONFIG_ESPTOOLPY_FLASHMODE_QIO=y
# CONFIG_ESPTOOLPY_FLASHMODE_QOUT is not set
# CONFIG_ESPTOOLPY_FLASHMODE_DIO is not set
# CONFIG_ESPTOOLPY_FLASHMODE_DOUT is not set
CONFIG_ESPTOOLPY_FLASHMODE="dio"
CONFIG_ESPTOOLPY_FLASHFREQ_80M=y
# CONFIG_ESPTOOLPY_FLASHFREQ_40M is not set
# CONFIG_ESPTOOLPY_FLASHFREQ_26M is not set
# CONFIG_ESPTOOLPY_FLASHFREQ_20M is not set
CONFIG_ESPTOOLPY_FLASHFREQ="80m"
# CONFIG_ESPTOOLPY_FLASHSIZE_1MB is not set
# CONFIG_ESPTOOLPY_FLASHSIZE_2MB is not set
CONFIG_ESPTOOLPY_FLASHSIZE_4MB=y
# CONFIG_ESPTOOLPY_FLASHSIZE_8MB is not set
# CONFIG_ESPTOOLPY_FLASHSIZE_16MB is not set
CONFIG_ESPTOOLPY_FLASHSIZE="4MB"
CONFIG_ESPTOOLPY_FLASHSIZE_DETECT=y
CONFIG_ESPTOOLPY_BEFORE_RESET=y
# CONFIG_ESPTOOLPY_BEFORE_NORESET is not set
CONFIG_ESPTOOLPY_BEFORE="default_reset"
CONFIG_ESPTOOLPY_AFTER_RESET=y
# CONFIG_ESPTOOLPY_AFTER_NORESET is not set
CONFIG_ESPTOOLPY_AFTER="hard_reset"
# CONFIG_ESPTOOLPY_MONITOR_BAUD_CONSOLE is not set
# CONFIG_ESPTOOLPY_MONITOR_BAUD_9600B is not set
# CONFIG_ESPTOOLPY_MONITOR_BAUD_57600B is not set
CONFIG_ESPTOOLPY_MONITOR_BAUD_115200B=y
# CONFIG_ESPTOOLPY_MONITOR_BAUD_230400B is not set
# CONFIG_ESPTOOLPY_MONITOR_BAUD_921600B is not set
# CONFIG_ESPTOOLPY_MONITOR_BAUD_2MB is not set
# CONFIG_ESPTOOLPY_MONITOR_BAUD_OTHER is not set
CONFIG_ESPTOOLPY_MONITOR_BAUD_OTHER_VAL=115200
CONFIG_ESPTOOLPY_MONITOR_BAUD=115200
# end of Serial flasher config

#
# ESP32S2-specific
#
# CONFIG_ESP32S2_DEFAULT_CPU_FREQ_80 is not set
# CONFIG_ESP32S2_DEFAULT_CPU_FREQ_160 is not set
CONFIG_ESP32S2_DEFAULT_CPU_FREQ_240=y
CONFIG_ESP32S2_DEFAULT_CPU_FREQ_MHZ=240

#
# Task watch dog
#
CONFIG_TASK_WDT=y
CONFIG_TASK_WDT_TIMEOUT_S=15
CONFIG_TASK_WDT_CHECK_IDLE_TASK_CPU0=y
```

## examples/usb/usb_cdc_4g_module/main/Kconfig.projbuild
```kconfig
menu "4G Modem Configuration"

    menu "gpio config"

        config LED_RED_SYSTEM_GPIO
            int "System status led (red) gpio"
            default 15
        config LED_BLUE_WIFI_GPIO
            int "Wi-Fi status led (blue) gpio"
            default 17
        config LED_GREEN_4GMODEM_GPIO
            int "Modem status led (green) gpio"
            default 16
        config MODEM_POWER_GPIO
            int "Modem power control gpio"
            default 12
        config MODEM_RESET_GPIO
            int "Modem reset control gpio"
            default 13
    endmenu

    menu "WiFi soft AP"

        config EXAMPLE_WIFI_SSID
            string "WiFi SSID"
            default "esp_4g_router"
            help
                SSID (network name) for the example to connect to.

        config EXAMPLE_WIFI_PASSWORD
            string "WiFi Password"
            default "12345678"
            help
                WiFi password (WPA or WPA2) for the example to use.
        config EXAMPLE_WIFI_CHANNEL
            int "WiFi Channel"
            range 1 13
            default 13
            help
                WiFi channel (network channel) for the example to use.

        config EXAMPLE_MAX_STA_CONN
            int "Maximal STA connections"
            default 5
            help
                Max number of the STA connects to AP.
    endmenu

    config MODEM_DIAL_RERTY_TIMES
        int "Retry times during dial"
        default 5
        help 
            Set retry times waitting for modem link with carrier base station

    config DUMP_SYSTEM_STATUS
        bool "Dump system task status"
        default n
        help
            Dump system task status, stack left, cpu load, etc.

    config EXAMPLE_MODEM_PPP_APN
        string "Set Modem APN"
        default "internet"
        help
            Set APN (Access Point Name), a logical name to choose data network 

endmenu
```

## examples/usb/usb_cdc_4g_module/sdkconfig.defaults
```kconfig
# Override some defaults to enable PPP
CONFIG_LWIP_PPP_SUPPORT=y
CONFIG_LWIP_PPP_PAP_SUPPORT=y
CONFIG_LWIP_TCPIP_TASK_STACK_SIZE=4096
# Do not enable IPV6 in dte<->dce link local
CONFIG_LWIP_PPP_ENABLE_IPV6=n
# Disable legacy API
CONFIG_MODEM_LEGACY_API=n
# Enable NAPT
CONFIG_LWIP_IP_FORWARD=y
CONFIG_LWIP_IPV4_NAPT=y

CONFIG_FREERTOS_HZ=1000

CONFIG_ESP_INT_WDT=n
CONFIG_ESP_TASK_WDT=n

CONFIG_LWIP_TCP_SND_BUF_DEFAULT=65534
CONFIG_LWIP_TCP_WND_DEFAULT=65534
CONFIG_LWIP_TCP_RECVMBOX_SIZE=64
CONFIG_LWIP_UDP_RECVMBOX_SIZE=64
CONFIG_LWIP_TCPIP_RECVMBOX_SIZE=64
CONFIG_LWIP_IRAM_OPTIMIZATION=y

#
# ESP32S2-specific
#
CONFIG_ESP32_WIFI_STATIC_RX_BUFFER_NUM=16
CONFIG_ESP32_WIFI_DYNAMIC_RX_BUFFER_NUM=64
CONFIG_ESP32_WIFI_DYNAMIC_TX_BUFFER_NUM=64
CONFIG_ESP32_WIFI_AMPDU_TX_ENABLED=y
CONFIG_ESP32_WIFI_TX_BA_WIN=32
CONFIG_ESP32_WIFI_AMPDU_RX_ENABLED=y
CONFIG_ESP32_WIFI_RX_BA_WIN=32

CONFIG_ESP32S2_DEFAULT_CPU_FREQ_240=y
CONFIG_ESP32S2_DEFAULT_CPU_FREQ_MHZ=240

CONFIG_ESPTOOLPY_FLASHMODE_QIO=y
CONFIG_ESPTOOLPY_FLASHFREQ_80M=y

CONFIG_ESP32S2_INSTRUCTION_CACHE_16KB=y
CONFIG_ESP32S2_INSTRUCTION_CACHE_LINE_16B=y
CONFIG_ESP32S2_INSTRUCTION_CACHE_WRAP=y

#
# Serial flasher config
#
CONFIG_ESPTOOLPY_BAUD_OTHER_VAL=115200
# CONFIG_ESPTOOLPY_NO_STUB is not set
CONFIG_ESPTOOLPY_FLASHMODE_QIO=y
# CONFIG_ESPTOOLPY_FLASHMODE_QOUT is not set
# CONFIG_ESPTOOLPY_FLASHMODE_DIO is not set
# CONFIG_ESPTOOLPY_FLASHMODE_DOUT is not set
CONFIG_ESPTOOLPY_FLASHMODE="dio"
CONFIG_ESPTOOLPY_FLASHFREQ_80M=y
# CONFIG_ESPTOOLPY_FLASHFREQ_40M is not set
# CONFIG_ESPTOOLPY_FLASHFREQ_26M is not set
# CONFIG_ESPTOOLPY_FLASHFREQ_20M is not set
CONFIG_ESPTOOLPY_FLASHFREQ="80m"
# CONFIG_ESPTOOLPY_FLASHSIZE_1MB is not set
# CONFIG_ESPTOOLPY_FLASHSIZE_2MB is not set
CONFIG_ESPTOOLPY_FLASHSIZE_4MB=y
# CONFIG_ESPTOOLPY_FLASHSIZE_8MB is not set
# CONFIG_ESPTOOLPY_FLASHSIZE_16MB is not set
CONFIG_ESPTOOLPY_FLASHSIZE="4MB"
CONFIG_ESPTOOLPY_FLASHSIZE_DETECT=y

CONFIG_FREERTOS_USE_TRACE_FACILITY=y
CONFIG_FREERTOS_GENERATE_RUN_TIME_STATS=y
CONFIG_FREERTOS_RUN_TIME_STATS_USING_ESP_TIMER=y

CONFIG_CDC_SYNC_WITH_AT=y
```

## examples/usb/usb_uart_bridge/sdkconfig.defaults
```kconfig
#
# TinyUSB
#
CONFIG_TINYUSB=y
CONFIG_TINYUSB_CDC_ENABLED=y
CONFIG_TINYUSB_CDC_RX_BUFSIZE=2048
CONFIG_TINYUSB_CDC_TX_BUFSIZE=2048

#
# Board Options
#
CONFIG_BOARD_ESP32S3_USB_OTG_EV=y
CONFIG_BOARD_SPI2_INIT=n
CONFIG_BOARD_SPI3_INIT=n
CONFIG_BOARD_I2C0_INIT=n
```

## examples/utilities/adc_tp_calibration/main/Kconfig.projbuild
```kconfig
menu "Example Configuration"

    menu "ESP32 ADC Configuration"
        depends on IDF_TARGET_ESP32
        config ADC1_CHANNEL
            int "ADC1 Channel Number"
            range 0 7
            default 6
            help
                ADC1 channel number (0-7).

        config ADC2_CHANNEL
            int "ADC2 Channel Number"
            range 0 9
            default 9
            help
                ADC1 channel number (0-9).
    endmenu

    menu "ESP32S2 ADC Configuration"
        depends on IDF_TARGET_ESP32S2
        config ADC1_CHANNEL
            int "ADC1 Channel Number"
            range 0 9
            default 6
            help
                ADC1 channel number (0-9).

        config ADC2_CHANNEL
            int "ADC2 Channel Number"
            range 0 9
            default 9
            help
                ADC1 channel number (0-9).
    endmenu

    config ADC_READ_TIMES
        int "Number of times to read ADC"
        range 20 100
        default 50
        help
            Number of times to read ADC for each voltage level.

    config ADC_ERROR_TOLERANCE_RANGE
        int "ADC Error Tolerance Range (mV)"
        range 1 30
        default 30
        help
            The error tolerance range for ADC readings.

endmenu
```

## examples/vision/opencv/color_tracker/main/Kconfig.projbuild
```kconfig
menu "Example Configuration"

    config EXAMPLE_ENABLE_MIPI_CSI_CAM_SENSOR
        bool "Enable MIPI CSI Camera Sensor"
        default y
        depends on SOC_MIPI_CSI_SUPPORTED

    if EXAMPLE_ENABLE_MIPI_CSI_CAM_SENSOR
        config EXAMPLE_MIPI_CSI_SCCB_I2C_PORT
            int "MIPI CSI SCCB I2C Port Number"
            default 0
            range 0 1

        config EXAMPLE_MIPI_CSI_SCCB_I2C_SCL_PIN
            int "MIPI CSI SCCB I2C SCL Pin"
            default 34
            range -1 56

        config EXAMPLE_MIPI_CSI_SCCB_I2C_SDA_PIN
            int "MIPI CSI SCCB I2C SDA Pin"
            default 31
            range -1 56

        config EXAMPLE_MIPI_CSI_SCCB_I2C_FREQ
            int "MIPI CSI SCCB I2C Frequency"
            default 100000
            range 100000 400000
            help
                Increasing this value can reduce the initialization time of the camera sensor.
                Please refer to the relevant instructions of the camera sensor to adjust the value.

        config EXAMPLE_MIPI_CSI_CAM_SENSOR_RESET_PIN
            int "MIPI CSI Camera Sensor Reset Pin"
            default -1
            range -1 56

        config EXAMPLE_MIPI_CSI_CAM_SENSOR_PWDN_PIN
            int "MIPI CSI Camera Sensor Power Down Pin"
            default -1
            range -1 56
    endif

    config EXAMPLE_CV_CONTOUR_FILTER_AREA_THRESHOLD
        int "Contour Filtering Area Threshold"
        default 5000
        help
            Contours with an area smaller than this value will be filtered out.
            Helps remove noise and small irrelevant shapes during image processing.

    config EXAMPLE_LCD_BUF_COUNT
        int "LCD Buffer Count"
        default 2
        range 2 3

    menu "Primary Color Range"
        config PRIMARY_COLOR_LOWER_H
            int "Primary Lower H (Hue)"
            range 0 255
            default 0
            help
                Specifies the minimum hue value for the primary color range.

        config PRIMARY_COLOR_LOWER_S
            int "Primary Lower S (Saturation)"
            range 0 255
            default 120
            help
                Specifies the minimum saturation value for the primary color range.

        config PRIMARY_COLOR_LOWER_V
            int "Primary Lower V (Value)"
            range 0 255
            default 70
            help
                Specifies the minimum value for the primary color range.

        config PRIMARY_COLOR_UPPER_H
            int "Primary Upper H (Hue)"
            range 0 255
            default 10
            help
                Specifies the maximum hue value for the primary color range.

        config PRIMARY_COLOR_UPPER_S
            int "Primary Upper S (Saturation)"
            range 0 255
            default 255
            help
                Specifies the maximum saturation value for the primary color range.

        config PRIMARY_COLOR_UPPER_V
            int "Primary Upper V (Value)"
            range 0 255
            default 255
            help
                Specifies the maximum value for the primary color range.
    endmenu

    menu "Secondary Color Range"
        config SECONDARY_COLOR_LOWER_H
            int "Secondary Lower H (Hue)"
            range 0 255
            default 170
            help
                Specifies the minimum hue value for the secondary color range.

        config SECONDARY_COLOR_LOWER_S
            int "Secondary Lower S (Saturation)"
            range 0 255
            default 120
            help
                Specifies the minimum saturation value for the secondary color range.

        config SECONDARY_COLOR_LOWER_V
            int "Secondary Lower V (Value)"
            range 0 255
            default 70
            help
                Specifies the minimum value for the secondary color range.

        config SECONDARY_COLOR_UPPER_H
            int "Secondary Upper H (Hue)"
            range 0 255
            default 180
            help
                Specifies the maximum hue value for the secondary color range.

        config SECONDARY_COLOR_UPPER_S
            int "Secondary Upper S (Saturation)"
            range 0 255
            default 255
            help
                Specifies the maximum saturation value for the secondary color range.

        config SECONDARY_COLOR_UPPER_V
            int "Secondary Upper V (Value)"
            range 0 255
            default 255
            help
                Specifies the maximum value for the secondary color range.
    endmenu
endmenu
```
