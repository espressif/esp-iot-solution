## platforms/alink_v2.0/Kconfig
```kconfig
menuconfig ALINK_V20_ENABLE
    bool "Enable alink_V2.0 function"
    default n
    help
       If the option is enabled, "alink_V20" works.

choice LOG_ALINK_LEVEL
    bool "Default log verbosity"
    default LOG_ALINK_LEVEL_INFO
    depends on ALINK_V20_ENABLE
    help
       Specify how much output to see in logs by default.
       Note that this setting limits which log statements
       are compiled into the program. So setting this to, say,
       "Warning" would mean that changing log level to "Debug"
       at runtime will not be possible.

config LOG_ALINK_LEVEL_NONE
   bool "No output"
config LOG_ALINK_LEVEL_ERROR
   bool "Error"
config LOG_ALINK_LEVEL_WARN
   bool "Warning"
config LOG_ALINK_LEVEL_INFO
   bool "Info"
config LOG_ALINK_LEVEL_DEBUG
   bool "Debug"
config LOG_ALINK_LEVEL_VERBOSE
   bool "Verbose"
endchoice

config LOG_ALINK_LEVEL
    int
    default 0 if LOG_ALINK_LEVEL_NONE
    default 1 if LOG_ALINK_LEVEL_ERROR
    default 2 if LOG_ALINK_LEVEL_WARN
    default 3 if LOG_ALINK_LEVEL_INFO
    default 4 if LOG_ALINK_LEVEL_DEBUG
    default 5 if LOG_ALINK_LEVEL_VERBOSE
    depends on ALINK_V20_ENABLE

config ALINK_PASSTHROUGH
    bool "Switch the data transmission mode to passthrough"
    default 0
    depends on ALINK_V20_ENABLE
    help
        Switch the data transmission mode to passthrough.

config ALINK_RESET_KEY_IO
	  int "Configure alink to restore the factory-set GPIO"
	  default 0
    depends on ALINK_V20_ENABLE
	  help
		    Configure alink to restore the factory-set GPIO

config WIFI_WAIT_TIME
    int "the connection router maximum latency unit is seconds"
    default 60
    depends on ALINK_V20_ENABLE
    help
        the connection router maximum latency unit is seconds

config ALINK_TASK_PRIOTY
    int "Configure the priority of all alink tasks"
    default 4
    depends on ALINK_V20_ENABLE
    help
        Configure the priority of all alink tasks
```

## platforms/joylink/Kconfig
```kconfig
menu "Joylink"

config JOYLINK_ENABLE
    bool "Enable Joylink"
    default "y"

config JOYLINK_SMNT_BUTTON_NUM
    int "the io number for one key configuration network"
    default 14
    depends on JOYLINK_ENABLE

config JOYLINK_RESET_BUTTON_NUM
    int "the io number for reset"
    default 15
    depends on JOYLINK_ENABLE
	
endmenu
```

## tools/unit-test-app/components/modem_sleep/Kconfig.projbuild
```kconfig
menu "Example Configuration"

config DEFAULT_SSID
    string "WiFi SSID"
    default "myssid"
    help
	SSID (network name) for the example to connect to.

config DEFAULT_PWD
    string "WiFi Password"
    default "mypassword"
    help
	WiFi password (WPA or WPA2) for the example to use.
endmenu
```

## tools/unit-test-app/main/Kconfig
```kconfig
menu "IoT unit-test settings"
    menu "TCP testcase"
        config AP_SSID
            string "Enter SSID of router to connect to"
            default ""
            help
                "Enter SSID of router to connect to"

        config AP_PASSWORD
            string "Enter PASSWORD of router to connect to"
            default ""
            help
                "Enter PASSWORD of router to connect to"
        config TCP_SERVER_MAX_CONNECTION
            int "Set max connection number for TCP server"
            default 10
            help
                "Set max connection number for TCP server"
        config TCP_SERVER_PORT
            int "Set listening port for TCP server"
            default 8002
            help
                "Set listening port for TCP server"
    endmenu



endmenu
```

## tools/unit-test-app/main/Kconfig.projbuild
```kconfig
menu "IoT unit-test settings"
    menu "OTA Test"
        config OTA_SERVER_IP
            string "Enter HTTP server IP or domain"
            default ""
        config OTA_SERVER_PORT
            int "Enter HTTP server port"
            default 80
        config OTA_SERVER_URI
            string "Enter OTA file path"
            default "/ota.bin"
    endmenu
    
    menu "WiFi config"
        config AP_SSID
            string "Enter SSID of router to connect to"
            default ""
            help
                "Enter SSID of router to connect to"

        config AP_PASSWORD
            string "Enter PASSWORD of router to connect to"
            default ""
            help
                "Enter PASSWORD of router to connect to"
    endmenu
    
    menu "MQTT testcase"
        config MQTT_BROKER_ADDR
            string "Enter MQTT broker address"
            default "192.168.1.1"
            help
                "Enter the address of MQTT broker"
    endmenu       

    menu "TCP testcase"
        config TCP_SERVER_MAX_CONNECTION
            int "Set max connection number for TCP server"
            default 10
            help
                "Set max connection number for TCP server"
        config TCP_SERVER_PORT
            int "Set listening port for TCP server"
            default 8002
            help
                "Set listening port for TCP server"
    endmenu

    menu "ESPNOW testcase"
        config ESPNOW_LMK
            string "Set ESPNOW LMK"
            default "lmk1234567890123"
        
    endmenu
    
    menu "TouchTFT Pin Configuration"
        config UT_LCD_MISO_GPIO
            int "UT_LCD_MISO_GPIO"
            default "25"
        config UT_LCD_MOSI_GPIO
            int "UT_LCD_MOSI_GPIO"
            default "23"
        config UT_LCD_CLK_GPIO
            int "UT_LCD_CLK_GPIO"
            default "19"
        config UT_LCD_CS_GPIO
            int "UT_LCD_CS_GPIO"
            default "22"
        config UT_LCD_DC_GPIO
            int "UT_LCD_DC_GPIO"
            default "21"
        config UT_LCD_RESET_GPIO
            int "UT_LCD_RESET_GPIO"
            default "18"
        config UT_LCD_BL_GPIO
            int "UT_LCD_BL_GPIO"
            default "5"
    endmenu

    menu "XPT2046 Pin Configuration"
        config XPT2046_CS_GPIO
            int "XPT2046_CS_GPIO"
            default "32"
        config XPT2046_IRQ_GPIO
            int "XPT2046_IRQ_GPIO"
            default "33"
    endmenu

    menu "LCD refresh test settings"
        menu "LCD Pin Configuration"
            config LCD_MISO_GPIO
                int "LCD_MISO_GPIO"
                default "27"
            config LCD_MOSI_GPIO
                int "LCD_MOSI_GPIO"
                default "21"
            config LCD_CLK_GPIO
                int "LCD_CLK_GPIO"
                default "22"
            config LCD_CS_GPIO
                int "LCD_CS_GPIO"
                default "5"
            config LCD_DC_GPIO
                int "LCD_DC_GPIO"
                default "19"
            config LCD_RESET_GPIO
                int "LCD_RESET_GPIO"
                default "18"
            config LCD_BL_GPIO
                int "LCD_BL_GPIO"
                default "23"
        endmenu

        config MAX_LCD_CLK_FREQ
            int "MAX_LCD_CLK_FREQ"
            default "32"

        config LCD_CLK_TEST_INCREASE
            int "LCD_CLK_TEST_INCREASE"
            default "10"

    endmenu

endmenu
```
