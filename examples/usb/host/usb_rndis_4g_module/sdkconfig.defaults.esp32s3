## main/Kconfig
```kconfig
menu "Iot_Solution"
        
    config DEMO_ENABLE
        bool "Enable example device"
        default y
        help
          select to enable demo codes, otherwise, disable demo codes to write customized project
            
    choice SMART_DEVICE_TYPE
        bool "Device type"
        default SMART_SOCKET_DEVICE
        #depends on DEMO_ENABLE
        help
          select the device type

    config SMART_SOCKET_DEVICE
        bool "smart socket"
    config SMART_LIGHT_DEVICE
        bool "smart light"
    endchoice
    
    menu "Smart socket"
        depends on DEMO_ENABLE && SMART_SOCKET_DEVICE
        menu "Socket parameter saving"
            config SMART_SOCKET_NAME_SPACE
                string "smart socket parameter namespace"
                default "socket"
                help
                    To set the namespace for parameters of smart socket 
                    devices
            config SMART_SOCKET_PARAM_KEY
                string "smart socket parameter key"
                default "socket_param"
                help
                    To set the key value for parameters of smart socket 
                    devices
        endmenu
                
        config SMART_SOCKET_POWER_METER_ENABLE
            bool "Power meter device"
            default y
            help 
                To enable power meter device in iot smart socket demo, 
                We only support a power meter of "V-F converter" type.
            menu "Power Meter"
                depends on SMART_SOCKET_POWER_METER_ENABLE
                config SMART_SOCKET_PM_CF_IO
                    depends on SMART_SOCKET_POWER_METER_ENABLE
                    int "Power meter GPIO number for CF pin"
                    default 25
                    help
                        To set the GPIO number for CF pin of power meter.
                config SMART_SOCKET_PM_CFI_IO
                    depends on SMART_SOCKET_POWER_METER_ENABLE
                    int "Power meter GPIO number for CFI pin"
                    default 26
                    help
                        To set the GPIO number for CF pin of power meter.
                        This pin defines the output on CF pin is current or voltage.
                config SMART_SOCKET_PM_POWER_COEF
                    depends on SMART_SOCKET_POWER_METER_ENABLE
                    int "Power-frequency coefficient for power meter"
                    default 1293699
                    help
                        To set the power-frequency coefficient for power meter.
                        Power = frequency * coefficient
                config SMART_SOCKET_PM_CURRENT_COEF
                    depends on SMART_SOCKET_POWER_METER_ENABLE
                    int "current-frequency coefficient for current value read from power meter"
                    default 13670
                    help
                        current-frequency coefficient for current value read from power meter.
                        Current = frequency * coefficient 
                config SMART_SOCKET_PM_VOLTAGE_COEF
                    depends on SMART_SOCKET_POWER_METER_ENABLE
                    int "Voltage-frequency coefficient for voltage value read from power meter"
                    default 102961
                    help
                        Voltage-frequency coefficient for voltage value read from power meter.
                        Voltage = frequency * coefficient         
            endmenu
            
        menu "Main button"
            config SMART_SOCKET_MAIN_BUTTON_IO
                int "The GPIO number to control all the units"
                range 0 39
                default 4
                help
                    The GPIO number to control all the units
            config SMART_SOCKET_MAIN_BUTTON_ACT_LEVEL
                int "The GPIO active level"
                range 0 1
                default 0
                help
                    The GPIO level when pushing the button
        endmenu
                
        menu "Network status LED"
            config SMART_SOCKET_NET_STATUS_LED_IO
                int "The GPIO of Net status LED"
                range 0 34
                default 19
                help 
                    The GPIO of Net status LED
            config SMART_SOCKET_NET_STATUS_LED_OFF_LEVEL
                int "The Network status LED 'off' level"
                range 0 1
                default 0
                help
                    The Network status LED "off" level
            
        endmenu
        
        config SMART_SOCKET_UNIT_NUM
            int "Socket unit number"
            range 1 4
            default 2
            help
                To set the number of socket unit,
                One unit has one relay controller, 
                one status LED and one button
        
        menu "Socket UNIT[0]"
            depends on  SMART_SOCKET_UNIT_NUM>0
            config SMART_SOCKET_UNIT0_BUTTON_IO
            int "UNIT[0] button IO"
            range 0 39
            default 5
            
            config SMART_SOCKET_UNIT0_BUTTON_ACTIVE_LEVEL
            int "UNIT[0] button active level"
            range 0 1
            default 0
            
            config SMART_SOCKET_UNIT0_LED_IO
            int "UNIT[0] led IO"
            range 0 34
            default 17
            
            config SMART_SOCKET_UNIT0_LED_OFF_LEVEL
            int "UNIT[0] led off level"
            range 0 1
            default 0 
            
            config SMART_SOCKET_UNIT0_RELAY_OFF_LEVEL
            int "UNIT[0] relay off level"
            range 0 1
            default 1
            
            config SMART_SOCKET_UNIT0_RELAY_CTRL_MODE
            int "UNIT[0] relay control mode"
            range 0 1
            default 1
            help
                To set teh control mode of relay
                0: D flip-flop mode
                1: Simple GPIO mode
            
            config SMART_SOCKET_UNIT0_RELAY_IO_MODE
            int "UNIT[0] relay IO mode"
            range 0 1
            default 0
            help
                To set the GPIO mode for relay
                0: Digital GPIO
                1: RTC GPIO
            
            config SMART_SOCKET_UNIT0_RELAY_CTL_IO
            int "UNIT[0] relay ctrl io"
            range 0 34
            default 12
            
            config SMART_SOCKET_UNIT0_RELAY_CLK_IO
            #depends on SMART_SOCKET_UNIT0_RELAY_CTRL_MODE
            int "UNIT[0] relay clk io(in D-flip-flop mode)"
            range -1 34
            default -1
        endmenu
        
        menu "Socket UNIT[1]"
            depends on  SMART_SOCKET_UNIT_NUM>1
            config SMART_SOCKET_UNIT1_BUTTON_IO
            int "UNIT[1] button IO"
            range 0 39
            default 2
            
            config SMART_SOCKET_UNIT1_BUTTON_ACTIVE_LEVEL
            int "UNIT[1] button active level"
            range 0 1
            default 0
            
            config SMART_SOCKET_UNIT1_LED_IO
            int "UNIT[1] led IO"
            range 0 34
            default 18
            
            config SMART_SOCKET_UNIT1_LED_OFF_LEVEL
            int "UNIT[1] led off level"
            range 0 1
            default 0 
            
            config SMART_SOCKET_UNIT1_RELAY_OFF_LEVEL
            int "UNIT[1] relay off level"
            range 0 1
            default 1
            
            config SMART_SOCKET_UNIT1_RELAY_CTRL_MODE
            int "UNIT[1] relay control mode"
            range 0 1
            default 1
            help
                To set teh control mode of relay
                0: D flip-flop mode
                1: Simple GPIO mode
            
            config SMART_SOCKET_UNIT1_RELAY_IO_MODE
            int "UNIT[1] relay IO mode"
            range 0 1
            default 0
            help
                To set the GPIO mode for relay
                0: Digital GPIO
                1: RTC GPIO
            
            config SMART_SOCKET_UNIT1_RELAY_CTL_IO
            int "UNIT[1] relay ctrl io"
            range 0 34
            default 13
            
            config SMART_SOCKET_UNIT1_RELAY_CLK_IO
            #depends on SMART_SOCKET_UNIT1_RELAY_CTRL_MODE
            int "UNIT[1] relay clk io(in D-flip-flop mode)"
            range -1 34
            default -1
        endmenu
        
        menu "Socket UNIT[2]"
            depends on  SMART_SOCKET_UNIT_NUM>2
            config SMART_SOCKET_UNIT2_BUTTON_IO
            int "UNIT[2] button IO"
            range 0 39
            default 20
            
            config SMART_SOCKET_UNIT2_BUTTON_ACTIVE_LEVEL
            int "UNIT[2] button active level"
            range 0 1
            default 0
            
            config SMART_SOCKET_UNIT2_LED_IO
            int "UNIT[2] led IO"
            range 0 34
            default 21
            
            config SMART_SOCKET_UNIT2_LED_OFF_LEVEL
            int "UNIT[2] led off level"
            range 0 1
            default 0 
            
            config SMART_SOCKET_UNIT2_RELAY_OFF_LEVEL
            int "UNIT[2] relay off level"
            range 0 1
            default 1
            
            config SMART_SOCKET_UNIT2_RELAY_CTRL_MODE
            int "UNIT[2] relay control mode"
            range 0 1
            default 1
            help
                To set teh control mode of relay
                0: D flip-flop mode
                1: Simple GPIO mode
            
            config SMART_SOCKET_UNIT2_RELAY_IO_MODE
            int "UNIT[2] relay IO mode"
            range 0 1
            default 0
            help
                To set the GPIO mode for relay
                0: Digital GPIO
                1: RTC GPIO
            
            config SMART_SOCKET_UNIT2_RELAY_CTL_IO
            int "UNIT[2] relay ctrl io"
            range 0 34
            default 22
            
            config SMART_SOCKET_UNIT2_RELAY_CLK_IO
            #depends on SMART_SOCKET_UNIT2_RELAY_CTRL_MODE
            int "UNIT[2] relay clk io(in D-flip-flop mode)"
            range -1 34
            default -1
        endmenu
        
        menu "Socket UNIT[3]"
            depends on  SMART_SOCKET_UNIT_NUM>3
            config SMART_SOCKET_UNIT3_BUTTON_IO
            int "UNIT[3] button IO"
            range 0 39
            default 23
            
            config SMART_SOCKET_UNIT3_BUTTON_ACTIVE_LEVEL
            int "UNIT[3] button active level"
            range 0 1
            default 0
            
            config SMART_SOCKET_UNIT3_LED_IO
            int "UNIT[3] led IO"
            range 0 34
            default 24
            
            config SMART_SOCKET_UNIT3_LED_OFF_LEVEL
            int "UNIT[3] led off level"
            range 0 1
            default 0 
            
            config SMART_SOCKET_UNIT3_RELAY_OFF_LEVEL
            int "UNIT[3] relay off level"
            range 0 1
            default 1
            
            config SMART_SOCKET_UNIT3_RELAY_CTRL_MODE
            int "UNIT[3] relay control mode"
            range 0 1
            default 1
            help
                To set teh control mode of relay
                0: D flip-flop mode
                1: Simple GPIO mode
            
            config SMART_SOCKET_UNIT3_RELAY_IO_MODE
            int "UNIT[3] relay IO mode"
            range 0 1
            default 0
            help
                To set the GPIO mode for relay
                0: Digital GPIO
                1: RTC GPIO
            
            config SMART_SOCKET_UNIT3_RELAY_CTL_IO
            int "UNIT[3] relay ctrl io"
            range 0 34
            default 27
            
            config SMART_SOCKET_UNIT3_RELAY_CLK_IO
            #depends on SMART_SOCKET_UNIT3_RELAY_CTRL_MODE
            int "UNIT[3] relay clk io(in D-flip-flop mode)"
            range -1 34
            default -1
        endmenu
    endmenu
    
    
    
    menu "Smart Light"
        depends on DEMO_ENABLE && SMART_LIGHT_DEVICE
        menu "Light parameter namespace"
            config SMART_LIGHT_NAME_SPACE
            string "Set light param namespace"
            default "light"
            help
                To set the namespace for light parameters
                It's fine to just use the default value.
                
            config SMART_LIGHT_PARAM_KEY
            string "Set light param key"
            default "light_param"
            help 
                To set the key value for light parameters
                It's fine to just use the default value
        endmenu
        menu "LEDC settings"
            config SMART_LIGHT_PWM_FREQ_HZ
            int "LEDC frequency"
            range 1000 5000
            default 1000
            help 
                To set the PWM frequency of light
               
            config SMART_LIGHT_PWM_BIT_NUM
            int "LEDC bit number"
            range 10 15
            default 13
            help
                To set the resolution for PWM channels
                So the duty range will 0 ~ (2 ^ bit_num) - 1
            
            config SMART_LIGHT_PWM_SPEED_MODE
            int "LEDC hw mode"
            range 0 1
            default 0
            help 
                To set the speed mode of PWM hw
                0: high-speed mode
                1: low-speed mode
                Usually we use default value(0)
            
            config SMART_LIGHT_PWM_TIMER_IDX
            int "LEDC hw timer"
            range 0 3
            default 0
            help
                To set the timer index of LEDC
                Chosen from TIME[0 - 3]
        endmenu
        
        config SMART_LIGHT_PWM_CHANNEL_NUM
        int "LEDC channel number"
        range 3 5
        default 3
        help
            To set the number of PWM channel
        
        menu "SMART LIGHT CHANNEL[0](RED)"
            depends on SMART_LIGHT_PWM_CHANNEL_NUM>0
            config SMART_LIGHT_PWM_UNIT0_LEDC_CHANNEL
            int "LEDC channel for PWM unit[0]"
            range 0 7
            default 0
            help
                To set the LEDC hw channel for PWM[0]
            config SMART_LIGHT_PWM_UNIT0_LEDC_IO
            int "GPIO number for PWM unit[0]"
            range 0 34
            default 17
            help
                To set the output GPIO number for LEDC
        endmenu
        menu "SMART LIGHT CHANNEL[1](GREEN)"
            depends on SMART_LIGHT_PWM_CHANNEL_NUM>1
            config SMART_LIGHT_PWM_UNIT1_LEDC_CHANNEL
            int "LEDC channel for PWM unit[1]"
            range 0 7
            default 1
            help
                To set the LEDC hw channel for PWM[1]
            config SMART_LIGHT_PWM_UNIT1_LEDC_IO
            int "GPIO number for PWM unit[1]"
            range 0 34
            default 18
            help
                To set the output GPIO number for LEDC
        endmenu
        menu "SMART LIGHT CHANNEL[2](BLUE)"
            depends on SMART_LIGHT_PWM_CHANNEL_NUM>2
            config SMART_LIGHT_PWM_UNIT2_LEDC_CHANNEL
            int "LEDC channel for PWM unit[2]"
            range 0 7
            default 2
            help
                To set the LEDC hw channel for PWM[2]
            config SMART_LIGHT_PWM_UNIT2_LEDC_IO
            int "GPIO number for PWM unit[2]"
            range 0 34
            default 19
            help
                To set the output GPIO number for LEDC
        endmenu
        menu "SMART LIGHT CHANNEL[3](CW)"
            depends on SMART_LIGHT_PWM_CHANNEL_NUM>3
            config SMART_LIGHT_PWM_UNIT3_LEDC_CHANNEL
            int "LEDC channel for PWM unit[3]"
            range 0 7
            default 3
            help
                To set the LEDC hw channel for PWM[3]
            config SMART_LIGHT_PWM_UNIT3_LEDC_IO
            int "GPIO number for PWM unit[3]"
            range 0 34
            default 20
            help
                To set the output GPIO number for LEDC
        endmenu        
        
        menu "SMART LIGHT CHANNEL[4](WW)"
            depends on SMART_LIGHT_PWM_CHANNEL_NUM>4
            config SMART_LIGHT_PWM_UNIT4_LEDC_CHANNEL
            int "LEDC channel for PWM unit[4]"
            range 0 7
            default 4
            help
                To set the LEDC hw channel for PWM[4]
            config SMART_LIGHT_PWM_UNIT4_LEDC_IO
            int "GPIO number for PWM unit[4]"
            range 0 34
            default 21
            help
                To set the output GPIO number for LEDC
        endmenu    
        
    endmenu
       

    choice CLOUD_TYPE
        bool "cloud type"
        default CLOUD_ALINK
        depends on DEMO_ENABLE
        help
          select the cloud type

    config CLOUD_ALINK
        bool "alink cloud"
    config CLOUD_JOYLINK
        bool "joylink cloud"
    endchoice
    
    #source "../platforms/alink_v2.0/Kconfig_alink" 
    menu "Alink"
    depends on DEMO_ENABLE && CLOUD_ALINK
    choice LOG_ALINK_LEVEL
    bool "Default log verbosity"
    default LOG_ALINK_LEVEL_INFO    
    help
       Specify how much output to see in logs by default.
       Note that this setting limits which log statements
       are compiled into the program. So setting this to, say,
       "Warning" would mean that changing log level to "Debug"
       at runtime will not be possible.
    config LOG_ALINK_LEVEL_NONE
       bool "No output"
    config LOG_ALINK_LEVEL_ERROR
       bool "Error"
    config LOG_ALINK_LEVEL_WARN
       bool "Warning"
    config LOG_ALINK_LEVEL_INFO
       bool "Info"
    config LOG_ALINK_LEVEL_DEBUG
       bool "Debug"
    config LOG_ALINK_LEVEL_VERBOSE
       bool "Verbose"
    endchoice

    config LOG_ALINK_LEVEL
        int
        default 0 if LOG_ALINK_LEVEL_NONE
        default 1 if LOG_ALINK_LEVEL_ERROR
        default 2 if LOG_ALINK_LEVEL_WARN
        default 3 if LOG_ALINK_LEVEL_INFO
        default 4 if LOG_ALINK_LEVEL_DEBUG
        default 5 if LOG_ALINK_LEVEL_VERBOSE

    config ALINK_RESET_KEY_IO
      int "Configure alink to restore the factory-set GPIO"
      default 0
      help
            Configure alink to restore the factory-set GPIO

    config WIFI_WAIT_TIME
        int "Timeout for connecting router, in seconds"
        default 60
        help
            the connection router maximum latency unit is seconds

    config ALINK_TASK_PRIOTY
        int "Configure the priority of all alink tasks"
        default 4
        help
            Configure the priority of all alink tasks
    config ALINK_PASSTHROUGH
        bool "Alink passthrough mode enable"
        default "n"
        help
            Alink passthrough mode enable, in this mode, you will 
            need a LUA script on server to parse binary data streams.
    config ALINK_MODULE_NAME
        string "Alink Module Name"
        default "ESP-WROOM-32"
        help
            Alink module name
    config ALINK_DATA_LEN
        int "Alink TCP packets buffer length"
        default 512
        help
            To set the max length for each data frame in alink
    endmenu
    
    #source "../platforms/joylink/Kconfig_joylink"
    menu "Joylink"
    depends on DEMO_ENABLE && CLOUD_JOYLINK
    config JOYLINK_SMNT_BUTTON_NUM
        int "the io number for one key configuration network"
        default 14

    config JOYLINK_RESET_BUTTON_NUM
        int "the io number for reset"
        default 15
endmenu
endmenu
```
