## examples/usb/host/usb_camera_wifi_transfer/sdkconfig.defaults
```kconfig
#
# FreeRTOS
#
CONFIG_FREERTOS_HZ=1000

#
# Compiler options
#
CONFIG_COMPILER_OPTIMIZATION_PERF=y
CONFIG_COMPILER_OPTIMIZATION_ASSERTIONS_ENABLE=y
CONFIG_COMPILER_STACK_CHECK_MODE_NONE=y

#
# ESP32S2-specific
#
CONFIG_ESP32S2_DEFAULT_CPU_FREQ_240=y
CONFIG_ESP32S2_DEFAULT_CPU_FREQ_MHZ=240
CONFIG_ESP32S2_SPIRAM_SUPPORT=y
CONFIG_SPIRAM_TYPE_AUTO=y
CONFIG_SPIRAM_SIZE=-1
# end of SPI RAM config

#
# USB Camera Demo
#
CONFIG_USE_PSRAM=y
```

## examples/usb/host/usb_camera_wifi_transfer/sdkconfig.defaults.esp32s3
```kconfig
#
# ESP32S3-Specific
#
CONFIG_ESP32S3_DEFAULT_CPU_FREQ_240=y
CONFIG_ESP32S3_DEFAULT_CPU_FREQ_MHZ=240

#
# SPI RAM config
#
CONFIG_ESP32S3_SPIRAM_SUPPORT=y
CONFIG_SPIRAM_MODE_OCT=y
# end of SPI RAM config

#
# USB Camera Demo
#
CONFIG_USE_PSRAM=y
```

## examples/usb/host/usb_cdc_4g_module/components/esp_modem/Kconfig
```kconfig
menu "ESP-MODEM"

    choice MODEM_TARGET
        prompt "Choose Modem Board"
        default MODEM_TARGET_ML302_DNLM

        config MODEM_TARGET_ML302_DNLM
            bool "ML302-DNLM/CNLM"
        config MODEM_TARGET_AIR724UG_NFM
            bool "AIR724UG-NFM"
        config MODEM_TARGET_EC600N_CNLA_N05
            bool "EC600NCNLA-N05"
        config MODEM_TARGET_EC600N_CNLC_N06
            bool "EC600NCNLC-N06"
        config MODEM_TARGET_A7600C1
            bool "A7600C1"
        config MODEM_TARGET_BG95_M3
            bool "BG95M3"
        config MODEM_TARGET_BG96_MA
            bool "BG96MA"
        config MODEM_TARGET_MC610_EU
            bool "MC610_EU"
        config MODEM_TARGET_USER
            bool "User Defined"
    endchoice

    config MODEM_TARGET_NAME
        string
        default "ML302-DNLM/CNLM" if MODEM_TARGET_ML302_DNLM
        default "AIR724UG-NFM" if MODEM_TARGET_AIR724UG_NFM
        default "EC600NCNLA-N05" if MODEM_TARGET_EC600N_CNLA_N05
        default "EC600NCNLC-N06" if MODEM_TARGET_EC600N_CNLC_N06
        default "A7600C1" if MODEM_TARGET_A7600C1
        default "BG95M3" if MODEM_TARGET_BG95_M3
        default "BG96MA" if MODEM_TARGET_BG96_MA
        default "MC610_EU" if MODEM_TARGET_MC610_EU
        default "User Defined" if MODEM_TARGET_USER

    config MODEM_SUPPORT_SECONDARY_AT_PORT
        bool "Enable Dual CDC Mode"
        depends on (MODEM_TARGET_MC610_EU || MODEM_TARGET_USER)
        default y if MODEM_TARGET_MC610_EU
        default n if MODEM_TARGET_USER

    menu "USB CDC endpoint address config"
        visible if MODEM_TARGET_USER

        config MODEM_USB_OUT_EP_ADDR
            hex "Modem USB CDC OUT endpoint address"
            default 0x01 if MODEM_TARGET_ML302_DNLM
            default 0x03 if MODEM_TARGET_AIR724UG_NFM
            default 0x0f if MODEM_TARGET_EC600N_CNLA_N05
            default 0x0a if MODEM_TARGET_EC600N_CNLC_N06
            default 0x0a if MODEM_TARGET_A7600C1
            default 0x03 if MODEM_TARGET_BG95_M3
            default 0x04 if MODEM_TARGET_BG96_MA
            default 0x07 if MODEM_TARGET_MC610_EU
            default 0x01 if MODEM_TARGET_USER
            range 0x01 0x7f
            help
                USB OUT endpoint address (eg.0x01) used for send AT/data to device

        config MODEM_USB_IN_EP_ADDR
            hex "Modem USB CDC IN endpoint address"
            default 0x81 if MODEM_TARGET_ML302_DNLM
            default 0x84 if MODEM_TARGET_AIR724UG_NFM
            default 0x86 if  MODEM_TARGET_EC600N_CNLA_N05
            default 0x81 if  MODEM_TARGET_EC600N_CNLC_N06
            default 0x81 if MODEM_TARGET_A7600C1
            default 0x84 if MODEM_TARGET_BG95_M3
            default 0x86 if MODEM_TARGET_BG96_MA
            default 0x87 if MODEM_TARGET_MC610_EU
            default 0x81 if MODEM_TARGET_USER
            range 0x81 0x8f
            help
                USB IN endpoint address (eg.0x81) used for recive data from device
        config MODEM_USB_OUT2_EP_ADDR
            depends on MODEM_SUPPORT_SECONDARY_AT_PORT
            hex "Modem USB CDC2 OUT endpoint address (AT Only)"
            default 0x06 if MODEM_TARGET_MC610_EU
            range 0x01 0x7f
            help
                USB OUT endpoint address (eg.0x01) used for send AT to device
        config MODEM_USB_IN2_EP_ADDR
            depends on MODEM_SUPPORT_SECONDARY_AT_PORT
            hex "Modem USB CDC2 IN endpoint address (AT Only)"
            default 0x86 if MODEM_TARGET_MC610_EU
            range 0x81 0x8f
            help
                USB IN endpoint address (eg.0x81) used for recive AT from device
    endmenu

endmenu
```

## examples/usb/host/usb_cdc_4g_module/main/Kconfig.projbuild
```kconfig
menu "4G Modem Example Config"

    choice DEVELOPMENT_BOARD_SELECTION
        prompt "Select the development board you are using"
        default ESP32_S3_GENERIC if IDF_TARGET_ESP32S3
        default ESP32_S2_GENERIC if IDF_TARGET_ESP32S2
        help
            Select this option to choose the board for the example.

        config ESP32_S3_USB_OTG
            bool "ESP32 S3 USB OTG"
            depends on IDF_TARGET_ESP32S3

        config ESP32_S3_GENERIC
            bool "ESP32 S3 GENERIC"
            depends on IDF_TARGET_ESP32S3

        config ESP32_S2_GENERIC
            bool "ESP32 S2 GENERIC"
            depends on IDF_TARGET_ESP32S2

    endchoice

    config EXAMPLE_USB_PPP_DOWNLOAD_SPEED_TEST
        bool "Enable USB PPP Download Speed Test"
        default n
        help
            Enable Download Speed Test.

    config DUMP_SYSTEM_STATUS
        bool "Dump system task status"
        default n
        help
            Dump system task status, stack left, cpu load, etc.

endmenu
```

## examples/usb/host/usb_cdc_4g_module/sdkconfig.defaults.esp32s2
```kconfig
#
# ESP32S2-specific
#

CONFIG_ESP32S2_DEFAULT_CPU_FREQ_240=y
CONFIG_ESP32S2_DEFAULT_CPU_FREQ_MHZ=240
```

## examples/usb/host/usb_cdc_4g_module/sdkconfig.defaults.esp32s3
```kconfig
#
# ESP32S3-Specific
#
CONFIG_ESP32S3_DEFAULT_CPU_FREQ_240=y
CONFIG_ESP32S3_DEFAULT_CPU_FREQ_MHZ=240

CONFIG_USBH_TASK_CORE_ID=1
```

## examples/usb/host/usb_ecm_4g_module/main/Kconfig.projbuild
```kconfig
menu "Example Configuration"

    config ESP_IDF_VERSION
       string
       option env="ESP_IDF_VERSION"

    config EXAMPLE_USB_ECM_IPERF
        bool "Enable USB ECM Iperf"
        help
            Enable USB ECM Iperf test, which is used to test the performance of USB ECM module.

    config EXAMPLE_USB_ECM_DOWNLOAD_SPEED_TEST
        bool "Enable USB ECM Download Speed Test"
        default n
        help
            Enable USB ECM Download Speed Test, which is used to test the download speed of USB ECM module.

    config EXAMPLE_USB_ECM_LIGHT_SLEEP_TEST
        bool "Enable USB ECM Light Sleep Test"
        default n
        select EXAMPLE_ENABLE_AT_CMD
        help
            Enable USB ECM Light Sleep Test, which is used to test USB ECM module in light sleep mode.

    config EXAMPLE_MODULE_RST_GPIO_NUM
        depends on EXAMPLE_USB_ECM_LIGHT_SLEEP_TEST
        int "USB ECM Module RST GPIO Number"
        default 5
        help
            Set the USB ECM module RST GPIO number.

    config EXAMPLE_MODULE_WAKEUP_GPIO_NUM
        depends on EXAMPLE_USB_ECM_LIGHT_SLEEP_TEST
        int "USB ECM Module WAKEUP GPIO Number"
        default 3
        help
            Set the USB ECM module WAKEUP GPIO number.

    config EXAMPLE_MODULE_WAKEUP_LEVEL
        depends on EXAMPLE_USB_ECM_LIGHT_SLEEP_TEST
        int "USB ECM Module WAKEUP Level"
        default 0
        range 0 1
        help
            Set the USB ECM module WAKEUP level.

    config EXAMPLE_ENABLE_AT_CMD
        bool "Enable USB ECM AT Command"
        default n
        help
            Enable USB ECM AT Command.

    config EXAMPLE_AT_INTERFACE_NUM
        depends on EXAMPLE_ENABLE_AT_CMD
        int "USB ECM AT Interface Number"
        default 2
        help
            Set the USB ECM AT interface number.

    config EXAMPLE_USE_USB_HOST_FULLSPEED
        bool "Use USB Host Full Speed"
        depends on IDF_TARGET_ESP32P4 && ESP_IDF_VERSION >= 5.5
        default n
        help
            By default, USB Host High Speed is used. Enable this option to use USB Host Full Speed instead.
endmenu
```

## examples/usb/host/usb_host_msc_example/components/app_file_web/Kconfig.projbuild
```kconfig
menu "USB Host MSC Demo"

    config WIFI_HTTP_ACCESS
        bool "Enable WiFi HTTP files server"
        default y

    menu "WiFi Settings"
        config ESP_WIFI_ROUTE_SSID
            string "WiFi Route SSID"
            default ""
            help
            WiFi SSID (network name) to connect to or empty for Off.

        config ESP_WIFI_ROUTE_PASSWORD
            string "WiFi Route Password"
            default ""
            help
            WiFi Password if WEP/WPA/WPA2 or empty if Open.

        config ESP_WIFI_SOFTAP_SSID
            string "WiFi softAP  SSID"
            default "ESP-Host-MSC-Demo"
            help
            softAP SSID (network name) to create or empty for Off.

        config ESP_WIFI_SOFTAP_PASSWORD
            string "WiFi softAP Password"
            default ""
            help
            softAP password for WPA2 or empty for Open.

        config ESP_WIFI_SOFTAP_MAX_STA
            int "Maximal STA connections"
            default 5
            help
            Max number of the STA connects to softAP.

        config ESP_WIFI_AP_CHANNEL
            int "WiFi softAP Channel"
            default 1
            help
            softAP channel for better connection performance.

        config SERVER_IP
            string "WiFi softAP IP Address"
            default "192.168.4.1"
            help
                IP address that the ESP will assign to it's softAP interface. You can use this IP to connect to the camera after flashing.

        config ESP_MAXIMUM_RETRY
            int "Maximum retry"
            default 5
            help
            Set the Maximum retry to avoid station reconnecting to the softAP unlimited when the softAP is really inexistent.

        config ENABLE_RESET_BUTTON
            bool
            default n
    endmenu

endmenu
```

## examples/usb/host/usb_hub_dual_camera/sdkconfig.defaults
```kconfig
CONFIG_USB_HOST_CONTROL_TRANSFER_MAX_SIZE=4096
CONFIG_USB_HOST_HW_BUFFER_BIAS_IN=y
CONFIG_USB_HOST_HUBS_SUPPORTED=y
CONFIG_PARTITION_TABLE_CUSTOM=y
CONFIG_PARTITION_TABLE_OFFSET=0x9000
CONFIG_FREERTOS_HZ=1000
CONFIG_HTTPD_MAX_REQ_HDR_LEN=1024

CONFIG_ESP_WIFI_STATIC_RX_BUFFER_NUM=16
CONFIG_ESP_WIFI_DYNAMIC_RX_BUFFER_NUM=64

CONFIG_UVC_CHECK_PAYLOAD_HEADER_EOH=n
CONFIG_ESP_WIFI_DYNAMIC_TX_BUFFER_NUM=64
CONFIG_ESP_WIFI_AMPDU_TX_ENABLED=y
CONFIG_ESP_WIFI_TX_BA_WIN=32
CONFIG_ESP_WIFI_AMPDU_RX_ENABLED=y
CONFIG_ESP_WIFI_RX_BA_WIN=32

CONFIG_LWIP_TCP_SND_BUF_DEFAULT=65534
CONFIG_LWIP_TCP_WND_DEFAULT=65534
CONFIG_LWIP_TCP_RECVMBOX_SIZE=64
CONFIG_LWIP_UDP_RECVMBOX_SIZE=64
CONFIG_LWIP_TCPIP_RECVMBOX_SIZE=64
CONFIG_UVC_CHECK_PAYLOAD_HEADER_EOH=n
```

## examples/usb/host/usb_hub_dual_camera/sdkconfig.defaults.esp32p4
```kconfig
CONFIG_IDF_SLAVE_TARGET="esp32c6"
CONFIG_SLAVE_IDF_TARGET_ESP32C6=y
CONFIG_ESP_WIFI_REMOTE_ENABLED=y
CONFIG_ESPTOOLPY_FLASHMODE_QIO=y
CONFIG_ESPTOOLPY_FLASHSIZE_16MB=y
CONFIG_SPIRAM=y
CONFIG_SPIRAM_SPEED_200M=y
CONFIG_IDF_EXPERIMENTAL_FEATURES=y

CONFIG_LWIP_TCP_SACK_OUT=y
CONFIG_EPPP_LINK_USES_PPP=y
```

## examples/usb/host/usb_hub_dual_camera/sdkconfig.defaults.esp32s2
```kconfig
CONFIG_ESP32S2_DEFAULT_CPU_FREQ_240=y
CONFIG_ESP32S2_DEFAULT_CPU_FREQ_MHZ=240
CONFIG_ESPTOOLPY_FLASHSIZE_8MB=y

#
# ESP PSRAM
#
CONFIG_SPIRAM=y

#
# Compiler options
#
CONFIG_COMPILER_OPTIMIZATION_PERF=y
```

## examples/usb/host/usb_hub_dual_camera/sdkconfig.defaults.esp32s3
```kconfig
CONFIG_ESP32S3_DEFAULT_CPU_FREQ_240=y
CONFIG_ESP32S3_DEFAULT_CPU_FREQ_MHZ=240
CONFIG_ESPTOOLPY_FLASHSIZE_8MB=y

#
# ESP PSRAM
#
CONFIG_SPIRAM=y
CONFIG_SPIRAM_MODE_OCT=y
CONFIG_SPIRAM_SPEED_80M=y
CONFIG_SPIRAM_FETCH_INSTRUCTIONS=y
CONFIG_SPIRAM_RODATA=y

#
# Compiler options
#
CONFIG_COMPILER_OPTIMIZATION_PERF=y
```

## examples/usb/host/usb_hub_dual_camera/sdkconfig.defaults.esp32s31
```kconfig
CONFIG_ESPTOOLPY_FLASHMODE_QIO=y
CONFIG_ESPTOOLPY_FLASHSIZE_16MB=y
CONFIG_SPIRAM=y
CONFIG_SPIRAM_SPEED_200M=y
CONFIG_IDF_EXPERIMENTAL_FEATURES=y

CONFIG_LWIP_TCP_SACK_OUT=y
```

## examples/usb/host/usb_msc_ota/main/Kconfig.projbuild
```kconfig
menu "Example Configeration"

    config MSC_OTA_BIN_NAME
        string "msc ota bin name"
        default "usb_msc_ota.bin"

    config SIMPLE_MSC_OTA
        bool "simple msc ota"
        default y
        help
            simple msc ota

endmenu
```

## examples/usb/host/usb_rndis_4g_module/main/Kconfig.projbuild
```kconfig
menu "Example Configuration"

    config EXAMPLE_USB_RNDIS_DOWNLOAD_SPEED_TEST
        bool "Enable USB RNDIS Download Speed Test"
        default n
        help
            Enable USB RNDIS Download Speed Test.

    config EXAMPLE_ENABLE_AT_CMD
        bool "Enable USB RNDIS AT Command"
        help
            Enable USB RNDIS AT Command.

    config EXAMPLE_AT_INTERFACE_NUM
        depends on EXAMPLE_ENABLE_AT_CMD
        int "USB RNDIS AT Interface Number"
        default 2
        help
            Set the USB RNDIS AT interface number.
endmenu
```

## examples/usb/host/usb_rndis_4g_module/sdkconfig.defaults.esp32p4
```kconfig
CONFIG_SLAVE_IDF_TARGET_ESP32C6=y
CONFIG_USBH_CDC_CONTROL_TRANSFER_BUFFER_SIZE=512
```
