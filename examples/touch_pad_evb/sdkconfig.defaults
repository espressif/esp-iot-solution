## examples/usb/device/usb_extend_screen/components/esp32_p4_function_ev_board/Kconfig
```kconfig
menu "Board Support Package"

    config BSP_ERROR_CHECK
        bool "Enable error check in BSP"
        default y
        help
            Error check assert the application before returning the error code.

    choice
        prompt "Choose Board Type"
        default BSP_BOARD_TYPE_SAMPLE
            config BSP_BOARD_TYPE_FLY_LINE
                bool "Fly Line"

            config BSP_BOARD_TYPE_FIB
                bool "FIB"

            config BSP_BOARD_TYPE_SAMPLE
                bool "Customer Sample"
    endchoice

    menu "I2C"
        config BSP_I2C_NUM
            int "I2C peripheral index"
            default 1
            range 0 1
            help
                ESP32S3 has two I2C peripherals, pick the one you want to use.

        config BSP_I2C_FAST_MODE
            bool "Enable I2C fast mode"
            default y
            help
                I2C has two speed modes: normal (100kHz) and fast (400kHz).

        config BSP_I2C_CLK_SPEED_HZ
            int
            default 400000 if BSP_I2C_FAST_MODE
            default 100000
    endmenu

    menu "SPIFFS - Virtual File System"
        config BSP_SPIFFS_FORMAT_ON_MOUNT_FAIL
            bool "Format SPIFFS if mounting fails"
            default n
            help
                Format SPIFFS if it fails to mount the filesystem.

        config BSP_SPIFFS_MOUNT_POINT
            string "SPIFFS mount point"
            default "/spiffs"
            help
                Mount point of SPIFFS in the Virtual File System.

        config BSP_SPIFFS_PARTITION_LABEL
            string "Partition label of SPIFFS"
            default "storage"
            help
                Partition label which stores SPIFFS.

        config BSP_SPIFFS_MAX_FILES
            int "Max files supported for SPIFFS VFS"
            default 5
            help
                Supported max files for SPIFFS in the Virtual File System.
    endmenu

    menu "SD card - Virtual File System"
        choice
            prompt "Choose Host"
            default BSP_SD_HOST_SPI
            config BSP_SD_HOST_SDMMC
                bool "SDMMC"
            config BSP_SD_HOST_SPI
                bool "SPI"
        endchoice

        config BSP_SD_FORMAT_ON_MOUNT_FAIL
            bool "Format SD card if mounting fails"
            default n
            help
                The SDMMC host will format (FAT) the SD card if it fails to mount the filesystem.

        config BSP_SD_MOUNT_POINT
            string "SD card mount point"
            default "/sdcard"
            help
                Mount point of the SD card in the Virtual File System
    endmenu

    menu "LCD DSI"
        choice
            prompt "Choose LCD Controller"
            default BSP_LCD_CONTROLLER_ILI9881
                config BSP_LCD_CONTROLLER_ILI9881
                    bool "ILI9881"

                config BSP_LCD_CONTROLLER_EK79007
                    bool "EK79007"
        endchoice

        config BSP_LCD_DSI_USE_DMA2D
            bool "Use DMA2D for LCD DSI"
            default y
    endmenu

    menu "Display"
        choice
            prompt "Choose LVGL Version"
            default BSP_DISPLAY_LVGL_VERSION_V9
                config BSP_DISPLAY_LVGL_VERSION_V8
                    bool "v8"

                config BSP_DISPLAY_LVGL_VERSION_V9
                    bool "v9"
        endchoice

        config EXAMPLE_LCD_RGB_BOUNCE_BUFFER_HEIGHT
            int "RGB Bounce buffer height"
            default 10
            help
                Height of bounce buffer. The width of the buffer is the same as that of the LCD.

        config BSP_DISPLAY_LVGL_TASK_MAX_DELAY_MS
            int "LVGL timer task maximum delay (ms)"
            default 500
            range 2 2000  # Example range, adjust as needed
            help
            The maximum delay of the LVGL timer task, in milliseconds.

        config BSP_DISPLAY_LVGL_TASK_MIN_DELAY_MS
            int "LVGL timer task minimum delay (ms)"
            default 10
            range 1 100  # Example range, adjust as needed
            help
            The minimum delay of the LVGL timer task, in milliseconds.

        config BSP_DISPLAY_LVGL_TASK_PRIORITY
            int "LVGL task priority"
            default 2
            help
                The Board Support Package will create a task that will periodically handle LVGL operation in lv_timer_handler().

        config BSP_DISPLAY_LVGL_TASK_STACK_SIZE_KB
            int "LVGL task stack size (KB)"
            default 6
            help
                Size(KB) of LVGL task stack.

        config BSP_DISPLAY_LVGL_TASK_CORE
            int "LVGL timer task core"
            default -1
            range -1 1
            help
            The core of the LVGL timer task.
            Set to -1 to not specify the core.
            Set to 1 only if the SoCs support dual-core, otherwise set to -1 or 0.

        config BSP_DISPLAY_LVGL_TICK
            int "LVGL tick period"
            default 2
            range 1 100
            help
                Period of LVGL tick timer.

        config BSP_DISPLAY_LVGL_AVOID_TEAR_ENABLE
            bool "Avoid tearing effect"
            default "n"
            help
                Avoid tearing effect through LVGL buffer mode and double frame buffers of RGB LCD. This feature is only available for RGB LCD.

        choice
            depends on BSP_DISPLAY_LVGL_AVOID_TEAR_ENABLE
            prompt "Select Avoid Tearing Mode"
            default BSP_DISPLAY_LVGL_AVOID_TEAR_ENABLE_MODE_3
            config BSP_DISPLAY_LVGL_AVOID_TEAR_ENABLE_MODE_1
                bool "Mode1: LCD double-buffer & LVGL full-refresh"
            config BSP_DISPLAY_LVGL_AVOID_TEAR_ENABLE_MODE_2
                bool "Mode2: LCD triple-buffer & LVGL full-refresh"
            config BSP_DISPLAY_LVGL_AVOID_TEAR_ENABLE_MODE_3
                bool "Mode3: LCD double-buffer & LVGL direct-mode"
            help
                The current tearing prevention mode supports both full refresh mode and direct mode. Tearing prevention mode may consume more PSRAM space
        endchoice

        config BSP_DISPLAY_LVGL_AVOID_TEAR_ENABLE_MODE
            depends on BSP_DISPLAY_LVGL_AVOID_TEAR_ENABLE
            int
            default 0 if BSP_DISPLAY_LVGL_AVOID_TEAR_ENABLE_MODE_1
            default 1 if BSP_DISPLAY_LVGL_AVOID_TEAR_ENABLE_MODE_2
            default 2 if BSP_DISPLAY_LVGL_AVOID_TEAR_ENABLE_MODE_3

        choice
            depends on !BSP_DISPLAY_LVGL_AVOID_TEAR_ENABLE
            prompt "Select LVGL buffer memory capability"
            default BSP_DISPLAY_LVGL_BUF_PSRAM
            config BSP_DISPLAY_LVGL_BUF_PSRAM
                bool "PSRAM memory"
            config BSP_DISPLAY_LVGL_BUF_INTERNAL
                bool "Internal memory"
        endchoice

        config BSP_DISPLAY_LVGL_BUF_HEIGHT
            depends on !BSP_DISPLAY_LVGL_AVOID_TEAR_ENABLE
            int "LVGL buffer height"
            default 1280
            help
                Height of LVGL buffer. The width of the buffer is the same as that of the LCD.

        config LVGL_PORT_USE_GPU
            depends on BSP_LCD_DSI_USE_DMA2D && BSP_DISPLAY_LVGL_VERSION_V8 && !BSP_DISPLAY_LVGL_AVOID_TEAR_ENABLE
            bool "Use GPU"
            default y
    endmenu

    config BSP_I2S_NUM
        int "I2S peripheral index"
        default 1
        range 0 1
        help
            ESP32S3 has two I2S peripherals, pick the one you want to use.
endmenu
```

## examples/usb/device/usb_extend_screen/components/espressif__esp_lcd_touch/Kconfig
```kconfig
menu "ESP LCD TOUCH"

    config ESP_LCD_TOUCH_MAX_POINTS
        int "Maximum count of the touch points"
        range 1 10
        default 5

    config ESP_LCD_TOUCH_MAX_BUTTONS
        int "Maximum count of the touch buttons supported"
        range 0 10
        default 1

endmenu
```

## examples/usb/device/usb_extend_screen/components/espressif__esp_lvgl_port/examples/rgb_lcd/sdkconfig.defaults
```kconfig
CONFIG_IDF_TARGET="esp32s3"
CONFIG_ESPTOOLPY_FLASHMODE_QIO=y
CONFIG_ESPTOOLPY_FLASHSIZE_4MB=y
CONFIG_PARTITION_TABLE_CUSTOM=y
CONFIG_COMPILER_OPTIMIZATION_PERF=y
CONFIG_SPIRAM=y
CONFIG_SPIRAM_MODE_OCT=y
CONFIG_SPIRAM_FETCH_INSTRUCTIONS=y
CONFIG_SPIRAM_RODATA=y
CONFIG_SPIRAM_SPEED_80M=y
CONFIG_ESP_DEFAULT_CPU_FREQ_MHZ_240=y
CONFIG_ESP32S3_DATA_CACHE_LINE_64B=y
CONFIG_FREERTOS_HZ=1000
CONFIG_LV_MEM_CUSTOM=y
CONFIG_LV_MEMCPY_MEMSET_STD=y
CONFIG_LV_ATTRIBUTE_FAST_MEM_USE_IRAM=y
CONFIG_LV_FONT_MONTSERRAT_12=y
CONFIG_LV_FONT_MONTSERRAT_16=y
CONFIG_LV_USE_DEMO_WIDGETS=y
CONFIG_LV_USE_DEMO_BENCHMARK=y
CONFIG_LV_USE_DEMO_STRESS=y
CONFIG_LV_USE_DEMO_MUSIC=y
CONFIG_LV_DEMO_MUSIC_AUTO_PLAY=y

## LVGL8 ##
CONFIG_LV_MEM_SIZE_KILOBYTES=48
CONFIG_LV_USE_PERF_MONITOR=y

## LVGL9 ##
CONFIG_LV_CONF_SKIP=y

#CLIB default
CONFIG_LV_USE_CLIB_MALLOC=y
CONFIG_LV_USE_CLIB_SPRINTF=y
CONFIG_LV_USE_CLIB_STRING=y

# Performance monitor
CONFIG_LV_USE_OBSERVER=y
CONFIG_LV_USE_SYSMON=y
CONFIG_LV_USE_PERF_MONITOR=y
```

## examples/usb/device/usb_extend_screen/components/espressif__esp_lvgl_port/examples/touchscreen/sdkconfig.defaults
```kconfig
CONFIG_IDF_TARGET="esp32s3"
CONFIG_ESPTOOLPY_FLASHMODE_QIO=y
CONFIG_ESPTOOLPY_FLASHSIZE_16MB=y
CONFIG_LV_COLOR_16_SWAP=y
```

## examples/usb/device/usb_extend_screen/components/espressif__esp_lvgl_port/test_apps/sdkconfig.defaults
```kconfig
CONFIG_IDF_TARGET="esp32s3"
CONFIG_ESPTOOLPY_FLASHMODE_QIO=y
CONFIG_ESPTOOLPY_FLASHSIZE_16MB=y
CONFIG_LV_COLOR_16_SWAP=y
CONFIG_FREERTOS_HZ=1000
CONFIG_ESP_TASK_WDT_EN=n
CONFIG_ESP_CONSOLE_USB_SERIAL_JTAG=y
```

## examples/usb/device/usb_extend_screen/main/uac/Kconfig.uac
```kconfig
menu "USB Device UAC"

    config UAC_SPEAKER_CHANNEL_NUM
        int "UAC Speaker channel number"
        range 0 8
        default 1

    config UAC_MIC_CHANNEL_NUM
        int "UAC mic channel number"
        range 0 4
        default 1

    config UAC_SAMPLE_RATE
        int "UAC sample rate"
        default 48000

    config UAC_SPK_INTERVAL_MS
        int "UAC SPK interval(ms)"
        default 10
        help
            SPK: The first interval of reading data from UAC device, in ms. And make SPK FIFO to accommodate data of size n milliseconds.

    config UAC_MIC_INTERVAL_MS
        int "UAC MIC interval(ms)"
        default 10
        help
            MIC: The interval of writing data to UAC device, in ms. Batch fetching data helps reduce latency at the slave end. And make MIC FIFO to accommodate data of size n milliseconds.

    config UAC_SPK_NEW_PLAY_INTERVAL
        int "UAC SPK new play interval(ms)"
        default 100
        help
            SPK: A new playback is considered if it has been longer than a certain number of milliseconds since the last audio data was received.

    config UAC_SUPPORT_MACOS
        bool "Support MacOS"
        default n
        help
            Enable conversion from 16.16 to 10.14 format on full-speed devices on MacOS.

    menu "UAC Task Config"
            config UAC_TINYUSB_TASK_PRIORITY
                int "Tinyusb task priority"
                default 5
                range 1 15

            config UAC_TINYUSB_TASK_CORE
                int "Tinyusb task core"
                default -1
                range -1 1

            config UAC_SPK_TASK_PRIORITY
                int "SPK task priority"
                default 5
                range 1 15
                depends on UAC_SPEAKER_CHANNEL_NUM != 0

            config UAC_SPK_TASK_CORE
                int "SPK task core"
                default -1
                range -1 1
                depends on UAC_SPEAKER_CHANNEL_NUM != 0

            config UAC_MIC_TASK_PRIORITY
                int "MIC task priority"
                default 5
                range 1 15
                depends on UAC_MIC_CHANNEL_NUM != 0

            config UAC_MIC_TASK_CORE
                int "MIC task core"
                default -1
                range -1 1
                depends on UAC_MIC_CHANNEL_NUM != 0
    endmenu

endmenu
```

## examples/usb/device/usb_hid_device/main/Kconfig.projbuild
```kconfig
menu "USB HID Device Example"

    choice DEVELOPMENT_BOARD_SELECTION
        prompt "Select the development board you are using"
        default ESP32_S3_USB_OTG if IDF_TARGET_ESP32S3
        default ESP32_S2_GENERIC if IDF_TARGET_ESP32S2
        help
            Select this option to choose the board for the example.

        config ESP32_S3_USB_OTG
            bool "ESP32 S3 USB OTG"
            depends on IDF_TARGET_ESP32S3

        config ESP32_S3_GENERIC
            bool "ESP32 S3 GENERIC"
            depends on IDF_TARGET_ESP32S3

        config ESP32_S2_GENERIC
            bool "ESP32 S2 GENERIC"
            depends on IDF_TARGET_ESP32S2

    endchoice

    choice HID_SUBCLASS
        prompt "HID Device"
        default SUBCLASS_MOUSE

        config SUBCLASS_MOUSE
            bool "Mouse"
        config SUBCLASS_KEYBOARD
            bool "Keyboard"
    endchoice

    config TUSB_VID
        hex "USB Device VID"
        default 0x303A
    config TUSB_PID
        hex "USB Device PID"
        default 0x8000
    config TUSB_MANUFACTURER
        string "USB Device Manufacture"
        default "Espressif"
    config TUSB_PRODUCT
        string "Product Name"
        default "HID Demo"

    choice TINYUSB_RHPORT
        prompt "TinyUSB Root Port"
        default TINYUSB_RHPORT_HS if IDF_TARGET_ESP32P4
        default TINYUSB_RHPORT_FS
        help
            Allows set the USB PHY Controller for TinyUSB: HS (USB OTG2.0 PHY for HighSpeed)

        config TINYUSB_RHPORT_HS
            depends on IDF_TARGET_ESP32P4
            bool "High Speed"

        config TINYUSB_RHPORT_FS
            bool "Full Speed"
    endchoice

    config ENABLE_FULL_KEY_KEYBOARD
        bool "Enable Full Key Keyboard"
        default n

endmenu
```
