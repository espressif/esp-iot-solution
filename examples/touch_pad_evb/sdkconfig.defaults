## examples/touch_pad_evb/sdkconfig.defaults
```kconfig
#
# IoT Solution settings
#

#
# IoT Components Management
#

#
# General functions
#
CONFIG_IOT_IR_ENABLE=y
CONFIG_IOT_TOUCH_ENABLE=y

#
# Touch Sensor
#
CONFIG_DATA_SCOPE_DEBUG=y

#
# DataScope port setting
#
CONFIG_SCOPE_PORT_NUM_UART0=y
CONFIG_SCOPE_PORT_NUM_UART1=
CONFIG_SCOPE_PORT_NUM_UART2=
CONFIG_SCOPE_DEBUG_PORT_NUM=0
CONFIG_SCOPE_PORT_BAUD_RATE_115200=
CONFIG_SCOPE_PORT_BAUD_RATE_256000=
CONFIG_SCOPE_PORT_BAUD_RATE_460800=
CONFIG_SCOPE_PORT_BAUD_RATE_921600=y
CONFIG_SCOPE_PORT_BAUD_RATE_1152000=
CONFIG_SCOPE_DEBUG_BAUD_RATE=921600
CONFIG_SCOPE_DEBUG_UART_TXD_IO=1
CONFIG_SCOPE_DEBUG_UART_RXD_IO=3
CONFIG_IOT_ULP_ENABLE=
CONFIG_IOT_LOWPOWER_APP_FRAMEWORK_ENABLE=
CONFIG_IOT_BUTTON_ENABLE=
CONFIG_IOT_DEBUG_ENABLE=
CONFIG_IOT_LED_ENABLE=y

#
# IoT Example - Touch Sensor settings
#
CONFIG_TOUCH_EB_V3=y
CONFIG_TOUCH_EB_V2=

#
# Plastic cover thickness setting
#
CONFIG_COVER_THICK_SPRING_BUTTON=3
CONFIG_COVER_THICK_LINEAR_SLIDER=1
CONFIG_COVER_THICK_DUPLEX_SLIDER=0
CONFIG_COVER_THICK_TOUCH_WHEEL=0
CONFIG_COVER_THICK_MATRIX_BUTTON=0
```

## examples/touch_tft/main/Kconfig.projbuild
```kconfig
menu "ESPILICAM Configuration"

config USE_LCD
    bool "use lcd"
    default y
    help
        whether use camera with lcd screen.

config WIFI_SSID
    string "WiFi SSID"
    default ""
    help
        SSID (network name) for the demo to connect to.

config WIFI_PASSWORD
    string "WiFi Password"
    default ""
    help
        Password for your network.

config XCLK_FREQ
    int "XCLK Frequency"
    default "8000000"
    help
        The XCLK Frequency in Herz.

menu "Pin Configuration"
    config HW_LCD_MISO_GPIO
        int "HW_LCD_MISO_GPIO"
        default "12"
    config HW_LCD_MOSI_GPIO
        int "HW_LCD_MOSI_GPIO"
        default "13"
    config HW_LCD_CLK_GPIO
        int "HW_LCD_CLK_GPIO"
        default "14"
    config HW_LCD_CS_GPIO
        int "HW_LCD_CS_GPIO"
        default "15"
    config HW_LCD_DC_GPIO
        int "HW_LCD_DC_GPIO"
        default "2"
    config HW_LCD_RESET_GPIO
        int "HW_LCD_RESET_GPIO"
        default "33"
    config HW_LCD_BL_GPIO
        int "HW_LCD_BL_GPIO"
        default "3"
    config D0
        int "D0"
        default "4"
    config D1
        int "D1"
        default "5"
    config D2
        int "D2"
        default "18"
    config D3
        int "D3"
        default "19"
    config D4
        int "D4"
        default "36"
    config D5
        int "D5"
        default "39"
    config D6
        int "D6"
        default "34"
    config D7
        int "D7"
        default "35"
    config XCLK
        int "XCLK"
        default "21"
    config PCLK
        int "PCLK"
        default "22"
    config VSYNC
        int "VSYNC"
        default "25"
    config HREF
        int "HREF"
        default "23"
    config SDA
        int "SDA"
        default "26"
    config SCL
        int "SCL"
        default "27"
    config RESET
        int "RESET"
        default "0"
endmenu

endmenu
```

## examples/touch_tft/sdkconfig.defaults
```kconfig
CONFIG_ENABLE_TEST_PATTERN=y
CONFIG_OV2640_SUPPORT=n
CONFIG_OV7725_SUPPORT=n
CONFIG_OV7670_SUPPORT=y
CONFIG_ESP32_DEFAULT_CPU_FREQ_240=y
CONFIG_ESP32_DEFAULT_CPU_FREQ_MHZ=240
CONFIG_MEMMAP_SMP=y
CONFIG_TASK_WDT=n
CONFIG_FREERTOS_UNICORE=n
CONFIG_FREERTOS_HZ=100
CONFIG_LOG_DEFAULT_LEVEL_DEBUG=y
CONFIG_LOG_DEFAULT_LEVEL=4
CONFIG_SPIRAM_SUPPORT=y
```

## examples/ulp/lp_cpu/lp_environment_sensor/components/app_epaper/Kconfig
```kconfig
menu "E-paper Display Pin Configuration"

config EPAPER_PIN_NUM_DC
    int "E-paper DC Pin Number"
    default 20
    help
      Select the pin number for connecting E-paper DC pin

config EPAPER_PIN_NUM_RST
    int "E-paper RST Pin Number"
    default 19
    help
      Select the pin number for connecting E-paper RST pin

config EPAPER_PIN_NUM_CS
    int "E-paper CS Pin Number"
    default 21
    help
      Select the pin number for connecting E-paper CS pin

config EPAPER_PIN_NUM_BUSY
    int "E-paper BUSY Pin Number"
    default 22
    help
      Select the pin number for connecting E-paper BUSY pin

config EPAPER_PIN_NUM_MOSI
    int "E-paper MOSI Pin Number"
    default 18
    help
      Select the pin number for connecting E-paper MOSI pin

config EPAPER_PIN_NUM_SCLK
    int "E-paper SCLK Pin Number"
    default 15
    help
      Select the pin number for connecting E-paper SCLK pin

endmenu
```

## examples/ulp/lp_cpu/lp_environment_sensor/main/Kconfig.projbuild
```kconfig
menu "LP Environment Sensor Configuration"
    config LP_CPU_WAKEUP_TIME_SECOND
        int "LP CPU wakeup time(seconds)"
        default 6
        help
        Set LP CPU wakeup time(seconds).

    config ULP_UART_PRINT
        bool "Print temperature and humidity data using ULP UART"
        default n
        help
        Enable print temperature and humidity data using ULP UART.

    config REPORT_THS_DATA
        bool "Report temperature and humidity data to RainMaker"
        default y
        help
        Enable report temperature and humidity data to RainMaker.

    config UPDATE_WEATHER_DATA
        bool "Get weather data from HTTP"
        default y
        depends on REPORT_THS_DATA
        help
        Enable get weather data from HTTP.

choice
    prompt "Select Region Type"
    default REGION_DOMESTIC
    depends on UPDATE_WEATHER_DATA

    config REGION_OVERSEAS
        bool "Overseas"

    config REGION_DOMESTIC
        bool "Domestic"
endchoice

    config CITY_DISTRICT_ID
        string "District ID for weather data"
        default "310115"
        depends on UPDATE_WEATHER_DATA
        help
        Specify the district ID to get weather data from HTTP.

    config DOMESTIC_CITY_NAME
        string "Domestic City Name"
        depends on REGION_DOMESTIC
        default "Shanghai"
        help
        Specify the name of the domestic city (e.g., Shanghai).

    config DOMESTIC_DISTRICT_NAME
        string "Domestic District Name"
        depends on REGION_DOMESTIC
        default "Pudong"
        help
        Specify the name of the domestic district (e.g., Pudong).

endmenu
```

## examples/ulp/lp_cpu/lp_environment_sensor/sdkconfig.defaults
```kconfig
#
# ESP System Settings
#
CONFIG_IDF_TARGET="esp32c6"
CONFIG_ESP_DEFAULT_CPU_FREQ_MHZ_160=y
CONFIG_ESP_DEFAULT_CPU_FREQ_MHZ=160
CONFIG_ULP_COPROC_ENABLED=y
CONFIG_ULP_COPROC_TYPE_LP_CORE=y
CONFIG_ULP_COPROC_RESERVE_MEM=16000
CONFIG_NEWLIB_TIME_SYSCALL_USE_RTC_HRT=y
CONFIG_RTC_CLK_SRC_INT_RC=y

#
# Bootloader config
#
CONFIG_BOOTLOADER_LOG_LEVEL_NONE=y
CONFIG_BOOTLOADER_LOG_LEVEL=0
CONFIG_BOOTLOADER_SKIP_VALIDATE_IN_DEEP_SLEEP=y
CONFIG_BOOTLOADER_SKIP_VALIDATE_ON_POWER_ON=y
CONFIG_BOOTLOADER_SKIP_VALIDATE_ALWAYS=y

#
# Boot ROM Behavior
#
CONFIG_BOOT_ROM_LOG_ALWAYS_OFF=y

#
# LWIP
#
CONFIG_LWIP_DHCP_RESTORE_LAST_IP=y

#
# Log output
#
CONFIG_LOG_DEFAULT_LEVEL_INFO=y
CONFIG_LOG_DEFAULT_LEVEL=3

#
# PHY
#
CONFIG_ESP_PHY_CALIBRATION_AND_DATA_STORAGE=y
CONFIG_ESP_PHY_RF_CAL_NONE=y
CONFIG_ESP_PHY_CALIBRATION_MODE=1

#
# Serial flasher config
#
CONFIG_ESPTOOLPY_FLASHMODE_QIO=y
CONFIG_ESPTOOLPY_FLASHFREQ_80M=y

#
# Kernel
#
CONFIG_FREERTOS_UNICORE=y
CONFIG_FREERTOS_HZ=1000

CONFIG_BT_NIMBLE_ENABLED=y
CONFIG_BT_BLE_42_FEATURES_SUPPORTED=y
CONFIG_ESP_TLS_INSECURE=y
CONFIG_ESP_TLS_SKIP_SERVER_CERT_VERIFY=y

#
# Partition Table
#
CONFIG_PARTITION_TABLE_CUSTOM=y
CONFIG_PARTITION_TABLE_CUSTOM_FILENAME="partitions.csv"
CONFIG_PARTITION_TABLE_FILENAME="partitions.csv"
CONFIG_PARTITION_TABLE_OFFSET=0x8000
CONFIG_PARTITION_TABLE_MD5=y

CONFIG_ESPTOOLPY_FLASHSIZE_4MB=y
CONFIG_ESPTOOLPY_FLASHSIZE="4MB"

#
# ESP RainMaker Config
#
CONFIG_ESP_RMAKER_ASSISTED_CLAIM=y
CONFIG_ESP_RMAKER_MQTT_HOST="a1p72mufdu6064-ats.iot.us-east-1.amazonaws.com"
```

## examples/ulp_examples/ulp_watering_device/main/Kconfig.projbuild
```kconfig
menu "WiFi Configuration"

config WIFI_SSID
    string "WiFi SSID"
	default "yourwifissid"
	help
		SSID (network name) to connect to.

config WIFI_PASSWORD
    string "WiFi Password"
	default "yourwifipassword"
	help
		WiFi password (WPA or WPA2) to use.

		Can be left blank if the network has no security set.

endmenu
```

## examples/usb/device/bootloader_uf2/main/Kconfig.projbuild
```kconfig
menu "Bootloader UF2 APP Config"

    config BOOTLOADER_UF2_NVS_PART_NAME
        string "NVS partition name"
        default "nvs"
        help
            The name of the NVS partition to use for bootloader UF2.

    config BOOTLOADER_UF2_NVS_NAMESPACE_NAME
        string  "NVS namespace name"
        default "uf2_nvs"
        help
            The name of the NVS namespace to use for bootloader UF2.

    config BOOTLOADER_UF2_LED_INDICATOR_ENABLE
        bool "Enable LED indicator"
        default y
        help
            Enable LED indicator for bootloader UF2.

    config BOOTLOADER_UF2_LED_INDICATOR_GPIO_NUM
        int "LED indicator GPIO number"
        depends on  BOOTLOADER_UF2_LED_INDICATOR_ENABLE
        default 2
        range 0 46 if IDF_TARGET_ESP32S2
        range 0 48 if IDF_TARGET_ESP32S3
        range 0 54 if IDF_TARGET_ESP32P4
        help
            GPIO number for LED indicator for bootloader UF2.
endmenu
```

## examples/usb/device/bootloader_uf2/sdkconfig.defaults
```kconfig
#
# Serial flasher config
#
CONFIG_ESPTOOLPY_FLASHSIZE_DETECT=y

#
# Partition Table
#
CONFIG_PARTITION_TABLE_OFFSET=0x60000
CONFIG_PARTITION_TABLE_CUSTOM=y
# end of Partition Table
CONFIG_SPI_FLASH_DANGEROUS_WRITE_ALLOWED=y
CONFIG_ESPTOOLPY_FLASHSIZE_2MB=y
CONFIG_PARTITION_TABLE_CUSTOM_FILENAME="partitions_singleapp_2m.csv"
CONFIG_UF2_OTA_FACTORY_ONLY=y
```

## examples/usb/device/usb_cdc_dual_port/sdkconfig.defaults
```kconfig
#
# TinyUSB
#
CONFIG_TINYUSB=y
CONFIG_TINYUSB_CDC_ENABLED=y
CONFIG_TINYUSB_CDC_PORT_NUM=2
CONFIG_TINYUSB_CDC_RX_BUFSIZE=2048
CONFIG_TINYUSB_CDC_TX_BUFSIZE=2048
```
