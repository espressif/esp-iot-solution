## examples/usb/device/usb_dongle/components/tinyusb_dongle/Kconfig
```kconfig
menu "TinyUSB Stack"
    config TINYUSB_DEBUG_LEVEL
        int "TinyUSB log level (0-3)"
        default 1
        range 0 3
        help
            Specify verbosity of TinyUSB log output.

    choice TINYUSB_RHPORT
        prompt "TinyUSB Root Port"
        default TINYUSB_RHPORT_HS if IDF_TARGET_ESP32P4
        default TINYUSB_RHPORT_FS
        help
            Allows set the USB PHY Controller for TinyUSB: HS (USB OTG2.0 PHY for HighSpeed)

        config TINYUSB_RHPORT_HS
            depends on IDF_TARGET_ESP32P4
            bool "High Speed"

        config TINYUSB_RHPORT_FS
            bool "Full Speed"
    endchoice

    menu "TinyUSB task configuration"
        config TINYUSB_NO_DEFAULT_TASK
            bool "Do not create a TinyUSB task"
            default n
            help
                This option allows to not create the FreeRTOS task during the driver initialization.
                User will have to handle TinyUSB events manually.

        config TINYUSB_TASK_PRIORITY
            int "TinyUSB task priority"
            default 5
            depends on !TINYUSB_NO_DEFAULT_TASK
            help
                Set the priority of the default TinyUSB main task.

        config TINYUSB_TASK_STACK_SIZE
            int "TinyUSB task stack size (bytes)"
            default 4096
            depends on !TINYUSB_NO_DEFAULT_TASK
            help
                Set the stack size of the default TinyUSB main task.

        choice TINYUSB_TASK_AFFINITY
            prompt "TinyUSB task affinity"
            default TINYUSB_TASK_AFFINITY_NO_AFFINITY
            depends on !TINYUSB_NO_DEFAULT_TASK
            help
                Allows setting TinyUSB tasks affinity, i.e. whether the task is pinned to
                CPU0, pinned to CPU1, or allowed to run on any CPU.

            config TINYUSB_TASK_AFFINITY_NO_AFFINITY
                bool "No affinity"
            config TINYUSB_TASK_AFFINITY_CPU0
                bool "CPU0"
            config TINYUSB_TASK_AFFINITY_CPU1
                bool "CPU1"
                depends on !FREERTOS_UNICORE
        endchoice

        config TINYUSB_TASK_AFFINITY
            hex
            default FREERTOS_NO_AFFINITY if TINYUSB_TASK_AFFINITY_NO_AFFINITY
            default 0x0 if TINYUSB_TASK_AFFINITY_CPU0
            default 0x1 if TINYUSB_TASK_AFFINITY_CPU1

        config TINYUSB_INIT_IN_DEFAULT_TASK
            bool "Initialize TinyUSB stack within the default TinyUSB task"
            default n
            depends on !TINYUSB_NO_DEFAULT_TASK
            help
                Run TinyUSB stack initialization just after starting the default TinyUSB task.
                This is especially useful in multicore scenarios, when we need to pin the task
                to a specific core and, at the same time initialize TinyUSB stack
                (i.e. install interrupts) on the same core.
    endmenu

    menu "Descriptor configuration"
        comment "You can provide your custom descriptors via tinyusb_driver_install()"
        config TINYUSB_DESC_USE_ESPRESSIF_VID
            bool "VID: Use Espressif's vendor ID"
            default y
            help
                Enable this option, USB device will use Espressif's vendor ID as its VID.
                This is helpful at product develop stage.

        config TINYUSB_DESC_CUSTOM_VID
            hex "VID: Custom vendor ID"
            default 0xcafe
            depends on !TINYUSB_DESC_USE_ESPRESSIF_VID
            help
                Custom Vendor ID.

        config TINYUSB_DESC_USE_DEFAULT_PID
            bool "PID: Use a default PID assigned to TinyUSB"
            default y
            help
                Default TinyUSB PID assigning uses values 0x4000...0x4007.

        config TINYUSB_DESC_CUSTOM_PID
            hex "PID: Custom product ID"
            default 0x5678
            depends on !TINYUSB_DESC_USE_DEFAULT_PID
            help
                Custom Product ID.

        config TINYUSB_DESC_BCD_DEVICE
            hex "bcdDevice"
            default 0x0100
            help
                Version of the firmware of the USB device.

        config TINYUSB_DESC_MANUFACTURER_STRING
            string "Manufacturer name"
            default "Espressif Systems"
            help
                Name of the manufacturer of the USB device.

        config TINYUSB_DESC_PRODUCT_STRING
            string "Product name"
            default "Espressif Device"
            help
                Name of the USB device.

        config TINYUSB_DESC_SERIAL_STRING
            string "Serial string"
            default "123456"
            help
                Serial number of the USB device.

        config TINYUSB_DESC_CDC_STRING
            depends on TINYUSB_CDC_ENABLED
            string "CDC Device String"
            default "Espressif CDC Device"
            help
                Name of the CDC device.

        config TINYUSB_DESC_BTH_STRING
            depends on TINYUSB_BTH_ENABLED
            string "BTH String"
            default "Espressif BTH Device"
            help
                Name of the BTH device.

    endmenu # "Descriptor configuration"

    menu "Communication Device Class (CDC)"
        config TINYUSB_CDC_ENABLED
            bool "Enable TinyUSB CDC feature"
            default n
            help
                Enable TinyUSB CDC feature.

        config TINYUSB_CDC_COUNT
            int "CDC Channel Count"
            default 1
            range 1 2
            depends on TINYUSB_CDC_ENABLED
            help
                Number of independent serial ports.

        config TINYUSB_CDC_RX_BUFSIZE
            depends on TINYUSB_CDC_ENABLED
            int "CDC FIFO size of RX channel"
            default 512
            range 64 10000
            help
                CDC FIFO size of RX channel.

        config TINYUSB_CDC_TX_BUFSIZE
            depends on TINYUSB_CDC_ENABLED
            int "CDC FIFO size of TX channel"
            default 512
            help
                CDC FIFO size of TX channel.
    endmenu # "Communication Device Class"

    menu "Device Firmware Upgrade (DFU)"
        config TINYUSB_DFU_ENABLED
            bool "Enable TinyUSB DFU feature"
            default n
            help
                Enable TinyUSB DFU feature.

        config TINYUSB_DFU_BUFSIZE
            depends on TINYUSB_DFU_ENABLED
            int "DFU XFER BUFFSIZE"
            default 512
            help
                DFU XFER BUFFSIZE.
    endmenu # Device Firmware Upgrade (DFU)

    menu "Bluetooth Host Class (BTH)"
        config TINYUSB_BTH_ENABLED
            bool "Enable TinyUSB BTH feature"
            default n
            help
                Enable TinyUSB BTH feature.

        config TINYUSB_BTH_ISO_ALT_COUNT
            depends on TINYUSB_BTH_ENABLED
            int "BTH ISO ALT COUNT"
            default 0
            help
                BTH ISO ALT COUNT.
    endmenu # "Bluetooth Host Device Class"

    menu "Network driver (ECM/NCM/RNDIS)"
        choice TINYUSB_NET_MODE
            prompt "Network mode"
            default TINYUSB_NET_MODE_NONE
            help
                Select network driver you want to use.

            config TINYUSB_NET_MODE_RNDIS
                bool "RNDIS"

            config TINYUSB_NET_MODE_ECM
                bool "ECM"

            config TINYUSB_NET_MODE_NCM
                bool "NCM"

            config TINYUSB_NET_MODE_NONE
                bool "None"
        endchoice
    endmenu # "Network driver (ECM/NCM/RNDIS)"

endmenu # "TinyUSB Stack"
```

## examples/usb/device/usb_dongle/main/Kconfig.projbuild
```kconfig
menu "Example Configuration"

    config UART_ENABLE
        depends on !TINYUSB_CDCACM_ENABLED
        bool "Use Uart to Communication"
        default y
        help
            Enable Uart.

    config UART_PORT_NUM
        depends on UART_ENABLE
        int "UART port number"
        range 0 2 if IDF_TARGET_ESP32   || IDF_TARGET_ESP32S3
        range 0 1 if IDF_TARGET_ESP32S2 || IDF_TARGET_ESP32C3
        default 2 if IDF_TARGET_ESP32   || IDF_TARGET_ESP32S3
        default 1 if IDF_TARGET_ESP32S2 || IDF_TARGET_ESP32C3
        help
            UART communication port number for the example.
            See UART documentation for available port numbers.

    config UART_BAUD_RATE
        depends on UART_ENABLE
        int "UART communication speed"
        range 1200 115200
        default 115200
        help
            UART communication speed for Modbus example.

    config UART_RXD
        depends on UART_ENABLE
        int "UART RXD pin number"
        range 0 34 if IDF_TARGET_ESP32
        range 0 46 if IDF_TARGET_ESP32S2 || IDF_TARGET_ESP32S3
        range 0 19 if IDF_TARGET_ESP32C3
        default 5
        help
            GPIO number for UART RX pin. See UART documentation for more information
            about available pin numbers for UART.

    config UART_TXD
        depends on UART_ENABLE
        int "UART TXD pin number"
        range 0 34 if IDF_TARGET_ESP32
        range 0 46 if IDF_TARGET_ESP32S2 || IDF_TARGET_ESP32S3
        range 0 19 if IDF_TARGET_ESP32C3
        default 4
        help
            GPIO number for UART TX pin. See UART documentation for more information
            about available pin numbers for UART.

    config TASK_STACK_SIZE
        depends on UART_ENABLE
        int "UART echo example task stack size"
        range 1024 16384
        default 4096
        help
            Defines stack size for UART echo example. Insufficient stack size can cause crash.

endmenu # "Example Configuration"
```

## examples/usb/device/usb_extend_screen/common_components/esp32_p4_function_ev_board/Kconfig
```kconfig
menu "Board Support Package"

    config BSP_ERROR_CHECK
        bool "Enable error check in BSP"
        default y
        help
            Error check assert the application before returning the error code.

    choice
        prompt "Choose Board Type"
        default BSP_BOARD_TYPE_SAMPLE
            config BSP_BOARD_TYPE_FLY_LINE
                bool "Fly Line"

            config BSP_BOARD_TYPE_FIB
                bool "FIB"

            config BSP_BOARD_TYPE_SAMPLE
                bool "Customer Sample"
    endchoice

    menu "I2C"
        config BSP_I2C_NUM
            int "I2C peripheral index"
            default 1
            range 0 1
            help
                ESP32S3 has two I2C peripherals, pick the one you want to use.

        config BSP_I2C_FAST_MODE
            bool "Enable I2C fast mode"
            default y
            help
                I2C has two speed modes: normal (100kHz) and fast (400kHz).

        config BSP_I2C_CLK_SPEED_HZ
            int
            default 400000 if BSP_I2C_FAST_MODE
            default 100000
    endmenu

    menu "SPIFFS - Virtual File System"
        config BSP_SPIFFS_FORMAT_ON_MOUNT_FAIL
            bool "Format SPIFFS if mounting fails"
            default n
            help
                Format SPIFFS if it fails to mount the filesystem.

        config BSP_SPIFFS_MOUNT_POINT
            string "SPIFFS mount point"
            default "/spiffs"
            help
                Mount point of SPIFFS in the Virtual File System.

        config BSP_SPIFFS_PARTITION_LABEL
            string "Partition label of SPIFFS"
            default "storage"
            help
                Partition label which stores SPIFFS.

        config BSP_SPIFFS_MAX_FILES
            int "Max files supported for SPIFFS VFS"
            default 5
            help
                Supported max files for SPIFFS in the Virtual File System.
    endmenu

    menu "SD card - Virtual File System"
        choice
            prompt "Choose Host"
            default BSP_SD_HOST_SPI
            config BSP_SD_HOST_SDMMC
                bool "SDMMC"
            config BSP_SD_HOST_SPI
                bool "SPI"
        endchoice

        config BSP_SD_FORMAT_ON_MOUNT_FAIL
            bool "Format SD card if mounting fails"
            default n
            help
                The SDMMC host will format (FAT) the SD card if it fails to mount the filesystem.

        config BSP_SD_MOUNT_POINT
            string "SD card mount point"
            default "/sdcard"
            help
                Mount point of the SD card in the Virtual File System
    endmenu

    menu "LCD DSI"
        choice
            prompt "Choose LCD Controller"
            default BSP_LCD_CONTROLLER_ILI9881
                config BSP_LCD_CONTROLLER_ILI9881
                    bool "ILI9881"

                config BSP_LCD_CONTROLLER_EK79007
                    bool "EK79007"
        endchoice

        config BSP_LCD_DSI_USE_DMA2D
            bool "Use DMA2D for LCD DSI"
            default y
    endmenu

    config BSP_I2S_NUM
        int "I2S peripheral index"
        default 1
        range 0 1
        help
            ESP32S3 has two I2S peripherals, pick the one you want to use.
endmenu
```
