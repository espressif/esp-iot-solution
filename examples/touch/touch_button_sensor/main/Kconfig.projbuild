## examples/touch/touch_button_sensor/main/Kconfig.projbuild
```kconfig
menu "Touch Button Example"

    config TOUCH_BUTTON_EXAMPLE_CHANNEL_NUM
        int "Touch channel count"
        range 1 4
        default 2
        help
            Number of touch channels used by this example. Set this to the
            number of electrodes wired on the board.

    config TOUCH_BUTTON_EXAMPLE_CHANNEL_1
        int "Touch channel 1"
        range 0 31
        default 6 if IDF_TARGET_ESP32S31
        default 12
        help
            First touch channel used by this example. On ESP32-S31, GPIO12 is
            touch channel 6; the channel ID is not the GPIO number.

    config TOUCH_BUTTON_EXAMPLE_CHANNEL_2
        int "Touch channel 2"
        range 0 31
        default 7 if IDF_TARGET_ESP32S31
        default 13
        help
            Second touch channel used by this example. On ESP32-S31, GPIO13 is
            touch channel 7; the channel ID is not the GPIO number.

    config TOUCH_BUTTON_EXAMPLE_CHANNEL_3
        int "Touch channel 3"
        range 0 31
        default 3
        help
            Third touch channel used by this example.

    config TOUCH_BUTTON_EXAMPLE_CHANNEL_4
        int "Touch channel 4"
        range 0 31
        default 4
        help
            Fourth touch channel used by this example.

    config TOUCH_BUTTON_EXAMPLE_THRESHOLD
        int "Touch threshold"
        range 1 100000
        default 500
        help
            Absolute touch-amplitude threshold. Tune this value for the board
            and electrode using the amplitude printed by the example.

    config TOUCH_BUTTON_EXAMPLE_WS2812_GPIO
        int "WS2812 data GPIO"
        range 0 48
        default 15
        help
            GPIO connected to the WS2812 data input. The first configured touch
            channel is shown red and the second configured channel is shown blue.

    config TOUCH_BUTTON_EXAMPLE_SAMPLE_PERIOD_MS
        int "Sample period (ms)"
        range 0 1000
        default 20
        help
            Requested full-scan period. Set 0 to use the lowlevel default.

    config TOUCH_BUTTON_EXAMPLE_SAMPLE_CFG_NUM
        int "Sample configuration count"
        range 0 1 if IDF_TARGET_ESP32S2 || IDF_TARGET_ESP32S3
        range 0 3
        default 0
        help
            Number of frequency/sample configurations. Set 0 to use the
            target-specific lowlevel default.

    config TOUCH_BUTTON_EXAMPLE_CUSTOM_FREQUENCIES
        bool "Customize V3 frequency tuning"
        depends on IDF_TARGET_ESP32P4 || IDF_TARGET_ESP32S31 || IDF_TARGET_ESP32H4
        default n
        help
            Override the built-in profile's RC and driver settings below.
            Otherwise select Low/High frequency under Component config >
            Touch sensor lowlevel. Frequencies depend on the circuit; tuning
            values are not measured frequencies in Hz.

    config TOUCH_BUTTON_EXAMPLE_FREQ1_CAP
        int "Frequency 0: RC capacitance"
        depends on TOUCH_BUTTON_EXAMPLE_CUSTOM_FREQUENCIES
        range 0 127
        default 100 if TOUCH_SENSOR_LOWLEVEL_V3_SAMPLE_PROFILE_HIGH_FREQ
        default 125

    config TOUCH_BUTTON_EXAMPLE_FREQ1_RES
        int "Frequency 0: RC resistance"
        depends on TOUCH_BUTTON_EXAMPLE_CUSTOM_FREQUENCIES
        range 0 3
        default 3 if TOUCH_SENSOR_LOWLEVEL_V3_SAMPLE_PROFILE_HIGH_FREQ
        default 3

    config TOUCH_BUTTON_EXAMPLE_FREQ1_COARSE
        int "Frequency 0: High driver"
        depends on TOUCH_BUTTON_EXAMPLE_CUSTOM_FREQUENCIES
        range 0 31
        default 5 if TOUCH_SENSOR_LOWLEVEL_V3_SAMPLE_PROFILE_HIGH_FREQ
        default 0

    config TOUCH_BUTTON_EXAMPLE_FREQ1_FINE
        int "Frequency 0: Low driver"
        depends on TOUCH_BUTTON_EXAMPLE_CUSTOM_FREQUENCIES
        range 0 15
        default 1 if TOUCH_SENSOR_LOWLEVEL_V3_SAMPLE_PROFILE_HIGH_FREQ
        default 5

    config TOUCH_BUTTON_EXAMPLE_FREQ2_CAP
        int "Frequency 1: RC capacitance"
        depends on TOUCH_BUTTON_EXAMPLE_CUSTOM_FREQUENCIES
        range 0 127
        default 100 if TOUCH_SENSOR_LOWLEVEL_V3_SAMPLE_PROFILE_HIGH_FREQ
        default 125

    config TOUCH_BUTTON_EXAMPLE_FREQ2_RES
        int "Frequency 1: RC resistance"
        depends on TOUCH_BUTTON_EXAMPLE_CUSTOM_FREQUENCIES
        range 0 3
        default 3 if TOUCH_SENSOR_LOWLEVEL_V3_SAMPLE_PROFILE_HIGH_FREQ
        default 3

    config TOUCH_BUTTON_EXAMPLE_FREQ2_COARSE
        int "Frequency 1: High driver"
        depends on TOUCH_BUTTON_EXAMPLE_CUSTOM_FREQUENCIES
        range 0 31
        default 7 if TOUCH_SENSOR_LOWLEVEL_V3_SAMPLE_PROFILE_HIGH_FREQ
        default 0

    config TOUCH_BUTTON_EXAMPLE_FREQ2_FINE
        int "Frequency 1: Low driver"
        depends on TOUCH_BUTTON_EXAMPLE_CUSTOM_FREQUENCIES
        range 0 15
        default 12 if TOUCH_SENSOR_LOWLEVEL_V3_SAMPLE_PROFILE_HIGH_FREQ
        default 11

    config TOUCH_BUTTON_EXAMPLE_FREQ3_CAP
        int "Frequency 2: RC capacitance"
        depends on TOUCH_BUTTON_EXAMPLE_CUSTOM_FREQUENCIES
        range 0 127
        default 100 if TOUCH_SENSOR_LOWLEVEL_V3_SAMPLE_PROFILE_HIGH_FREQ
        default 125

    config TOUCH_BUTTON_EXAMPLE_FREQ3_RES
        int "Frequency 2: RC resistance"
        depends on TOUCH_BUTTON_EXAMPLE_CUSTOM_FREQUENCIES
        range 0 3
        default 3 if TOUCH_SENSOR_LOWLEVEL_V3_SAMPLE_PROFILE_HIGH_FREQ
        default 3

    config TOUCH_BUTTON_EXAMPLE_FREQ3_COARSE
        int "Frequency 2: High driver"
        depends on TOUCH_BUTTON_EXAMPLE_CUSTOM_FREQUENCIES
        range 0 31
        default 23 if TOUCH_SENSOR_LOWLEVEL_V3_SAMPLE_PROFILE_HIGH_FREQ
        default 1

    config TOUCH_BUTTON_EXAMPLE_FREQ3_FINE
        int "Frequency 2: Low driver"
        depends on TOUCH_BUTTON_EXAMPLE_CUSTOM_FREQUENCIES
        range 0 15
        default 14 if TOUCH_SENSOR_LOWLEVEL_V3_SAMPLE_PROFILE_HIGH_FREQ
        default 7

endmenu
```

## examples/touch/touch_button_sensor/sdkconfig.defaults
```kconfig
CONFIG_LOG_DEFAULT_LEVEL_INFO=y
CONFIG_TOUCH_BUTTON_EXAMPLE_CHANNEL_NUM=2
CONFIG_TOUCH_BUTTON_EXAMPLE_THRESHOLD=500
CONFIG_TOUCH_BUTTON_EXAMPLE_WS2812_GPIO=15
```

## examples/usb/device/bootloader_uf2/bootloader_components/bootloader_uf2/Kconfig
```kconfig
menu "Bootloader UF2 enter config"
    config BOOTLOADER_UF2_GPIO_NUM
        int "GPIO number for UF2 bootloader"
        default 1
        range 0 46 if IDF_TARGET_ESP32S2
        range 0 48 if IDF_TARGET_ESP32S3
        range 0 54 if IDF_TARGET_ESP32P4
        range 0 62 if IDF_TARGET_ESP32S31
        help
            The GPIO number to use for enter the UF2 bootloader.

    config BOOTLOADER_UF2_GPIO_LEVEL
        bool "GPIO level for enter the UF2 bootloader"
        default 0
        help
            The GPIO level to use for enter the UF2 bootloader.

    config BOOTLOADER_UF2_GPIO_PULL_TIME_SECONDS
        int "GPIO pull time for enter the UF2 bootloader (seconds)"
        default 1
        help
            The GPIO pull time to use for enter the UF2 bootloader.

    config UF2_OTA_RESET_REASON_VALUE
        hex "OTA Reset Reason Value"
        default 0xF2
        help
            The reset value for uf2 ota reset.

endmenu
```

## examples/usb/device/usb_extend_screen/main/Kconfig.projbuild
```kconfig
menu "Example Configuration"

    menu "TinyUSB Configuration"

        config TUSB_VID
            hex "USB Device VID"
            default 0x303A
        config TUSB_PID
            hex "USB Device PID"
            default 0x2986 if HID_TOUCH_ENABLE || UAC_AUDIO_ENABLE
            default 0x2987 if !HID_TOUCH_ENABLE && !UAC_AUDIO_ENABLE
        config TUSB_MANUFACTURER
            string "USB Device Manufacture"
            default "Espressif"
        config TUSB_PRODUCT
            string "Product Name"
            default "Vendor"

        choice TINYUSB_RHPORT
            depends on IDF_TARGET_ESP32P4 || IDF_TARGET_ESP32S31
            prompt "TinyUSB PHY"
            default TINYUSB_RHPORT_HS
            help
                Allows set the USB PHY Controller for TinyUSB: HS (USB OTG2.0 PHY for HighSpeed).

            config TINYUSB_RHPORT_HS
                bool "HS"
        endchoice

    endmenu

    menu "USB extend screen configuration"
        config USB_EXTEND_SCREEN_JPEG_QUALITY
            int "USB extend screen jpeg quality"
            default 6
            range 1 10
            help
                USB extend screen jpeg quality

        config USB_EXTEND_SCREEN_MAX_FPS
            int "USB extend screen max fps"
            default 60 if IDF_TARGET_ESP32P4
            default 60 if IDF_TARGET_ESP32S31
            default 15 if IDF_TARGET_ESP32S3
            default 30
            range 1 60
            help
                USB extend screen max fps

        config USB_EXTEND_SCREEN_FRAME_LIMIT_B
            int "Maximum frame image (B)"
            default 300000 if IDF_TARGET_ESP32P4
            default 300000 if IDF_TARGET_ESP32S31
            default 100000 if IDF_TARGET_ESP32S3
            default 100000
            help
                The maximum length of a single frame image transmitted from Windows.
    endmenu

    config USB_TASK_PRIORITY
        int "USB Task Priority"
        default 6
        range 1 15
        help
            TinyUSB main task priority

    config VENDOR_TASK_PRIORITY
        int "Vendor Task Priority"
        default 5
        range 1 15
        help
            Task to receive JPG data from PC

    config HID_TOUCH_ENABLE
        bool "Enable HID Touch Report"
        depends on ESP_BOARD_DEV_LCD_TOUCH_SUPPORT
        default y
        help
            Enable this option to allow HID touch events to be reported.
            The selected Board Manager board must provide a device named lcd_touch.
            If disabled, touch events will not be processed or sent.

    config HID_TASK_PRIORITY
        int "HID Task Priority"
        depends on  HID_TOUCH_ENABLE
        default 5
        range 1 15
        help
            Task to transmit touch data to PC

    config TOUCH_TASK_PRIORITY
        int "Touch Task Priority"
        depends on  HID_TOUCH_ENABLE
        default 5
        range 1 15
        help
            Task to read touch data from i2s

    config UAC_AUDIO_ENABLE
        bool "Enable UAC Audio"
        depends on ESP_BOARD_DEV_AUDIO_CODEC_SUPPORT
        default y
        help
            Enable this option to allow UAC audio to be processed.
            The selected Board Manager board must provide audio_dac and audio_adc
            devices. If disabled, audio will not be processed or sent.

    config UAC_MIC_GAIN_DB
        int "UAC microphone gain (dB)"
        depends on UAC_AUDIO_ENABLE && UAC_MIC_CHANNEL_NUM > 0
        range 0 42
        default 24
        help
            Set the codec microphone input gain in dB. The actual gain may be
            rounded to the nearest value supported by the selected codec.

    config EXAMPLE_ENABLE_PRINT_FPS_RATE_VALUE
        bool "enable print fps rate value"
        default y

    config EXAMPLE_LCD_BUF_COUNT
        int "LCD Buffer Count"
        depends on IDF_TARGET_ESP32P4 || IDF_TARGET_ESP32S31
        default 2
        range 1 3

endmenu
```

## examples/usb/device/usb_extend_screen/sdkconfig.defaults.esp32p4
```kconfig
CONFIG_EXAMPLE_LCD_BUF_COUNT=3
CONFIG_COMPILER_ORPHAN_SECTIONS_PLACE=y
CONFIG_BOOTLOADER_LOG_LEVEL_WARN=y
CONFIG_FREERTOS_HZ=1000
CONFIG_IDF_EXPERIMENTAL_FEATURES=y
CONFIG_COMPILER_OPTIMIZATION_PERF=y
CONFIG_CACHE_L2_CACHE_256KB=y
CONFIG_CACHE_L2_CACHE_LINE_128B=y
CONFIG_UAC_SPEAKER_CHANNEL_NUM=2
CONFIG_UAC_MIC_CHANNEL_NUM=2
CONFIG_UAC_SAMPLE_RATE=48000
CONFIG_UAC_BIT_RESOLUTION_16=y
CONFIG_UAC_SPK_INTERVAL_MS=10
CONFIG_UAC_MIC_INTERVAL_MS=10
CONFIG_UAC_SPK_NEW_PLAY_INTERVAL=100
```

## examples/usb/device/usb_extend_screen/sdkconfig.defaults.esp32s3
```kconfig
CONFIG_COMPILER_OPTIMIZATION_PERF=y
CONFIG_SPIRAM_FETCH_INSTRUCTIONS=y
CONFIG_SPIRAM_RODATA=y
CONFIG_IDF_EXPERIMENTAL_FEATURES=y
CONFIG_ESP32S3_DATA_CACHE_LINE_64B=y

CONFIG_USB_EXTEND_SCREEN_JPEG_QUALITY=4

CONFIG_UAC_SPEAKER_CHANNEL_NUM=2
CONFIG_UAC_MIC_CHANNEL_NUM=2
CONFIG_UAC_SAMPLE_RATE=16000
CONFIG_UAC_BIT_RESOLUTION_16=y
CONFIG_UAC_SPK_INTERVAL_MS=10
CONFIG_UAC_MIC_INTERVAL_MS=10
CONFIG_UAC_SPK_NEW_PLAY_INTERVAL=100
```

## examples/usb/device/usb_extend_screen/sdkconfig.defaults.esp32s31
```kconfig
CONFIG_IDF_EXPERIMENTAL_FEATURES=y
CONFIG_COMPILER_OPTIMIZATION_PERF=y

CONFIG_SPIRAM_XIP_FROM_PSRAM=y
CONFIG_SPIRAM_MEMTEST=n
CONFIG_SPIRAM_MALLOC_RESERVE_INTERNAL=12768
CONFIG_SPIRAM_ALLOW_BSS_SEG_EXTERNAL_MEMORY=y
CONFIG_SPIRAM_ALLOW_NOINIT_SEG_EXTERNAL_MEMORY=y

CONFIG_FREERTOS_HZ=1000

CONFIG_TINYUSB_RHPORT_HS=y
CONFIG_HID_TOUCH_ENABLE=y
CONFIG_ESP_LCD_TOUCH_MAX_POINTS=5
CONFIG_UAC_SPEAKER_CHANNEL_NUM=2
CONFIG_UAC_MIC_CHANNEL_NUM=2
CONFIG_UAC_SAMPLE_RATE=48000
CONFIG_UAC_BIT_RESOLUTION_16=y
CONFIG_UAC_SPK_INTERVAL_MS=10
CONFIG_UAC_MIC_INTERVAL_MS=10
CONFIG_UAC_SPK_NEW_PLAY_INTERVAL=100

CONFIG_USB_EXTEND_SCREEN_MAX_FPS=60
CONFIG_USB_EXTEND_SCREEN_FRAME_LIMIT_B=300000
CONFIG_EXAMPLE_LCD_BUF_COUNT=2
```
