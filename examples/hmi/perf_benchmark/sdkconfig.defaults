## examples/lighting/lightbulb/main/Kconfig.projbuild
```kconfig
menu "Lightbulb Demo Configuration"

    choice LIGHTBULB_DEMO_DRIVER_SELECT
            bool "Demo select"
            default LIGHTBULB_DEMO_DRIVER_SELECT_WS2812 if IDF_TARGET_ESP32C3 || IDF_TARGET_ESP32S2 || IDF_TARGET_ESP32S3 || IDF_TARGET_ESP32H2 || IDF_TARGET_ESP32C6
            default LIGHTBULB_DEMO_DRIVER_SELECT_PWM
            help
                Select the driver type you want to demonstrate

            config LIGHTBULB_DEMO_DRIVER_SELECT_SM2135E
                bool "Demo SM2135E"
            config LIGHTBULB_DEMO_DRIVER_SELECT_WS2812
                bool "Demo WS2812"
            config LIGHTBULB_DEMO_DRIVER_SELECT_PWM
                bool "Demo PWM"
    endchoice

    config WS2812_LED_GPIO
        int "WS2812 LED GPIO"
        default 8 if IDF_TARGET_ESP32C3 || IDF_TARGET_ESP32H2 || IDF_TARGET_ESP32C6
        default 18 if IDF_TARGET_ESP32S2
        default 48 if IDF_TARGET_ESP32S3
        default 4 if IDF_TARGET_ESP32C2
        default 18
        depends on LIGHTBULB_DEMO_DRIVER_SELECT_WS2812
        help
            Set the WS2812 RGB LED GPIO.

    config WS2812_LED_NUM
        int "WS2812 LED NUM"
        default 1
        depends on LIGHTBULB_DEMO_DRIVER_SELECT_WS2812
        help
            Set the WS2812 LED NUM.

    config PWM_FREQ_HZ
        int "PWM Frequency (hz)"
        default 4000
        range 2000 5000
        depends on LIGHTBULB_DEMO_DRIVER_SELECT_PWM
        help
            Set the PWM Frequency (hz).

    config PWM_RED_GPIO
        int "PWM Red GPIO"
        default 10 if IDF_TARGET_ESP32C3 || IDF_TARGET_ESP32S2 || IDF_TARGET_ESP32C6
        default 15 if IDF_TARGET_ESP32S3
        default 0 if IDF_TARGET_ESP32C2
        default 23 if IDF_TARGET_ESP32H2
        default 25
        depends on LIGHTBULB_DEMO_DRIVER_SELECT_PWM
        help
            Set the PWM Red LED GPIO.

    config PWM_GREEN_GPIO
        int "PWM Green GPIO"
        default 6 if IDF_TARGET_ESP32C3 || IDF_TARGET_ESP32S2 || IDF_TARGET_ESP32C6
        default 16 if IDF_TARGET_ESP32S3
        default 1 if IDF_TARGET_ESP32C2
        default 24 if IDF_TARGET_ESP32H2
        default 26
        depends on LIGHTBULB_DEMO_DRIVER_SELECT_PWM
        help
            Set the PWM Green LED GPIO.

    config PWM_BLUE_GPIO
        int "PWM Blue GPIO"
        default 7 if IDF_TARGET_ESP32C3 || IDF_TARGET_ESP32S2 || IDF_TARGET_ESP32C6
        default 17 if IDF_TARGET_ESP32S3
        default 8 if IDF_TARGET_ESP32C2
        default 25 if IDF_TARGET_ESP32H2
        default 27
        depends on LIGHTBULB_DEMO_DRIVER_SELECT_PWM
        help
            Set the PWM Blue LED GPIO.

    config SM2135E_IIC_CLK_GPIO
        int "SM2135E IIC CLK GPIO"
        default 4
        depends on LIGHTBULB_DEMO_DRIVER_SELECT_SM2135E
        help
            Set the SM2135E CLK GPIO.

    config SM2135E_IIC_SDA_GPIO
        int "SM2135E IIC SDA GPIO"
        default 5
        depends on LIGHTBULB_DEMO_DRIVER_SELECT_SM2135E
        help
            Set the SM2135E SDA GPIO.

endmenu
```

## examples/lighting/lightbulb/sdkconfig.defaults
```kconfig
#
# LightBulb Driver Config
#
CONFIG_LB_NOTIFY_TASK_STACK=1536
#
# Drivers
#
CONFIG_ENABLE_PWM_DRIVER=y
CONFIG_ENABLE_SM2135E_DRIVER=y
CONFIG_ENABLE_SM2135EH_DRIVER=y
CONFIG_ENABLE_SM2x35EGH_DRIVER=y
CONFIG_ENABLE_BP5758D_DRIVER=y
CONFIG_ENABLE_WS2812_DRIVER=y
# end of Drivers

#
# Debug Log Config
#
CONFIG_LIGHTBULB_CHECK_DEFAULT_LEVEL_3=y
```

## examples/lowpower_evb/main/Kconfig.projbuild
```kconfig
menu "Lowpower EVB settings"

    config LOWPOWER_EVB_TASK_STACK
        int "Set lowpower evb task stack size"
        default 4096
        help
            "Set lowpower evb task stack size"

    choice WAKE_UP_TYPE
        bool "Wake up type"
        default ULP_WAKE_UP
        help
            "Select the wake up type"

    config ULP_WAKE_UP
        bool "ulp wake up"
    config GPIO_WAKE_UP
        bool "gpio wake up"
    config TIMER_WAKE_UP
        bool "timer wake up"
    endchoice

    config WAKEUP_TIME_US
        depends on TIMER_WAKE_UP
        int "wake up time(us)"
        default 5000000
        help
            "Set wake up time, a 64-bit unsigned value"

    choice WIFI_CONFIGURE
        bool "WiFi configure mode"
        default USE_ESP_TOUCH_CONFIG
        help
            "Select WiFi configure mode"

    config USE_ESP_TOUCH_CONFIG
        bool "esp-touch"
    config USE_FIXED_ROUTER
        bool "fixed router"
    endchoice
    
    config FIXED_ROUTER_SSID
	    depends on USE_FIXED_ROUTER
	    string "Set SSID of fixed router"
	    default "router_ssid"
	    help
	        "Set SSID of fixed router"

	config FIXED_ROUTER_PASSWORD
	    depends on USE_FIXED_ROUTER
	    string "Set password of fixed router"
	    default "router_password"
	    help
	        "Set password of fixed router"
            
    config SERVER_IP
        string "Set server IP to connect to"
        default "192.168.111.116"
        help
            "Set server IP to connect to"

    config SERVER_PORT
        int "Set server port to connect to"
        default 8000
        help
            "Set server port to connect to"

    config UPLOAD_DATA_SIZE
        int "Set upload data size"
        default 2048
        help
            "Set upload data size"
            
    config READ_SENSOR_VALUE_NUM
        int "Read sensor value number"
        range 0 600
        default 20
        help
            "Set sensor value number need to read, can not greater than 600"

    config READ_SENSOR_INTERVAL
		int "Read sensor interval(ms)"
		default 200
		help
		    "Set read sensor interval"

    config ENABLE_EPAPER
        bool "Enable E-ink"
        default n
        help
            "Enable E-ink"
endmenu
```

## examples/lowpower_evb/sdkconfig.defaults
```kconfig
#
# IoT Solution settings
#

#
# IoT Components Management
#

CONFIG_STATUS_LED_NIGHT_MODE_TIMER=2
CONFIG_ESP32_ULP_COPROC_ENABLED=y
CONFIG_ESP32_ULP_COPROC_RESERVE_MEM=1024

#
# General functions
#
CONFIG_IOT_DAC_AUDIO_ENABLE=
CONFIG_IOT_TOUCH_ENABLE=y
CONFIG_IOT_ULP_ENABLE=
CONFIG_IOT_LOWPOWER_APP_FRAMEWORK_ENABLE=y
CONFIG_IOT_BUTTON_ENABLE=y
CONFIG_IOT_DEBUG_ENABLE=
CONFIG_IOT_LED_ENABLE=y
CONFIG_IOT_LIGHT_ENABLE=
CONFIG_IOT_OTA_FUNC_ENABLE=
CONFIG_IOT_PARAM_ENABLE=y
CONFIG_IOT_POWER_METER_ENABLE=
CONFIG_IOT_RELAY_ENABLE=
CONFIG_IOT_WEEKLY_TIMER_ENABLE=

#
# I2C devices
#
CONFIG_IOT_APDS9960_ENABLE=y
CONFIG_IOT_AT24C02_ENABLE=
CONFIG_IOT_BME280_ENABLE=
CONFIG_IOT_CH450_ENABLE=
CONFIG_IOT_IS31FL3XXX_ENABLE=
CONFIG_IOT_MCP23017_ENABLE=
CONFIG_IOT_OLED_ENABLE=y
CONFIG_IOT_BH1750_ENABLE=y
CONFIG_IOT_HTS221_ENABLE=y
CONFIG_IOT_LIS2DH12_ENABLE=
CONFIG_IOT_MVH3004D_ENABLE=

#
# SPI devices
#
CONFIG_IOT_LCD_ENABLE=
CONFIG_IOT_EINK_ENABLE=y

#
# Network and Protocols
#
CONFIG_IOT_MQTT_ENABLE=
CONFIG_IOT_TCP_CLASS_ENABLE=y
CONFIG_IOT_UDP_CLASS_ENABLE=

#
# Platforms and Clouds
#
CONFIG_IOT_ALINK_ENABLE=
CONFIG_IOT_JOYLINK_ENABLE=

#
# WiFi abstract
#
CONFIG_IOT_SMARTCONFIG_ABSTRACT_ENABLE=y
CONFIG_IOT_WIFI_ABSTRACT_ENABLE=y

#
# Enable ULP
#
CONFIG_ULP_COPROC_ENABLED=y
CONFIG_ULP_COPROC_RESERVE_MEM=5120
```

## examples/mcp/mcp_client/main/Kconfig
```kconfig
menu "Example Configuration"
    config MCP_REMOTE_HOST
        string "Remote MCP server host"
        default "192.168.1.100"
        help
            Hostname or IP, or a full origin such as https://dashscope.aliyuncs.com
            (do not also add a scheme in code; port still applies unless it matches the
            default for the scheme: 443 for https, 80 for http).

    config MCP_REMOTE_PORT
        int "Remote MCP server port"
        range 1 65535
        default 8080
        help
            Remote MCP server port.

    config MCP_REMOTE_EP
        string "Remote MCP endpoint name"
        default "mcp_server"
        help
            Remote MCP endpoint name, used as HTTP path: POST /<endpoint>.

    config MCP_TRANSPORT_TIME
        int "MCP communication timeout in milliseconds"
        range 1000 30000
        default 5000
        help
            Set the time to wait for communication timeout in milliseconds.

    config MCP_DEMO_RESOURCES
        bool "Enable resources/* demo requests"
        default n
        help
            Send resources/list, resources/templates/list and resources/read
            after initialize. Useful when remote server exposes resource APIs.

    config MCP_DEMO_RESOURCE_URI
        string "Demo resources/read URI"
        default "resource://device/status"
        depends on MCP_DEMO_RESOURCES
        help
            URI used by the resources/read demo request.

    config MCP_DEMO_PROMPTS
        bool "Enable prompts/* demo requests"
        default n
        help
            Send prompts/list and prompts/get after initialize. Useful when
            remote server exposes prompt APIs.

    config MCP_DEMO_PROMPT_NAME
        string "Demo prompts/get name"
        default "status_prompt"
        depends on MCP_DEMO_PROMPTS
        help
            Prompt name used by the prompts/get demo request.

    config MCP_TOOLS_LIST_PAGINATION
        bool "Enable tools/list pagination demo"
        default y
        help
            Repeatedly call tools/list with nextCursor until exhausted or
            max pages reached.

    config MCP_TOOLS_LIST_MAX_PAGES
        int "Max tools/list pages"
        range 1 10
        default 3
        depends on MCP_TOOLS_LIST_PAGINATION
        help
            Maximum number of tools/list pages requested in one run.

    config MCP_DYNAMIC_TOOL_CALL
        bool "Enable dynamic tools/call from tools/list result"
        default y
        help
            Call the first tool name discovered in tools/list results using
            empty JSON args {}.

endmenu
```

## examples/mcp/mcp_client/sdkconfig.defaults
```kconfig
CONFIG_COMPILER_OPTIMIZATION_SIZE=y
CONFIG_BOOTLOADER_COMPILER_OPTIMIZATION_PERF=y
CONFIG_BOOTLOADER_LOG_LEVEL_NONE=y
CONFIG_ESPTOOLPY_FLASHSIZE_4MB=y
CONFIG_PARTITION_TABLE_CUSTOM=y
CONFIG_PARTITION_TABLE_CUSTOM_FILENAME="partitions.csv"

CONFIG_EXAMPLE_WIFI_SSID="Redmi_7BDB_2.4G"
CONFIG_EXAMPLE_WIFI_PASSWORD="12345678"

CONFIG_MCP_REMOTE_HOST="https://dashscope.aliyuncs.com"
CONFIG_MCP_REMOTE_PORT=443
CONFIG_MCP_REMOTE_EP="api/v1/mcps/mcp-MjZlNmJkYmIwYTJh/mcp"

CONFIG_MCP_HTTP_AUTH_ENABLE=y
CONFIG_MCP_HTTP_AUTH_BEARER_TOKEN="sk-04cee741b28641dda094ddc20044ceb3"
```

## examples/mcp/mcp_server/main/Kconfig
```kconfig
menu "Example Configuration"
    config MCP_HOST
        string "MCP host"
        default "0.0.0.0"
        help
            Set the MCP host address.

    config MCP_URI
        string "MCP URI"
        default "/mcp_server"
        help
            Set the MCP URI path.

    config MCP_PORT
        int "MCP Port"
        default 8080
        help
            Set the MCP port.

    config MCP_TRANSPORT_TIME
        int "MCP communication timeout in milliseconds"
        range 1000 30000
        default 5000
        help
            Set the time to wait for communication timeout. Use a value big enough to avoid retransmissions.

endmenu
```

## examples/mcp/mcp_server/sdkconfig.defaults
```kconfig
CONFIG_BOOTLOADER_COMPILER_OPTIMIZATION_PERF=y
CONFIG_BOOTLOADER_LOG_LEVEL_NONE=y
CONFIG_ESPTOOLPY_FLASHSIZE_4MB=y
CONFIG_PARTITION_TABLE_CUSTOM=y
CONFIG_PARTITION_TABLE_CUSTOM_FILENAME="partitions.csv"

CONFIG_EXAMPLE_WIFI_SSID="Redmi_7BDB_2.4G"
CONFIG_EXAMPLE_WIFI_PASSWORD="12345678"
```

## examples/motor/bldc_fan_rainmaker/components/esp_sensorless_bldc_control/test_apps/bldc_adc/sdkconfig.defaults
```kconfig
# For IDF 5.0
CONFIG_ESP_DEFAULT_CPU_FREQ_MHZ_240=y
CONFIG_FREERTOS_HZ=1000
CONFIG_ESP_TASK_WDT_EN=n

# For IDF4.4
CONFIG_ESP32S2_DEFAULT_CPU_FREQ_240=y
CONFIG_ESP32S3_DEFAULT_CPU_FREQ_240=y
CONFIG_ESP_TASK_WDT=n
```
