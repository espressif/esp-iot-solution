## examples/hmi/perf_benchmark/sdkconfig.defaults
```kconfig
# For IDF 5.0
CONFIG_ESP_TASK_WDT_EN=n

CONFIG_ESPTOOLPY_FLASHSIZE_4MB=y
CONFIG_PARTITION_TABLE_CUSTOM=y
CONFIG_FREERTOS_HZ=1000
CONFIG_LV_COLOR_16_SWAP=y
CONFIG_LV_MEM_SIZE_KILOBYTES=128
CONFIG_LV_MEM_BUF_MAX_NUM=10
```

## examples/hmi/ugfx_example/sdkconfig.defaults
```kconfig
#
# IoT Solution settings
#


#
# IoT Components Management
#


#
# I2C devices
#
CONFIG_IOT_APDS9960_ENABLE=y
CONFIG_IOT_AT24C02_ENABLE=y
CONFIG_IOT_BME280_ENABLE=y
CONFIG_IOT_CH450_ENABLE=y
CONFIG_IOT_HT16C21_ENABLE=y
CONFIG_IOT_IS31FL3XXX_ENABLE=y
CONFIG_IOT_MCP23017_ENABLE=y
CONFIG_IOT_OLED_ENABLE=y
CONFIG_IOT_BH1750_ENABLE=y
CONFIG_IOT_HTS221_ENABLE=y
CONFIG_IOT_LIS2DH12_ENABLE=y
CONFIG_IOT_MVH3004D_ENABLE=y
CONFIG_IOT_VEML6040_ENABLE=y
CONFIG_IOT_HDC2010_ENABLE=y
CONFIG_IOT_FT5X06_ENABLE=y

#
# SPI devices
#
CONFIG_IOT_LCD_ENABLE=y
CONFIG_IOT_EINK_ENABLE=y
CONFIG_IOT_TOUCH_SCREEN_ENABLE=y

#
# I2S devices
#
CONFIG_IOT_LCD_NT35510_ENABLE=y
CONFIG_IOT_LCD_ILI9806_ENABLE=
CONFIG_BIT_MODE_16BIT=y
CONFIG_BIT_MODE_8BIT=

#
# HMI components
#
CONFIG_UGFX_GUI_ENABLE=y

#
# uGFX Settings
#
CONFIG_UGFX_PROJ_RESOURCE_PATH="resource/include"
CONFIG_UGFX_USE_CUSTOM_DRIVER=
CONFIG_UGFX_USE_CONFIGURED_OPTIONS=y
CONFIG_UGFX_DRIVER_TOUCH_SCREEN_ENABLE=y
CONFIG_UGFX_LCD_DRIVER_FRAMEBUFFER_MODE=y
CONFIG_UGFX_LCD_DRIVER_API_MODE=
CONFIG_UGFX_DRIVER_AUTO_FLUSH_ENABLE=y
CONFIG_UGFX_DRIVER_AUTO_FLUSH_INTERVAL=200
CONFIG_UGFX_DISP_ROTATE_0=
CONFIG_UGFX_DISP_ROTATE_90=
CONFIG_UGFX_DISP_ROTATE_180=
CONFIG_UGFX_DISP_ROTATE_270=y

#
# Config Driver
#
CONFIG_UGFX_DRIVER_SCREEN_WIDTH=480
CONFIG_UGFX_DRIVER_SCREEN_HEIGHT=800
CONFIG_UGFX_DRIVER_TOUCH_XPT2046=
CONFIG_UGFX_DRIVER_TOUCH_FT5X06=y
CONFIG_UGFX_DRIVER_ILI9341=
CONFIG_UGFX_DRIVER_SSD1306=
CONFIG_UGFX_DRIVER_ST7789=
CONFIG_UGFX_DRIVER_NT35510=y
CONFIG_UGFX_DRIVER_EPAPER=

#
# ESP32-specific
#
CONFIG_ESP32_DEFAULT_CPU_FREQ_80=
CONFIG_ESP32_DEFAULT_CPU_FREQ_160=y
CONFIG_ESP32_DEFAULT_CPU_FREQ_240=
CONFIG_SPIRAM_SUPPORT=y

#
# SPI RAM config
#
CONFIG_SPIRAM_SPEED_80M=y

#
# FreeRTOS
#
CONFIG_FREERTOS_HZ=1000
CONFIG_FREERTOS_ASSERT_FAIL_PRINT_CONTINUE=y
```

## examples/hmi/ugfx_keyboard/sdkconfig.defaults
```kconfig
#
# IoT Components Management
#


#
# SPI devices
#
CONFIG_IOT_LCD_ENABLE=y
CONFIG_IOT_EINK_ENABLE=y
CONFIG_IOT_TOUCH_SCREEN_ENABLE=y

#
# HMI Components
#
CONFIG_LVGL_GUI_ENABLE=
CONFIG_UGFX_GUI_ENABLE=y
CONFIG_SELECT_NONE=

#
# uGFX Settings
#
CONFIG_UGFX_PROJ_RESOURCE_PATH="resource/include"
CONFIG_UGFX_USE_CUSTOM_DRIVER=
CONFIG_UGFX_USE_CONFIGURED_OPTIONS=y
CONFIG_UGFX_DRIVER_TOUCH_SCREEN_ENABLE=y
CONFIG_UGFX_DRIVER_TOGGLE_ENABLE=
CONFIG_UGFX_LCD_DRIVER_FRAMEBUFFER_MODE=y
CONFIG_UGFX_LCD_DRIVER_API_MODE=
CONFIG_UGFX_DRIVER_AUTO_FLUSH_ENABLE=y
CONFIG_UGFX_DRIVER_AUTO_FLUSH_INTERVAL=200
CONFIG_UGFX_DISP_ROTATE_0=
CONFIG_UGFX_DISP_ROTATE_90=y
CONFIG_UGFX_DISP_ROTATE_180=
CONFIG_UGFX_DISP_ROTATE_270=

#
# Config Driver
#
CONFIG_UGFX_DRIVER_TOUCH_XPT2046=y
CONFIG_UGFX_DRIVER_TOUCH_FT5X06=

#
# XPT2046 Touch Screen Pin Configuration
#
CONFIG_UGFX_TOUCH_CS_GPIO=32
CONFIG_UGFX_TOUCH_IRQ_GPIO=33
CONFIG_UGFX_DRIVER_ILI9341=
CONFIG_UGFX_DRIVER_SSD1306=
CONFIG_UGFX_DRIVER_ST7789=y
CONFIG_UGFX_DRIVER_NT35510=

#
# ST7789 Screen Pin Configuration
#
CONFIG_UGFX_LCD_HSPI=y
CONFIG_UGFX_LCD_VSPI=
CONFIG_UGFX_LCD_SPI_NUM=1
CONFIG_UGFX_LCD_SPI_CLOCK=20000000
CONFIG_UGFX_LCD_MISO_GPIO=27
CONFIG_UGFX_LCD_MOSI_GPIO=21
CONFIG_UGFX_LCD_CLK_GPIO=22
CONFIG_UGFX_LCD_CS_GPIO=5
CONFIG_UGFX_LCD_DC_GPIO=19
CONFIG_UGFX_LCD_RESET_GPIO=18
CONFIG_UGFX_LCD_BL_GPIO=23
CONFIG_ST7789_UGFX_DRIVER_SCREEN_WIDTH=240
CONFIG_ST7789_UGFX_DRIVER_SCREEN_HEIGHT=320
CONFIG_UGFX_DRIVER_SCREEN_WIDTH=240
CONFIG_UGFX_DRIVER_SCREEN_HEIGHT=320

#
# ESP32-specific
#
CONFIG_ESP32_DEFAULT_CPU_FREQ_80=
CONFIG_ESP32_DEFAULT_CPU_FREQ_160=y
CONFIG_ESP32_DEFAULT_CPU_FREQ_240=
CONFIG_ESP32_DEFAULT_CPU_FREQ_MHZ=160

#
# FreeRTOS
#
CONFIG_FREERTOS_HZ=1000
```

## examples/hmi/ugfx_sokoban/sdkconfig.defaults
```kconfig
#
# IoT Components Management
#


#
# I2C devices
#
CONFIG_IOT_FT5X06_ENABLE=y

#
# SPI devices
#
CONFIG_IOT_LCD_ENABLE=y
CONFIG_IOT_EINK_ENABLE=y
CONFIG_IOT_TOUCH_SCREEN_ENABLE=y

#
# I2S devices
#
CONFIG_IOT_LCD_NT35510_ENABLE=y
CONFIG_IOT_LCD_ILI9806_ENABLE=
CONFIG_BIT_MODE_16BIT=y
CONFIG_BIT_MODE_8BIT=

#
# HMI components
#
CONFIG_UGFX_GUI_ENABLE=y

#
# uGFX Settings
#
CONFIG_UGFX_PROJ_RESOURCE_PATH="resource/include"
CONFIG_UGFX_USE_CUSTOM_DRIVER=
CONFIG_UGFX_USE_CONFIGURED_OPTIONS=y
CONFIG_UGFX_DRIVER_TOUCH_SCREEN_ENABLE=y
CONFIG_UGFX_LCD_DRIVER_FRAMEBUFFER_MODE=y
CONFIG_UGFX_LCD_DRIVER_API_MODE=
CONFIG_UGFX_DRIVER_AUTO_FLUSH_ENABLE=y
CONFIG_UGFX_DRIVER_AUTO_FLUSH_INTERVAL=200
CONFIG_UGFX_DISP_ROTATE_0=
CONFIG_UGFX_DISP_ROTATE_90=y
CONFIG_UGFX_DISP_ROTATE_180=
CONFIG_UGFX_DISP_ROTATE_270=

#
# Config Driver
#
CONFIG_UGFX_DRIVER_SCREEN_WIDTH=480
CONFIG_UGFX_DRIVER_SCREEN_HEIGHT=800
CONFIG_UGFX_DRIVER_TOUCH_XPT2046=
CONFIG_UGFX_DRIVER_TOUCH_FT5X06=y
CONFIG_UGFX_DRIVER_ILI9341=
CONFIG_UGFX_DRIVER_SSD1306=
CONFIG_UGFX_DRIVER_ST7789=
CONFIG_UGFX_DRIVER_NT35510=y
CONFIG_UGFX_DRIVER_EPAPER=

#
# SPI RAM config
#
CONFIG_SPIRAM_SUPPORT=y

#
# FreeRTOS
#
CONFIG_FREERTOS_HZ=1000
```

## examples/indicator/ws2812_strips/main/Kconfig.projbuild
```kconfig
menu "Example Configuration"

    config EXAMPLE_WS2812_GPIO_NUM
        int "WS2812 GPIO number"
        default 8 if IDF_TARGET_ESP32C3 || IDF_TARGET_ESP32H2
        default 18 if IDF_TARGET_ESP32S2
        default 48 if IDF_TARGET_ESP32S3
        default 8 if IDF_TARGET_ESP32C6
        default 1
        help
          GPIO number (IOxx) to blink on and off or the RMT signal for the addressable LED.
          Some GPIOs are used for other purposes (flash connections, etc.) and cannot be used to blink.

    config EXAMPLE_WS2812_STRIPS_NUM
        int "Number of strips"
        default 1
        help
          Number of strips to control.

    config EXAMPLE_ENABLE_CONSOLE_CONTROL
      bool "Enable console control"
      default n

endmenu
```

## examples/keyboard/components/esp32_s3_kbd_kit/Kconfig
```kconfig
menu "Board Support Package"

    config BSP_ERROR_CHECK
        bool "Enable error check in BSP"
        default y
        help
            Error check assert the application before returning the error code.

    menu "SPIFFS - Virtual File System"
        config BSP_SPIFFS_FORMAT_ON_MOUNT_FAIL
            bool "Format SPIFFS if mounting fails"
            default n
            help
                Format SPIFFS if it fails to mount the filesystem.

        config BSP_SPIFFS_MOUNT_POINT
            string "SPIFFS mount point"
            default "/spiffs"
            help
                Mount point of SPIFFS in the Virtual File System.

        config BSP_SPIFFS_PARTITION_LABEL
            string "Partition label of SPIFFS"
            default "storage"
            help
                Partition label which stores SPIFFS.

        config BSP_SPIFFS_MAX_FILES
            int "Maximum files that could be open at the same time"
            default 2
            help
                Supported max files for SPIFFS in the Virtual File System.
    endmenu

    menu "uSD card - Virtual File System"
        config BSP_uSD_FORMAT_ON_MOUNT_FAIL
            bool "Format uSD card if mounting fails"
            default n
            help
                The SDMMC host will format (FAT) the uSD card if it fails to mount the filesystem.

        config BSP_SD_MOUNT_POINT
            string "uSD card mount point"
            default "/sdcard"
            help
                Mount point of the uSD card in the Virtual File System

    endmenu
    menu "Display"
        config BSP_DISPLAY_BRIGHTNESS_LEDC_CH
            int "LEDC channel index"
            default 1
            range 0 7
            help
                LEDC channel is used to generate PWM signal that controls display brightness.
                Set LEDC index that should be used.

        choice
            prompt "LCD type"
            default BSP_LCD_ILI9341
            help
                Wrover-kit is shipped with two different LCD controllers, pick the one you want to use.

            config BSP_LCD_ST7789
                bool "ST7789"
            config BSP_LCD_ILI9341
                bool "ILI9341"
        endchoice
    endmenu
endmenu
```

## examples/keyboard/main/Kconfig.projbuild
```kconfig
menu "ESP KeyBoard Example"

    menu "USB Configuration"
        config TUSB_VID
            hex "USB Device VID"
            default 0x303A
        config TUSB_PID
            hex "USB Device PID"
            default 0x8000
        config TUSB_MANUFACTURER
            string "USB Device Manufacture"
            default "Espressif"
        config TUSB_PRODUCT
            string "Product Name"
            default "HID Demo"
    endmenu

    menu "Wireless Configuration"
        config LIGHT_SLEEP_TIMEOUT_MS
            int "Light Sleep Timeout"
            default 60000
            help
                "Time to enter light sleep mode and close all light when no key is pressed"

        config ESP_MAX_CPU_FREQ_MHZ
            int "PM max CPU frequency (MHz) for BLE HID"
            default 96 if IDF_TARGET_ESP32H4
            default 240
            help
                Maximum CPU frequency used by esp_pm_configure() when BLE HID is active.

        config ESP_MIN_CPU_FREQ_MHZ
            int "PM min CPU frequency (MHz) for BLE HID"
            default 32 if IDF_TARGET_ESP32H4
            default 160
            help
                Minimum CPU frequency used by esp_pm_configure() when BLE HID is active.
    endmenu

    config KEYBOARD_BATTERY_ADC_ENABLE
        bool "Enable battery ADC monitor"
        default n if IDF_TARGET_ESP32H4
        default y
        help
            Enables the ADC battery monitor task and BLE battery level reporting.

    config KEYBOARD_KEY_OUTPUT_SWITCH_ENABLE
        bool "Enable key-based output mode switch"
        default n if KEYBOARD_HW_MODE_SWITCH_ENABLE
        default y
        help
            Enables QK_OUTPUT_USB / QK_OUTPUT_BLUETOOTH
            keycodes to switch HID output mode. Disable this when a hardware
            mode switch owns output mode selection.

    menu "Hardware mode switch"
        depends on IDF_TARGET_ESP32H4

        config KEYBOARD_HW_MODE_SWITCH_ENABLE
            bool "Enable hardware mode switch (GPIO13/14)"
            default y
            help
                Two valid positions: left = BLE, center = USB.
                Other switch positions fall back to USB.

        config KEYBOARD_HW_MODE_GPIO_SW_L
            int "Mode switch SW_L GPIO"
            depends on KEYBOARD_HW_MODE_SWITCH_ENABLE
            default 13

        config KEYBOARD_HW_MODE_GPIO_SW_R
            int "Mode switch SW_R GPIO"
            depends on KEYBOARD_HW_MODE_SWITCH_ENABLE
            default 14

        config KEYBOARD_HW_MODE_GPIO_INTERNAL_PULLUP
            bool "Enable internal pull-ups for mode switch GPIOs"
            depends on KEYBOARD_HW_MODE_SWITCH_ENABLE
            default y
            help
                Supplements the external V_BAT pull-ups when the board is powered by USB only.
    endmenu

endmenu
```

## examples/keyboard/sdkconfig.defaults.esp32h4
```kconfig
# ESP32-H4: BLE HID keyboard via NimBLE host (switch to Bluedroid in menuconfig if needed)
CONFIG_BT_ENABLED=y
CONFIG_BT_NIMBLE_ENABLED=y
CONFIG_BT_BLE_42_FEATURES_SUPPORTED=y
# NimBLE host HID GATT (IDF stack option; app code uses CONFIG_BT_NIMBLE_ENABLED only)
CONFIG_BT_NIMBLE_HID_SERVICE=y
# Keyboard HID descriptor: 3 keyboard reports + 6 lighting feature reports
CONFIG_BT_NIMBLE_SVC_HID_MAX_RPTS=12
# ble_svc_hid_params on stack (~3.7KB with 12 reports); default 4096 overflows
CONFIG_BT_NIMBLE_HOST_TASK_STACK_SIZE=8192
# nimble_hid_start_gatts in esp_ble_hidd_dev_init runs on main; ble_svc_hid_add copies params by value
CONFIG_ESP_MAIN_TASK_STACK_SIZE=8192
CONFIG_BT_NIMBLE_NVS_PERSIST=y

# Low-power baseline aligned with ESP-IDF power_save (esp32h4)
CONFIG_BT_CTRL_SLEEP_ENABLE=y
CONFIG_BT_LE_LP_CLK_SRC_DEFAULT=y
CONFIG_PM_DFS_INIT_AUTO=y
CONFIG_PM_POWER_DOWN_PERIPHERAL_IN_LIGHT_SLEEP=y
CONFIG_ESP_SLEEP_POWER_DOWN_FLASH=y
CONFIG_ESP_SLEEP_CACHE_SAFE_ASSERTION=y
CONFIG_RTC_CLK_SRC_EXT_CRYS=y

# Run FreeRTOS on Core 0 only
CONFIG_FREERTOS_UNICORE=y
# CONFIG_ESP_TASK_WDT_CHECK_IDLE_TASK_CPU1 is not set

# PM CPU frequency range for BLE HID (hid_transport.c)
CONFIG_ESP_MAX_CPU_FREQ_MHZ=96
CONFIG_ESP_MIN_CPU_FREQ_MHZ=32

# Battery ADC calibration is not enabled on ESP32-H4 yet.
CONFIG_KEYBOARD_BATTERY_ADC_ENABLE=n
```

## examples/keyboard/sdkconfig.defaults.esp32s3
```kconfig
# Keyboard HID descriptor: 3 keyboard reports + 6 lighting feature reports
CONFIG_BT_NIMBLE_SVC_HID_MAX_RPTS=12
# ble_svc_hid_params on stack (~3.7KB with 12 reports); default 4096 overflows
CONFIG_BT_NIMBLE_HOST_TASK_STACK_SIZE=8192
# nimble_hid_start_gatts in esp_ble_hidd_dev_init runs on main; ble_svc_hid_add copies params by value
CONFIG_ESP_MAIN_TASK_STACK_SIZE=8192
```

## examples/lighting/dali/sdkconfig.defaults
```kconfig
CONFIG_ESPTOOLPY_FLASHSIZE_4MB=y
CONFIG_PARTITION_TABLE_TWO_OTA=y
CONFIG_RMT_RECV_FUNC_IN_IRAM=y
CONFIG_RMT_TX_ISR_CACHE_SAFE=y
CONFIG_RMT_RX_ISR_CACHE_SAFE=y
CONFIG_ESP_HTTPS_OTA_ALLOW_HTTP=y
CONFIG_ESP_TASK_WDT_EN=y
CONFIG_FREERTOS_HZ=1000
```

## examples/lighting/indicator/gpio/main/Kconfig.projbuild
```kconfig
menu "Example Configuration"

    config EXAMPLE_GPIO_NUM
        int "GPIO number"
        default 1
        help
          GPIO number to use for example.

    config EXAMPLE_GPIO_ACTIVE_LEVEL
        bool "GPIO active level"
        default y
        help
          GPIO active level.

    config EXAMPLE_ENABLE_CONSOLE_CONTROL
        bool "Enable console control"
        default n

endmenu
```

## examples/lighting/indicator/rgb/main/Kconfig.projbuild
```kconfig
menu "Example Configuration"

    config EXAMPLE_GPIO_RED_NUM
        int "GPIO red number"
        default 1
        help
          GPIO red number to use for example.

    config EXAMPLE_GPIO_GREEN_NUM
        int "GPIO green number"
        default 2
        help
          GPIO green number to use for example.

    config EXAMPLE_GPIO_BLUE_NUM
        int "GPIO blue number"
        default 3
        help
          GPIO blue number to use for example.

    config EXAMPLE_LEDC_RED_CHANNEL
        int "LED RED channel"
        default 0
        help
          LED RGD channel to use for example.

    config EXAMPLE_LEDC_GREEN_CHANNEL
        int "LED GREEN channel"
        default 1
        help
          LED GREEN channel to use for example.

    config EXAMPLE_LEDC_BLUE_CHANNEL
        int "LED BLUE channel"
        default 2
        help
          LED BLUE channel to use for example.

    config EXAMPLE_GPIO_ACTIVE_LEVEL
        bool "GPIO active level"
        default y
        help
          GPIO active level.

    config EXAMPLE_ENABLE_CONSOLE_CONTROL
      bool "Enable console control"
      default n

endmenu
```
