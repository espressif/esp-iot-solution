/* ULP Example: using ADC in deep sleep

   This example code is in the Public Domain (or CC0 licensed, at your option.)

   Unless required by applicable law or agreed to in writing, this
   software is distributed on an "AS IS" BASIS, WITHOUT WARRANTIES OR
   CONDITIONS OF ANY KIND, either express or implied.

   This file contains assembly code which runs on the ULP.

   ULP wakes up to run this code at a certain period, determined by the values
   in SENS_ULP_CP_SLEEP_CYCx_REG registers. On each wake up, the program
   measures input voltage on the given ADC channel 'adc_oversampling_factor'
   times. Measurements are accumulated and average value is calculated.
   Average value is compared to the two thresholds: 'low_thr' and 'high_thr'.
   If the value is less than 'low_thr' or more than 'high_thr', ULP wakes up
   the chip from deep sleep.
*/

/* ULP assembly files are passed through C preprocessor first, so include directives
   and C macros may be used in these files 
 */
#include "soc/rtc_cntl_reg.h"
#include "soc/soc_ulp.h"

	/* ADC1 channel 6, GPIO34 */
	.set adc_channel, 6

	/* Configure the number of ADC samples to average on each measurement.
	   For convenience, make it a power of 2. */
	.set adc_oversampling_factor_log, 2
	.set adc_oversampling_factor, (1 << adc_oversampling_factor_log)

.data 	/* .data section */

.global thermistor_lut
thermistor_lut:
		.long 0x0D33	//3379		-5 degree centigrade
		.long 0x0D1F	//3359		-4 
		.long 0x0D0C	//3340		-3 
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		.long 0xffff	//table end

	/* Define variables, which go into .bss section (zero-initialized data) */
	.bss

	.global last_result
last_result:
	.long 0

	.global temperature
temperature:
	.long 0

	/* Code goes into .text section */
	.text
	.global entry
entry:
	/* do measurements using ADC */
	/* r0 will be used as accumulator */
	move r0, 0
	/* initialize the loop counter */
	stage_rst
measure:
	/* measure and add value to accumulator */
	adc r1, 0, adc_channel + 1
	add r0, r0, r1
	/* increment loop counter and check exit condition */
	stage_inc 1
	jumps measure, adc_oversampling_factor, lt

	/* divide accumulator by adc_oversampling_factor.
	   Since it is chosen as a power of two, use right shift */
	rsh r0, r0, adc_oversampling_factor_log
	/* averaged value is now in r0; store it into last_result */
	move r3, last_result
	st r0, r3, 0

	move r3, temperature
	ld r1, r3, 0
	/* initialize temperature every calculate loop */
	move r1, 0 
	st r1, r3, 0
	/* use r3 as thermistor_lut pointer */
	move r3, thermistor_lut 
look_up_table:
	/* load table data in R2 */
	ld r2, r3, 0 

	/* check if at the table_end */
	sub	r1, r2, 0xffff
	/* if hit the tail of table, jump to table_end */
	jump out_of_range, eq
	
	/* thermistor_lut - last_result */
	sub r2, r0, r2
	/* adc_value < table_value */
	jump move_step, ov 
	/* adc_value > table_value, get current value */
	jump wake_up
out_of_range:
	move r1, temperature
	ld r2, r1, 0
	/* Maximum range 100 degree centigrade */
	move r2, 105 
	st r2, r1, 0
	jump wake_up
move_step:
	/* move pointer a step */
	add r3, r3, 1 

	move r1, temperature
	ld r2, r1, 0
	/* temperature count 1 */
	add r2, r2, 1 
	st r2, r1, 0
	jump look_up_table

	/* value within range, end the program */
	.global exit
exit:
	halt

	.global wake_up
wake_up:
	/* Check if the system can be woken up */
	READ_RTC_FIELD(RTC_CNTL_LOW_POWER_ST_REG, RTC_CNTL_RDY_FOR_WAKEUP)

	and r0, r0, 1
	jump exit, eq

	/* Wake up the SoC, end program */
	wake
	WRITE_RTC_FIELD(RTC_CNTL_STATE0_REG, RTC_CNTL_ULP_CP_SLP_TIMER_EN, 0)
	halt
