## examples/bluetooth/ble_conn_mgr/ble_spp/spp_client/main/Kconfig.projbuild
```kconfig
menu "Example Configuration"
    config EXAMPLE_BLE_ADV_NAME
    string "Advertisement name"
    default "ESP_SPP_SERVER"
    help
      The device name inside advertisement.

    config EXAMPLE_BLE_SUB_ADV
    string "Subsequent advertisement data"
    default "SUB_ADV"
    help
      The data inside subsequent advertisements.
endmenu
```

## examples/bluetooth/ble_conn_mgr/ble_spp/spp_client/sdkconfig.defaults
```kconfig
# Override some defaults so BT stack is enabled
# by default in this example
CONFIG_BT_ENABLED=y
CONFIG_BT_NIMBLE_ENABLED=y

CONFIG_BLE_CONN_MGR_ROLE_CENTRAL=y
```

## examples/bluetooth/ble_l2cap_coc/l2cap_coc_central/sdkconfig.defaults
```kconfig
# Override some defaults so BT stack is enabled
# in this example
CONFIG_BT_ENABLED=y
CONFIG_BTDM_CTRL_MODE_BLE_ONLY=y
CONFIG_BT_NIMBLE_ENABLED=y
CONFIG_BT_NIMBLE_L2CAP_COC_MAX_NUM=1
CONFIG_BT_NIMBLE_MSYS_1_BLOCK_COUNT=30
CONFIG_BT_NIMBLE_MSYS_1_BLOCK_SIZE=512
CONFIG_BLE_CONN_MGR_ROLE_CENTRAL=y
```

## examples/bluetooth/ble_l2cap_coc/l2cap_coc_peripheral/main/Kconfig.projbuild
```kconfig
menu "Example Configuration"
    config EXAMPLE_BLE_ADV_NAME
      string "Advertisement name"
      default "BLE_L2CAP_COC_PERIPH"
      help
        The device name inside advertisement (max 29 characters).

    config EXAMPLE_BLE_SUB_ADV
      string "Subsequent advertisement data"
      default "SUB_ADV"
      help
        The data inside subsequent advertisements (max 29 characters).

    config EXAMPLE_L2CAP_COC_PSM
        hex "L2CAP CoC PSM (Protocol/Service Multiplexer)"
        range 0x0001 0x00FF
        default 0x00EF
        help
            Protocol/Service Multiplexer value for L2CAP Connection-Oriented Channel.
            Valid range: 0x0001-0x00FF (1-255)
            - 0x0001-0x007F: Fixed Bluetooth SIG-defined services
            - 0x0080-0x00FF: Dynamic custom services
            Both central and peripheral must use the same PSM value to establish a connection.

endmenu
```

## examples/bluetooth/ble_ota/main/Kconfig.projbuild
```kconfig
menu "Example Configuration"

    choice EXAMPLE_OTA_SECURITY_VERSION
        bool "Protocomm security version"
        default EXAMPLE_OTA_SECURITY_VERSION_2
        help
            OTA component offers 3 security versions.
            The example offers a choice between security version 1 and 2.

        config EXAMPLE_OTA_SECURITY_VERSION_1
            bool "Security version 1"
            select ESP_PROTOCOMM_SUPPORT_SECURITY_VERSION_1

        config EXAMPLE_OTA_SECURITY_VERSION_2
            bool "Security version 2"
            select ESP_PROTOCOMM_SUPPORT_SECURITY_VERSION_2
    endchoice

    choice EXAMPLE_OTA_MODE
        bool "Security version 2 mode"
        depends on EXAMPLE_OTA_SECURITY_VERSION_2
        default EXAMPLE_OTA_SEC2_DEV_MODE

        config EXAMPLE_OTA_SEC2_DEV_MODE
            bool "Security version 2 development mode"
            depends on EXAMPLE_OTA_SECURITY_VERSION_2
            help
                This enables the development mode for
                security version 2.
                Please note that this mode is NOT recommended for production purpose.

        config EXAMPLE_OTA_SEC2_PROD_MODE
            bool "Security version 2 production mode"
            depends on EXAMPLE_OTA_SECURITY_VERSION_2
            help
                This enables the production mode for
                security version 2.
    endchoice

    choice EXAMPLE_OTA_TYPE
        prompt "Type of OTA"
        default EXAMPLE_OTA_WITHOUT_SECURITY

        config EXAMPLE_OTA_WITHOUT_SECURITY
            bool "Use OTA without security"
            help
                This transfers file without any security using OTA

        config EXAMPLE_USE_PROTOCOMM
            bool "Use protocomm layer for security"
            depends on BT_NIMBLE_ENABLED
            help
                This enables protocomm level security to transfer file via OTA

        config EXAMPLE_USE_PRE_ENC_OTA
            bool "Use Pre-Encrypted OTA"
            depends on BT_NIMBLE_ENABLED
            help
                This enables transferring pre-encrypted file via OTA

        config EXAMPLE_USE_DELTA_OTA
            bool "Use Delta OTA"
            help
                This enables transferring patch file via Delta OTA
    endchoice

    config EXAMPLE_EXTENDED_ADV
        bool
        default y if SOC_ESP_NIMBLE_CONTROLLER
        select BT_NIMBLE_EXT_ADV
        prompt "Enable Extended Adv"
        depends on BT_NIMBLE_ENABLED && !IDF_TARGET_ESP32
        help
            Use this option to enable extended advertising in the example
endmenu
```

## examples/bluetooth/ble_ota/sdkconfig.defaults
```kconfig
# Override some defaults so BT stack is enabled
# by default in this example
CONFIG_BT_ENABLED=y
CONFIG_BTDM_CTRL_MODE_BLE_ONLY=y
CONFIG_BTDM_CTRL_MODE_BR_EDR_ONLY=n
CONFIG_BTDM_CTRL_MODE_BTDM=n

#
# Partition Table
#
# CONFIG_PARTITION_TABLE_SINGLE_APP is not set
# CONFIG_PARTITION_TABLE_TWO_OTA is not set
CONFIG_PARTITION_TABLE_CUSTOM=y
CONFIG_PARTITION_TABLE_CUSTOM_FILENAME="partitions.csv"
CONFIG_PARTITION_TABLE_FILENAME="partitions.csv"
CONFIG_PARTITION_TABLE_OFFSET=0x8000
CONFIG_PARTITION_TABLE_MD5=y
# end of Partition Table

CONFIG_ESPTOOLPY_FLASHSIZE_4MB=y

CONFIG_BT_BLE_42_FEATURES_SUPPORTED=y
```

## examples/bluetooth/ble_profiles/ble_anp/main/Kconfig.projbuild
```kconfig
menu "Example Configuration"
    config EXAMPLE_BLE_ADV_NAME
	string "Advertisement name"
	default "BLE_ANS"
	help
	  The device name inside advertisement.

    config EXAMPLE_BLE_SUB_ADV
	string "Subsequent advertisement data"
	default "SUB_ADV"
	help
	  The data inside subsequent advertisements.

    config EXAMPLE_BLE_SUB_SCAN
	string "Subsequent scan responses data"
	default "SUB_SCAN"
	help
	  The data inside subsequent scan responses.
endmenu
```

## examples/bluetooth/ble_profiles/ble_htp/sdkconfig.defaults
```kconfig
# Override some defaults so BT stack is enabled
# by default in this example
CONFIG_BT_ENABLED=y
CONFIG_BT_NIMBLE_ENABLED=y

CONFIG_BLE_CONN_MGR_ROLE_CENTRAL=y
CONFIG_BLE_HEALTH_THERMOMETER_PROFILES=y
```

## examples/bluetooth/ble_profiles/ble_midi/ble_midi_peripheral/main/Kconfig.projbuild
```kconfig
menu "Example Configuration"
    config EXAMPLE_BLE_ADV_NAME
        string "Advertisement name"
        default "BLE_MIDI"
        help
            The device name inside advertisement. Keep it reasonably short
            (typically under 20-30 characters) to fit within BLE advertisement constraints.

    config EXAMPLE_BLE_SUB_ADV
        string "Subsequent advertisement data"
        default ""
        help
            Additional data to include in subsequent BLE advertisements (e.g., manufacturer-specific data).

endmenu
```

## examples/bluetooth/ble_profiles/ble_ota/main/Kconfig.projbuild
```kconfig
menu "Example Configuration"
    config EXAMPLE_BLE_OTA_RAW_DEVICE_NAME
        string "Device name"
        default "ESP-C919"
        help
            BLE advertising device name used by ble_conn_mgr.
endmenu
```

## examples/bluetooth/ble_profiles/ble_ota/sdkconfig.defaults
```kconfig
# Enable BT/NimBLE and BLE connection OTA profile by default
CONFIG_BT_ENABLED=y
CONFIG_BT_NIMBLE_ENABLED=y
CONFIG_BLE_OTA_RAW_PROFILE=y
CONFIG_ESPTOOLPY_FLASHSIZE_4MB=y
CONFIG_BT_NIMBLE_ATT_PREFERRED_MTU=515
CONFIG_BT_NIMBLE_LOG_LEVEL_WARNING=y

#
# Partition Table
#
CONFIG_PARTITION_TABLE_CUSTOM=y
CONFIG_PARTITION_TABLE_CUSTOM_FILENAME="partitions.csv"
CONFIG_PARTITION_TABLE_FILENAME="partitions.csv"
CONFIG_PARTITION_TABLE_OFFSET=0x8000
CONFIG_PARTITION_TABLE_MD5=y
# end of Partition Table
```

## examples/bluetooth/ble_profiles/ble_otp/ble_otp_client/main/Kconfig.projbuild
```kconfig
menu "Example Configuration"
    config EXAMPLE_BLE_DEVICE_NAME
        string "Device name"
        default "BLE_OTP_CLIENT"
        help
            The device name used by the BLE connection manager.

    config EXAMPLE_BLE_SUB_ADV
        string "Subsequent advertisement data"
        default "SUB_ADV"
        help
            The data inside subsequent advertisements.

    config EXAMPLE_PEER_NAME
        string "Peer Device Name"
        default "BLE_OTP_SERVER"
        help
            The device name to match in advertising data for connection.

    config EXAMPLE_OTP_PSM
        hex "OTP L2CAP CoC PSM (Protocol/Service Multiplexer)"
        range 0x0001 0x00FF
        default 0x0025
        help
            Protocol/Service Multiplexer value for Object Transfer Channel.
            Both client and server must use the same PSM value.
endmenu
```

## examples/bluetooth/ble_profiles/ble_otp/ble_otp_client/sdkconfig.defaults
```kconfig
# Override some defaults so BT stack is enabled
# by default in this example
CONFIG_BT_ENABLED=y
CONFIG_BT_NIMBLE_ENABLED=y

CONFIG_BLE_CONN_MGR_ROLE_CENTRAL=y
CONFIG_BLE_OTS=y
CONFIG_BLE_OBJECT_TRANSFER_PROFILE=y

CONFIG_NIMBLE_L2CAP_COC_MAX_NUM=1
CONFIG_BT_NIMBLE_MSYS_1_BLOCK_COUNT=30
CONFIG_BT_NIMBLE_MSYS_1_BLOCK_SIZE=512
```

## examples/bluetooth/ble_remote_control/main/Kconfig.projbuild
```kconfig
menu "Example Configuration"

    config BOARD_BUTTON_GPIO
        int "Boot Button GPIO"
        default 0 if !IDF_TARGET_ESP32C3
        default 9 if IDF_TARGET_ESP32C3
        help
            GPIO number on which the "Boot" button is connected. This is generally used
            by the application for custom operations like toggling states, resetting to defaults, etc.

    choice JOYSTICK_INPUT_MODE
        prompt "Joystick Input Mode"
        default JOYSTICK_INPUT_MODE_ADC
        help
            Select the mode of joystick input.

        config JOYSTICK_INPUT_MODE_ADC
            bool "ADC"
            help
                Use ADC to read joystick input, using external hardware

        config JOYSTICK_INPUT_MODE_CONSOLE
            bool "Console"
            help
                Read from console to emulate joystick input.
    endchoice

    choice BUTTON_INPUT_MODE
        prompt "Button Input Mode"
        default BUTTON_INPUT_MODE_BOOT
        help
            Select the mode of button input.

        config BUTTON_INPUT_MODE_GPIO
            bool "GPIO"
            help
                Use GPIO to read button input, using external hardware

        config BUTTON_INPUT_MODE_BOOT
            bool "Boot"
            help
                Use boot button as button input.

    endchoice

    config EXAMPLE_ENABLE_TEAR_DOWN_DEMO
        bool "Demo Tear Down"
        depends on BUTTON_INPUT_MODE_GPIO
        default n
        help
            Enable this option to demonstrate tear down when the tear down button bitmask combination is pressed.
            Need external buttons with pull-up resistors connected to GPIOs.

    config BUTTON_PIN_A
        int "Button A GPIO"
        depends on BUTTON_INPUT_MODE_GPIO
        default 4
        help
            GPIO pin number on which the "Button A" is connected.

    config BUTTON_PIN_B
        int "Button B GPIO"
        depends on BUTTON_INPUT_MODE_GPIO
        default 5
        help
            GPIO pin number on which the "Button B" is connected.

    config BUTTON_PIN_C
        int "Button C GPIO"
        depends on BUTTON_INPUT_MODE_GPIO
        default 6
        help
            GPIO pin number on which the "Button C" is connected.

    config BUTTON_PIN_D
        int "Button D GPIO"
        depends on BUTTON_INPUT_MODE_GPIO
        default 7
        help
            GPIO pin number on which the "Button D" is connected.

endmenu
```

## examples/bluetooth/ble_services/ble_dis/main/Kconfig.projbuild
```kconfig
menu "Example Configuration"
    config EXAMPLE_BLE_ADV_NAME
    string "Advertisement name"
    default "BLE_DIS"
    help
      The device name inside advertisement.

    config EXAMPLE_BLE_SUB_ADV
    string "Subsequent advertisement data"
    default "SUB_ADV"
    help
      The data inside subsequent advertisements.

    config EXAMPLE_BLE_DIS_INFO
    bool "Settings Device Information"
    default y
    help
      Enable to settings the device information.

endmenu
```

## examples/bluetooth/ble_services/ble_dis/sdkconfig.defaults
```kconfig
# Override some defaults so BT stack is enabled
# by default in this example
CONFIG_BT_ENABLED=y
CONFIG_BT_NIMBLE_ENABLED=y

CONFIG_BLE_CONN_MGR_ROLE_PERIPHERAL=y
CONFIG_BLE_DIS=y
CONFIG_BLE_DIS_SERIAL_NUMBER=y
CONFIG_BLE_DIS_FW_REV=y
CONFIG_BLE_DIS_HW_REV=y
CONFIG_BLE_DIS_SW_REV=y
CONFIG_BLE_DIS_PNP=y
```

## examples/bluetooth/ble_services/ble_hrs/main/Kconfig.projbuild
```kconfig
menu "Example Configuration"
    config EXAMPLE_BLE_ADV_NAME
    string "Advertisement name"
    default "BLE_HRS"
    help
      The device name inside advertisement.

    config EXAMPLE_BLE_SUB_ADV
    string "Subsequent advertisement data"
    default "SUB_ADV"
    help
      The data inside subsequent advertisements.

    config EXAMPLE_BLE_HRS_ROLE
    bool "Heart Rate Sensor Role"
    depends on BLE_DIS
    help
      Enable Heart Rate Sensor Role which instantiate one and only one Heart Rate Service and instantiate one Device Information Service.
endmenu
```

## examples/bluetooth/ble_services/ble_hrs/sdkconfig.defaults
```kconfig
# Override some defaults so BT stack is enabled
# by default in this example
CONFIG_BT_ENABLED=y
CONFIG_BT_NIMBLE_ENABLED=y

CONFIG_BLE_CONN_MGR_ROLE_PERIPHERAL=y
CONFIG_BLE_HRS=y
CONFIG_BLE_HRS_BODY_SENSOR_LOCATION=y
CONFIG_BLE_HRS_CONTROL_POINT=y
```

## examples/bluetooth/ble_services/ble_hts/main/Kconfig.projbuild
```kconfig
menu "Example Configuration"
    config EXAMPLE_BLE_ADV_NAME
    string "Advertisement name"
    default "BLE_HTS"
    help
      The device name inside advertisement.

    config EXAMPLE_BLE_SUB_ADV
    string "Subsequent advertisement data"
    default "SUB_ADV"
    help
      The data inside subsequent advertisements.

    config EXAMPLE_BLE_THERMOMETER_ROLE
    bool "Thermometer Role"
    depends on BLE_DIS
    help
      Enable Thermometer Role which instantiate one and only one Health Thermometer Service and instantiate one Device Information Service.
endmenu
```

## examples/bluetooth/ble_services/ble_ots/main/Kconfig.projbuild
```kconfig
menu "Example Configuration"
    config EXAMPLE_BLE_ADV_NAME
      string "Advertisement name"
      default "BLE_OTS"
      help
        The device name inside advertisement (max 29 characters).

    config EXAMPLE_BLE_SUB_ADV
      string "Subsequent advertisement data"
      default "SUB_ADV"
      help
        The data inside subsequent advertisements.
endmenu
```
