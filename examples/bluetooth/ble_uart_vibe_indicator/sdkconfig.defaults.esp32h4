## examples/common_components/boards/esp32s3_usb_otg_ev/Kconfig.in
```kconfig
if BOARD_ESP32S3_USB_OTG_EV

    config BOARD_SPI3_INIT
        bool "init spi3 during board init"
        default n
        help
            if yes, spi3 will be initialized with default configuration during board initialize,
            then, you can use iot_board_get_handle to get the bus handle.

    config BOARD_ADC_INIT
        bool "init adc during board init"
        default n
        help
            if yes, adc for voltage monitoring will be configured.

endif
```

## examples/common_components/web_wifi/Kconfig.projbuild
```kconfig
menu "4G Modem WiFi Config"
    config ESP_WIFI_STA_SSID
        string "WiFi STA SSID"
        default ""
        help
            WiFi SSID (network name) to connect to or empty for Off.

    config ESP_WIFI_STA_PASSWORD
        string "WiFi STA Password"
        default ""
        help
            WiFi Password if WEP/WPA/WPA2 or empty if Open.

    config ESP_WIFI_AP_SSID
        string "WiFi AP SSID"
        default "ESP-USB-4G"
        help
            AP SSID (network name) to create or empty for Off.

    config ESP_WIFI_AP_PASSWORD
        string "WiFi AP Password"
        default ""
        help
            AP password for WPA2 or empty for Open.

    config ESP_WIFI_AP_CHANNEL
        int "WiFi AP Channel"
        default 6
        range 1 13
        help
            AP channel for better connection performance.

    choice
        prompt "WiFi Bandwidth"
        default WIFI_BANDWIFTH_40

        config WIFI_BANDWIFTH_20
            bool "20MHz"
        config WIFI_BANDWIFTH_40
            bool "40MHz"
    endchoice

    config MODEM_WIFI_MAX_STA
        int "Maximal STA connections"
        default 10
        help
            Max number of the STA connects to AP.

    config SERVER_IP
        string "WiFi AP IP Address"
        default "192.168.4.1"
        help
            IP address that the ESP will assign to it's AP interface. You can use this IP to connect to the camera after flashing.

    config ESP_MAXIMUM_RETRY
        int "Maximum retry"
        default 5
        help
            Set the Maximum retry to avoid station reconnecting to the AP unlimited when the AP is really inexistent.

    config EXAMPLE_ENABLE_WEB_ROUTER
        bool "Open web configuration"
        default y
        help
            Open the web router, you can configure the system parameters

    config EXAMPLE_WEB_MOUNT_POINT
        string "Website mount point in VFS"
        default "/spiffs"
        depends on EXAMPLE_ENABLE_WEB_ROUTER
        help
            Specify the mount point in VFS.

    config EXAMPLE_WEB_USERNAME
        string "Default login username"
        default "esp32"
        depends on EXAMPLE_ENABLE_WEB_ROUTER
        help
            Default username for logging in to the server.

    config EXAMPLE_WEB_PASSWORD
        string "Default login password"
        default "12345678"
        depends on EXAMPLE_ENABLE_WEB_ROUTER
        help
            Default password for logging in to the server.


endmenu
```

## examples/decompress/xz_compressed_ota/main/Kconfig.projbuild
```kconfig
menu "Example Configuration"
    choice CONFIG_EXAMPLE_DOWNLOAD_MODE
        prompt "Download Mode"
        default EXAMPLE_HTTP_DOWNLOAD
        help
            Select the communication method for downloading compressed firmware.

        config EXAMPLE_HTTP_DOWNLOAD
            bool "Http Download"
            help
                Use Http(WiFi/Eth) to download compressed image.
        
        config EXAMPLE_BLE_DOWNLOAD
            bool "BLE Download"
            select BT_ENABLED
            help
                Use BLE to download compressed image.
    endchoice
    
    config EXAMPLE_FIRMWARE_UPG_URL
        string "Firmware Upgrade URL"
        default "https://192.168.2.106:8070/hello-world.bin"
        depends on EXAMPLE_HTTP_DOWNLOAD
        help
            URL of server which hosts the firmware image.

    config EXAMPLE_SKIP_COMMON_NAME_CHECK
        bool "Skip server certificate CN fieldcheck"
        default y
        depends on EXAMPLE_HTTP_DOWNLOAD
        help
            This allows you to skip the validation of OTA server certificate CN field.

    config EXAMPLE_OTA_RECV_TIMEOUT
        int "OTA Receive Timeout"
        default 5000
        depends on EXAMPLE_HTTP_DOWNLOAD
        help
            Maximum time for reception

    config EXAMPLE_APP_ENCRY_ENABLED
        bool "Enable compressed app encryption"
        default n
        help
            This allows you to encrypt the compressed app bin.

    config APP_ENCRY_KEY
        string "The encryption key."
        default "encryption_key.bin"
        depends on EXAMPLE_APP_ENCRY_ENABLED
        
    choice CONFIG_EXAMPLE_APP_ENCTY_TYPE
        prompt "APP Entryption Type"
        default EXAMPLE_USE_AES128
        depends on EXAMPLE_APP_ENCRY_ENABLED
        help
            Select the algorithm to encrypt.

        config EXAMPLE_USE_AES128
            bool "AES128"
            help
                Use AES128 to encry compressed app bin.
    endchoice

    choice APP_ENCRY_KEY_STORE_LOACTION
        bool "The location used to store encrypt key"
        depends on EXAMPLE_APP_ENCRY_ENABLED
        default AES_KEY_STORE_IN_FLASH
        help
            Chose the location to store the encrypt key.

        config AES_KEY_STORE_IN_FLASH
            bool "AES Entrypt Key Store in Flash"
    
        config AES_KEY_STORE_IN_EFUSE
            bool "AES Entrypt Key Store in Efuse"
        
    endchoice

    config EXAMPLE_CLEAR_STORAGE_IF_CHECK_FAILED
        bool "Clear the storage partition if OTA header check fail"
        default n
        help
            Verify the stored compressed data. If the verification fails, enable this optin will clear some data of the compressed partition
            to avoid checking the compressed data again in the bootloader.
endmenu
```

## examples/decompress/xz_compressed_ota/sdkconfig.defaults
```kconfig
# Default sdkconfig parameters to use the OTA
# partition table layout, with a 4MB flash size
CONFIG_ESPTOOLPY_FLASHSIZE_4MB=y

CONFIG_BOOTLOADER_COMPILER_OPTIMIZATION_SIZE=y

CONFIG_PARTITION_TABLE_CUSTOM=y
CONFIG_PARTITION_TABLE_CUSTOM_FILENAME="partition_for_diff_ota.csv"
CONFIG_PARTITION_TABLE_FILENAME="partition_for_diff_ota.csv"
CONFIG_PARTITION_TABLE_OFFSET=0xd000

CONFIG_BOOTLOADER_DECOMPRESSOR_XZ=y
CONFIG_BOOTLOADER_DIFF_ENABLED=y
CONFIG_BOOTLOADER_DIFF_DDELTA=y
```

## examples/display/gui/common/hw_init/Kconfig.projbuild
```kconfig
menu "Hardware Configuration"

choice EXAMPLE_LCD_INTERFACE
    prompt "LCD Interface Type"
    default EXAMPLE_LCD_INTERFACE_MIPI_DSI if IDF_TARGET_ESP32P4
    default EXAMPLE_LCD_INTERFACE_SPI_WITH_PSRAM if IDF_TARGET_ESP32S3
    default EXAMPLE_LCD_INTERFACE_SPI_WITHOUT_PSRAM if IDF_TARGET_ESP32C3
    default EXAMPLE_LCD_INTERFACE_SPI_WITH_PSRAM
    help
        Select the LCD interface type for your display.
        Resolution and input device will be set automatically based on the interface.

    config EXAMPLE_LCD_INTERFACE_MIPI_DSI
        bool "MIPI DSI Interface (1024x600, Touch)"
        depends on IDF_TARGET_ESP32P4
        help
            MIPI DSI interface for high-resolution displays.
            Resolution: 1024x600
            Input: Touch panel
            Only available on ESP32-P4.

    config EXAMPLE_LCD_INTERFACE_QSPI
        bool "QSPI Interface (360x360, Touch)"
        depends on !IDF_TARGET_ESP32C3
        help
            QSPI (Quad SPI) interface for medium-resolution displays.
            Resolution: 360x360
            Input: Touch panel
            Requires PSRAM. Not available on ESP32-C3.

    config EXAMPLE_LCD_INTERFACE_RGB
        bool "RGB Interface (800x480, Touch)"
        depends on IDF_TARGET_ESP32S3 || IDF_TARGET_ESP32P4
        help
            RGB parallel interface for medium to high-resolution displays.
            Resolution: 800x480
            Input: Touch panel
            Requires PSRAM. Available on ESP32-S3 and ESP32-P4.

    config EXAMPLE_LCD_INTERFACE_SPI_WITH_PSRAM
        bool "SPI Interface with PSRAM (320x240, Touch)"
        depends on !IDF_TARGET_ESP32C3
        help
            Standard SPI interface with PSRAM support.
            Resolution: 320x240
            Input: Touch panel
            Not available on ESP32-C3.

    config EXAMPLE_LCD_INTERFACE_SPI_WITHOUT_PSRAM
        bool "SPI Interface without PSRAM (240x240, Encoder)"
        help
            Standard SPI interface without PSRAM.
            Resolution: 240x240
            Input: Encoder/Knob
            Suitable for resource-constrained chips.
endchoice

choice EXAMPLE_DISPLAY_ROTATION
    prompt "Display Rotation"
    default EXAMPLE_DISPLAY_ROTATION_0
    help
        Select the rotation applied to both the LCD panel and the touch controller
        so that LVGL coordinates match the screen orientation.

config EXAMPLE_DISPLAY_ROTATION_0
    bool "Rotate 0 degrees"

config EXAMPLE_DISPLAY_ROTATION_90
    bool "Rotate 90 degrees clockwise"

config EXAMPLE_DISPLAY_ROTATION_180
    bool "Rotate 180 degrees"

config EXAMPLE_DISPLAY_ROTATION_270
    bool "Rotate 270 degrees clockwise"

endchoice

endmenu
```

## examples/display/gui/lvgl_decode_image/sdkconfig.defaults
```kconfig
CONFIG_PARTITION_TABLE_CUSTOM=y
CONFIG_COMPILER_OPTIMIZATION_PERF=y

# FreeRTOS configuration
CONFIG_FREERTOS_HZ=1000

# LVGL configuration
CONFIG_LV_USE_CLIB_MALLOC=y
CONFIG_LV_USE_CLIB_STRING=y
CONFIG_LV_USE_CLIB_SPRINTF=y
CONFIG_LV_DEF_REFR_PERIOD=15
CONFIG_LV_DPI_DEF=60
CONFIG_LV_OS_FREERTOS=y
CONFIG_LV_DRAW_LAYER_SIMPLE_BUF_SIZE=48000
CONFIG_LV_DRAW_THREAD_PRIO=4
CONFIG_LV_DRAW_SW_SHADOW_CACHE_SIZE=4
CONFIG_LV_GRADIENT_MAX_STOPS=4
CONFIG_LV_OBJ_STYLE_CACHE=y
CONFIG_LV_USE_SYSMON=y
CONFIG_LV_USE_PERF_MONITOR=y
CONFIG_LV_USE_DEMO_BENCHMARK=y
CONFIG_ESP_LVGL_ADAPTER_ENABLE_FPS_STATS=y
CONFIG_ESP_LVGL_ADAPTER_ENABLE_DECODER=y
CONFIG_ESP_LVGL_ADAPTER_ENABLE_FS=y
CONFIG_LV_USE_FS_POSIX=y
CONFIG_LV_FS_POSIX_LETTER=65
```

## examples/display/gui/lvgl_eaf_player/sdkconfig.defaults.esp32p4
```kconfig
# ESP32-P4 default configuration

CONFIG_IDF_TARGET="esp32p4"

# Default LCD interface: MIPI DSI
CONFIG_EXAMPLE_LCD_INTERFACE_MIPI_DSI=y

# PSRAM configuration
CONFIG_ESP32P4_SELECTS_REV_LESS_V3=y
CONFIG_SPIRAM=y
CONFIG_SPIRAM_SPEED_200M=y
CONFIG_SPIRAM_XIP_FROM_PSRAM=y
CONFIG_SPIRAM_MEMTEST=n
CONFIG_CACHE_L2_CACHE_256KB=y
CONFIG_CACHE_L2_CACHE_LINE_128B=y

CONFIG_LV_DRAW_SW_DRAW_UNIT_CNT=2

CONFIG_IDF_EXPERIMENTAL_FEATURES=y
```

## examples/display/gui/lvgl_freetype_font/sdkconfig.defaults.esp32c3
```kconfig
# ESP32-C3 default configuration

CONFIG_IDF_TARGET="esp32c3"

# Default LCD interface: SPI without PSRAM (only option for C3)
CONFIG_EXAMPLE_LCD_INTERFACE_SPI_WITHOUT_PSRAM=y

# ESP32-C3 uses encoder/knob input (not touch)
CONFIG_ESP_LVGL_ADAPTER_ENABLE_BUTTON=y
CONFIG_ESP_LVGL_ADAPTER_ENABLE_KNOB=y
```

## examples/display/gui/lvgl_fs_assets/main/Kconfig.projbuild
```kconfig
menu "LVGL FS Assets Demo Configuration"

choice EXAMPLE_FS_TYPE
    prompt "Storage filesystem type"
    default EXAMPLE_FS_SPIFFS
    help
        Select the filesystem used for the storage partition.
        The example packages the same image and binfont assets into the
        selected filesystem and mounts them at /storage during boot.

    config EXAMPLE_FS_SPIFFS
        bool "SPIFFS"

    config EXAMPLE_FS_FATFS
        bool "FATFS"

    config EXAMPLE_FS_LITTLEFS
        bool "LittleFS"
endchoice

endmenu
```

## examples/display/gui/lvgl_light_sleep_demo/main/Kconfig.projbuild
```kconfig
menu "LVGL Light Sleep Demo Configuration"

choice EXAMPLE_SLEEP_MODE
    prompt "Sleep mode"
    default EXAMPLE_SLEEP_MODE_AUTO
    help
        Select whether the demo enters sleep automatically after LVGL idle time
        or only when the UI button is pressed.

config EXAMPLE_SLEEP_MODE_AUTO
    bool "Auto sleep"

config EXAMPLE_SLEEP_MODE_MANUAL
    bool "Manual sleep"

endchoice

config EXAMPLE_AUTO_SLEEP_IDLE_TIMEOUT_MS
    int "Auto sleep idle timeout (ms)"
    range 100 600000
    default 5000
    depends on EXAMPLE_SLEEP_MODE_AUTO
    help
        Idle time before the adapter enters auto sleep.
        SPI and QSPI interfaces use adapter pause mode with PM.
        RGB and MIPI-DSI interfaces use the example-managed full light sleep flow.

config EXAMPLE_LIGHT_SLEEP_WAKE_TIMER_MS
    int "Light sleep wake timer (ms)"
    range 100 600000
    default 5000
    help
        Duration of the timer wake-up used by the example light sleep flows.
        RGB/MIPI-DSI (user mode) arm it before esp_light_sleep_start(); SPI/QSPI
        (pause mode) use it via a one-shot timer that requests a wake.

endmenu
```

## examples/display/gui/lvgl_light_sleep_demo/sdkconfig.defaults.esp32s31
```kconfig
# ESP32-S31 default configuration

CONFIG_IDF_TARGET="esp32s31"

# Default LCD interface: RGB
CONFIG_EXAMPLE_LCD_INTERFACE_RGB=y

# PSRAM configuration
CONFIG_SPIRAM=y
CONFIG_SPIRAM_SPEED_250M=y
CONFIG_SPIRAM_XIP_FROM_PSRAM=y
CONFIG_SPIRAM_MEMTEST=n
CONFIG_DMA2D_OPERATION_FUNC_IN_IRAM=y
CONFIG_PM_POWER_DOWN_PERIPHERAL_IN_LIGHT_SLEEP=y
```

## examples/display/gui/lvgl_multi_screen/main/Kconfig.projbuild
```kconfig
menu "Hardware Configuration"

choice EXAMPLE_DISPLAY_ROTATION
    prompt "Display Rotation"
    default EXAMPLE_DISPLAY_ROTATION_0
    help
        Select the SPI LCD rotation so that the LVGL coordinate system matches the physical screen orientation.

config EXAMPLE_DISPLAY_ROTATION_0
    bool "Rotate 0 degrees"

config EXAMPLE_DISPLAY_ROTATION_90
    bool "Rotate 90 degrees clockwise"

config EXAMPLE_DISPLAY_ROTATION_180
    bool "Rotate 180 degrees"

config EXAMPLE_DISPLAY_ROTATION_270
    bool "Rotate 270 degrees clockwise"

endchoice

endmenu
```
