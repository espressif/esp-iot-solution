## examples/camera/pic_server/main/Kconfig.projbuild
```kconfig
menu "Example Configuration"
    menu "Example Connection Configuration"

        config ESP_WIFI_SSID
            string "WiFi STA SSID"
            default ""
            help
            WiFi SSID (network name) to connect to or empty for Off.

        config ESP_WIFI_PASSWORD
            string "WiFi STA Password"
            default ""
            help
            WiFi Password if WEP/WPA/WPA2 or empty if Open.

        config ESP_WIFI_AP_SSID
            string "WiFi AP SSID"
            default "ESP32-Camera"
            help
            AP SSID (network name) to create or empty for Off.

        config ESP_WIFI_AP_PASSWORD
            string "WiFi AP Password"
            default ""
            help
            AP password for WPA2 or empty for Open.

        config MAX_STA_CONN
            int "Maximal STA connections"
            default 1
            help
            Max number of the STA connects to AP.

        config ESP_WIFI_AP_CHANNEL
            string "WiFi AP Channel"
            default ""
            help
            AP channel for better connection performance.

        config SERVER_IP
            string "WiFi AP IP Address"
            default "192.168.4.1"
            help
                IP address that the ESP will assign to it's AP interface. You can use this IP to connect to the camera after flashing.

        config ESP_MAXIMUM_RETRY
            int "Maximum retry"
            default 5
            help
            Set the Maximum retry to avoid station reconnecting to the AP unlimited when the AP is really inexistent.
    endmenu

    choice IMAGE_FORMAT
            prompt "image format"
            default IMAGE_JPEG_FORMAT
            help
                Different image formats mean different amounts of data and image quality.
            config IMAGE_JPEG_FORMAT
                bool "JPEG"
                help
                    The image data in JPEG format is compressed data, so it is more suitable for network transmission.
                    In particular, use this format when a camera that can output jpeg format is used.
            config IMAGE_BMP_FORMAT
                bool "BMP"
                help
                    The image data in BMP format is uncompressed data.
                    Data in this format will take up a lot of memory, but it can bring lossless image quality.
    endchoice
endmenu
```

## examples/camera/video_recorder/main/Kconfig.projbuild
```kconfig
menu "Example Configuration"
    menu "Connection Configuration"
        config ESP_WIFI_SSID
            string "WiFi STA SSID"
            default ""
            help
            WiFi SSID (network name) to connect to or empty for Off.

        config ESP_WIFI_PASSWORD
            string "WiFi STA Password"
            default ""
            help
            WiFi Password if WEP/WPA/WPA2 or empty if Open.
            
        config ESP_WIFI_AP_SSID
            string "WiFi AP SSID"
            default "ESP32-Camera"
            help
            AP SSID (network name) to create or empty for Off.

        config ESP_WIFI_AP_PASSWORD
            string "WiFi AP Password"
            default ""
            help
            AP password for WPA2 or empty for Open.

        config MAX_STA_CONN
            int "Maximal STA connections"
            default 1
            help
            Max number of the STA connects to AP.

        config ESP_WIFI_AP_CHANNEL
            string "WiFi AP Channel"
            default ""
            help
            AP channel for better connection performance.

        config SERVER_IP
            string "WiFi AP IP Address"
            default "192.168.4.1"
            help
                IP address that the ESP will assign to it's AP interface. You can use this IP to connect to the camera after flashing.

        config ESP_MAXIMUM_RETRY
            int "Maximum retry"
            default 5
            help
            Set the Maximum retry to avoid station reconnecting to the AP unlimited when the AP is really inexistent.
            
        config EXAMPLE_HTTPD_CONN_CLOSE_HEADER
            bool "Send connection close header from request handlers"
            default y
            help
                If this config item is set, Connection: close header will be set in handlers.
                This closes HTTP connection and frees the server socket instantly.
    endmenu

    menu "SD Configuration"
        config EXAMPLE_FORMAT_IF_MOUNT_SDCARD_FAILED
            bool "The card will be formatted if mount has failed."
            default n
            help
                If this config item is set, the card will be formatted if mount has failed.

        config EXAMPLE_USE_SDMMC_HOST
            bool "Use SDMMC host"
            default y
            depends on IDF_TARGET_ESP32S3 || IDF_TARGET_ESP32
            help
                If this config item is set, SDMMC is used to mount the SDcard.
                Otherwise, will use SPI host to access and mount the SDcard.
    endmenu

    config EXAMPLE_FILE_SERVER_ENABLED
        bool "Enable file server to download video recorder."
            default n
            help
                If this config item is set, After the video capture is over, a file server is automatically started. 
                Video files can be downloaded through this file server.
endmenu
```

## examples/camera/video_recorder/sdkconfig.defaults
```kconfig
CONFIG_FLASHMODE_QIO=y
CONFIG_ESPTOOLPY_FLASHFREQ_80M=y
CONFIG_ESPTOOLPY_FLASHSIZE_4MB=y
CONFIG_HTTPD_MAX_REQ_HDR_LEN=1024

#
# Camera configuration
#
CONFIG_ENABLE_TEST_PATTERN=
CONFIG_OV2640_SUPPORT=y
CONFIG_CAMERA_MODEL_AI_THINKER=y
CONFIG_CAMERA_MODEL_WROVER_KIT=n
CONFIG_ESP_FACE_DETECT_ENABLED=n
CONFIG_ESP_FACE_RECOGNITION_ENABLED=n
#
# ESP32-specific
#
CONFIG_ESP32_DEFAULT_CPU_FREQ_240=y
CONFIG_SPIRAM_SUPPORT=y
CONFIG_SPIRAM_SPEED_80M=y

CONFIG_FREERTOS_HZ=500

CONFIG_FATFS_LFN_STACK=y
CONFIG_FATFS_MAX_LFN=127
```

## examples/camera/video_recorder/sdkconfig.defaults.esp32s3
```kconfig
CONFIG_CAMERA_MODULE_ESP_S3_EYE=y

CONFIG_ESP32S3_DEFAULT_CPU_FREQ_240=y
CONFIG_SPIRAM_SUPPORT=y
CONFIG_ESP32S3_SPIRAM_SUPPORT=y
CONFIG_SPIRAM_MODE_OCT=y
```

## examples/camera/video_stream_server/sdkconfig.defaults
```kconfig
CONFIG_ESP32_DEFAULT_CPU_FREQ_240=y
CONFIG_ESP32S2_DEFAULT_CPU_FREQ_240=y
CONFIG_ESP32S3_DEFAULT_CPU_FREQ_240=y
CONFIG_ESP_MAIN_TASK_STACK_SIZE=4096
CONFIG_ESPTOOLPY_FLASHSIZE_4MB=y

CONFIG_FREERTOS_HZ=1000
CONFIG_ESPTOOLPY_FLASHFREQ_80M=y
CONFIG_ESPTOOLPY_FLASHMODE_QIO=y

CONFIG_SPIRAM_SUPPORT=y
CONFIG_ESP32_SPIRAM_SUPPORT=y
CONFIG_ESP32S2_SPIRAM_SUPPORT=y
CONFIG_ESP32S3_SPIRAM_SUPPORT=y
CONFIG_SPIRAM_MODE_OCT=y
CONFIG_SPIRAM_SPEED_80M=y
CONFIG_SPIRAM_MEMTEST=n

#
# camera-optionally
#
CONFIG_SPIRAM_MALLOC_ALWAYSINTERNAL=1580
CONFIG_FREERTOS_IDLE_TASK_STACKSIZE=1536
CONFIG_HTTPD_MAX_REQ_HDR_LEN=1214

#
# wifi-iperf-specific
#
CONFIG_MEMMAP_SMP=y
CONFIG_ESP_SYSTEM_EVENT_TASK_STACK_SIZE=4096
CONFIG_FREERTOS_UNICORE=n

CONFIG_ESP_INT_WDT=n
CONFIG_ESP_TASK_WDT=n

CONFIG_LWIP_ETHARP_TRUST_IP_MAC=n
CONFIG_LWIP_IRAM_OPTIMIZATION=y
```

## examples/check_pedestrian_flow/main/Kconfig.projbuild
```kconfig
menu "Demo Configuration"

menu "WiFi Configuration"

config WIFI_SSID
    string "WiFi SSID"
    help
        SSID (network name) to connect to.

config WIFI_PASSWORD
    string "WiFi Password"
    help
        WiFi password (WPA or WPA2) to use.

        Can be left blank if the network has no security set.

endmenu

menu "OneNET Configuration"

config DEVICE_ID
    string "ONENET_DEVICE_ID"
    help
        mqtt client id.

config PROJECT_ID
    string "ONENET_PROJECT_ID"
    help
        mqtt username.

config AUTH_INFO
    string "ONENET_AUTH_INFO"
    help
        mqtt password.

config DATA_STREAM
    string "ONENET_DATA_STREAM"
    help
        datastream name.

endmenu

endmenu
```

## examples/common_components/boards/Kconfig.projbuild
```kconfig
menu "Board Options"

    choice BOARD_TARGET
        prompt "Choose Target Board"
        default BOARD_ESP32_DEVKITC_V4 if IDF_TARGET_ESP32
        default BOARD_ESP32S2_SAOLA_1 if IDF_TARGET_ESP32S2
        default BOARD_ESP32S3_USB_OTG_EV if IDF_TARGET_ESP32S3

        config BOARD_ESP32_DEVKITC_V4
            bool "esp32-devkitc-v4"
            depends on IDF_TARGET_ESP32
        config BOARD_ESP32_MESHKIT_SENSE
            bool "esp32-meshkit-sense"
            depends on IDF_TARGET_ESP32
        config BOARD_ESP32S2_SAOLA_1
            bool "esp32s2-saola-1"
            depends on IDF_TARGET_ESP32S2
        config BOARD_ESP32_LCDKIT
            bool "esp32-lcdkit"
            depends on IDF_TARGET_ESP32
        config BOARD_ESP32S3_USB_OTG_EV
            bool "esp32s3_usb_otg_ev"
            depends on IDF_TARGET_ESP32S3
        config BOARD_ESP32S3_DEVKITC_V1
            bool "esp32s3_devkitc_v1"
            depends on IDF_TARGET_ESP32S3
        config BOARD_ESP32_M5STACK
            bool "Board ESP32-M5Stack"
            depends on IDF_TARGET_ESP32
    endchoice

    config BOARD_TARGET_PATH
        string
        default "esp32-devkitc-v4" if BOARD_ESP32_DEVKITC_V4
        default "esp32-meshkit-sense" if BOARD_ESP32_MESHKIT_SENSE
        default "esp32s2-saola-1" if BOARD_ESP32S2_SAOLA_1
        default "esp32-lcdkit" if BOARD_ESP32_LCDKIT
        default "esp32s3_usb_otg_ev" if BOARD_ESP32S3_USB_OTG_EV
        default "esp32s3-devkitc-v1" if BOARD_ESP32S3_DEVKITC_V1
        default "esp32-m5stack" if BOARD_ESP32_M5STACK

    menu "Board Common Options"
        menu "Initialize Options"
            config BOARD_LED_INIT
                bool "init led during board initialize"
                default n
                help
                    if yes, led will be initialized during board initialize

            config BOARD_BUTTON_INIT
                bool "init buttons during board initialize"
                default n
                help
                    if yes, buttons will be initialized during board initialize
                    then you can use iot_board_get_handle to get the button handle.
            config BOARD_GPIO_INIT
                bool "init gpio during board init"
                default n
                help
                    if yes, gpio for power control will be initialized with default configuration during board initialize,
            config BOARD_I2C0_INIT
                bool "init i2c0 during board initialize"
                default n
                help
                    if yes, i2c0 will be initialized with default configuration during board initialize,
                    then you can use iot_board_get_handle to get the bus handle.
            menu "i2c0 configurations"
                visible if BOARD_I2C0_INIT
                config BOARD_I2C0_SPEED
                    int "i2c0 clock speed"
                    default 100000
                config BOARD_I2C0_SCL_PULLUP_EN
                    bool "i2c0 scl pullup enable"
                    default y
                config BOARD_I2C0_SDA_PULLUP_EN
                    bool "i2c0 sda pullup enable"
                    default y
            endmenu
            config BOARD_SPI2_INIT
                bool "init spi2 during board initialize"
                default n
                help
                    if yes, spi2 will be initialized with default configuration during board initialize,
                    then you can use iot_board_get_handle to get the bus handle.
            menu "spi2 configuration"
                visible if BOARD_SPI2_INIT
                config BOARD_SPI2_MAX_TXF_SIZE
                    int "sp2 max transfer size"
                    default 4096
            endmenu
        endmenu

        menu "Wi-Fi Settings"

            config BOARD_WIFI_SSID
                string "WiFi STA SSID"
                default ""
                help
                WiFi SSID (network name) to connect to or empty for Off.

            config BOARD_WIFI_PASSWORD
                string "WiFi STA Password"
                default ""
                help
                WiFi Password if WEP/WPA/WPA2 or empty if Open.

            config BOARD_WIFI_AP_SSID
                string "WiFi AP SSID"
                default "iot-default"
                help
                AP SSID (network name) to create or empty for Off.

            config BOARD_WIFI_AP_PASSWORD
                string "WiFi AP Password"
                default ""
                help
                AP password for WPA2 or empty for Open.

            config BOARD_MAX_STA_CONN
                int "WiFi AP Maximal STA connections"
                default 3
                help
                Max number of the STA connects to AP.

            config BOARD_WIFI_AP_CHANNEL
                int "WiFi AP Channel"
                default 6
                help
                AP channel for better connection performance.

            config BOARD_SERVER_IP
                string "WiFi AP IP Address"
                default "192.168.4.1"
                help
                    IP address that the ESP will assign to it's AP interface. You can use this IP to connect to the camera after flashing.

            config BOARD_MAXIMUM_RETRY
                int "Maximum retry"
                default 5
                help
                Set the Maximum retry to avoid station reconnecting to the AP unlimited when the AP is really inexistent.
        endmenu
    endmenu

    menu "Meshkit Sense Board Options"
        visible if BOARD_ESP32_MESHKIT_SENSE

        orsource "./esp32-meshkit-sense/Kconfig.in"
        #source "{absolute path}/esp32-meshkit-sense/Kconfig.in" # v4.0 Backwards compatibility
    endmenu

endmenu
```

## examples/common_components/boards/esp32-lcdkit/Kconfig.in
```kconfig
menu "esp32-lcdkit board configuration"
    menu "Board Init Options"
        config BOARD_I2C0_INIT
            bool "init i2c0 during board init"
            default n
            help
                if enable, i2c0 will be initialized with default configuration during board init,
                then, you can use iot_board_get_handle to get the bus handle.

        config BOARD_SPI2_INIT
            bool "init spi2 during board init"
            default y
            help
                if yes, spi2 will be initialized with default configuration during board init,
                then, you can use iot_board_get_handle to get the bus handle.
    endmenu
endmenu
```

## examples/common_components/boards/esp32-meshkit-sense/Kconfig.in
```kconfig
if BOARD_ESP32_MESHKIT_SENSE

    config BOARD_POWER_SENSOR
        bool "power on sensors during board init"
        default y
        select BOARD_GPIO_INIT
        help
            if enable, sensors' power switch will be on during board init.
    config BOARD_POWER_SCREEN
        bool "power on screen during board init"
        default y
        select BOARD_GPIO_INIT
        help
            if enable, screen's power switch will be on during board init.

endif #BOARD_ESP32_MESHKIT_SENSE
```

## examples/common_components/boards/esp32s2-saola-1/Kconfig.in
```kconfig
if BOARD_ESP32S2_SAOLA_1

    menu "Board Init Options"
        config BOARD_I2C0_INIT
            bool "init i2c0 during board init"
            default y
            help
                if enable, i2c0 will be initialized with default configuration during board init,
                then, you can use iot_board_get_handle to get the bus handle.
        config BOARD_SPI2_INIT
            bool "init spi2 during board init"
            default n
            help
                if yes, spi2 will be initialized with default configuration during board init,
                then, you can use iot_board_get_handle to get the bus handle.
    endmenu

endif # BOARD_ESP32S2_SAOLA_1
```
