## components/usb/usb_device_uvc/Kconfig
```kconfig
menu "USB Device UVC"

    config TUSB_VID
        hex "USB Device VID"
        default 0x303A
    config TUSB_PID
        hex "USB Device PID"
        default 0x8000
    config TUSB_MANUFACTURER
        string "USB Device Manufacture"
        default "Espressif"
    config TUSB_PRODUCT
        string "Product Name"
        default "ESP UVC Device"
    config TUSB_SERIAL_NUM
        string "Product ID"
        default "12345678"

    config UVC_SUPPORT_TWO_CAM
        bool "Support two cameras"
        default n
        help
            If enable, support two cameras

    choice TINYUSB_RHPORT
        depends on IDF_TARGET_ESP32P4
        prompt "TinyUSB PHY"
        default TINYUSB_RHPORT_HS
        help
            Allows set the USB PHY Controller for TinyUSB: HS (USB OTG2.0 PHY for HighSpeed)

        config TINYUSB_RHPORT_HS
            bool "HS"
    endchoice

    menu "USB Cam1 Config"

        choice UVC_CAM1_FORMAT
            bool "UVC Cam1 Format"
            default FORMAT_MJPEG_CAM1
            config FORMAT_MJPEG_CAM1
                bool "MJPEG"
            config FORMAT_H264_CAM1
                bool "H264"
            config FORMAT_UNCOMPR_CAM1
                bool "uncompressed"
        endchoice

        choice UVC_CAM1_XFER_MODE
            bool "UVC cam1 transfer mode"
            default UVC_MODE_ISOC_CAM1
            config UVC_MODE_ISOC_CAM1
                bool "Isochronous"
            config UVC_MODE_BULK_CAM1
                bool "Bulk"
        endchoice

        choice UVC_CAM1_FRAMESIZE
            bool "UVC Default Resolution"
            default FRAMESIZE_HD
            config FRAMESIZE_QVGA
                bool "QVGA 320x240"
            config FRAMESIZE_HVGA
                bool "HVGA 480x320"
            config FRAMESIZE_VGA
                bool "VGA 640x480"
            config FRAMESIZE_SVGA
                bool "SVGA 800x600"
            config FRAMESIZE_HD
                bool "HD 1280x720"
            config FRAMESIZE_FHD
                bool "FHD 1920x1080"
        endchoice

        config UVC_CAM1_FRAMERATE
            int "Frame Rate (FPS)"
            default 30 if FRAMESIZE_QVGA
            default 30 if FRAMESIZE_HVGA
            default 15 if FRAMESIZE_VGA
            default 15 if FRAMESIZE_SVGA
            default 15 if FRAMESIZE_HD
            default 15 if FRAMESIZE_FHD

        config UVC_CAM1_FRAMESIZE_WIDTH
            int "Cam1 Frame Width"
            default 320 if FRAMESIZE_QVGA
            default 480 if FRAMESIZE_HVGA
            default 640 if FRAMESIZE_VGA
            default 800 if FRAMESIZE_SVGA
            default 1280 if FRAMESIZE_HD
            default 1920 if FRAMESIZE_FHD

        config UVC_CAM1_FRAMESIZE_HEIGT
            int "Cam1 Frame Height"
            default 240 if FRAMESIZE_QVGA
            default 320 if FRAMESIZE_HVGA
            default 480 if FRAMESIZE_VGA
            default 600 if FRAMESIZE_SVGA
            default 720 if FRAMESIZE_HD
            default 1080 if FRAMESIZE_FHD

        config UVC_CAM1_MULTI_FRAMESIZE
            bool "Enable cam1 multiple frames sizes"
            default y
            help
                If enable, add VGA and HVGA to list
    endmenu

    menu "USB Cam2 Config"
        depends on UVC_SUPPORT_TWO_CAM

        choice UVC_CAM2_FORMAT
            bool "UVC Cam2 Format"
            default FORMAT_MJPEG_CAM2
            config FORMAT_MJPEG_CAM2
                bool "MJPEG"
            config FORMAT_H264_CAM2
                bool "H264"
            config FORMAT_UNCOMPR_CAM2
                bool "uncompressed"
        endchoice

        choice UVC_CAM2_XFER_MODE
            bool "UVC cam2 transfer mode"
            default UVC_MODE_ISOC_CAM2
            config UVC_MODE_ISOC_CAM2
                bool "Isochronous"
            config UVC_MODE_BULK_CAM2
                bool "Bulk"
        endchoice

        choice UVC_CAM2_FRAMESIZE
            bool "UVC Default Resolution"
            default FRAMESIZE_HD_2
            config FRAMESIZE_QVGA_2
                bool "QVGA 320x240"
            config FRAMESIZE_HVGA_2
                bool "HVGA 480x320"
            config FRAMESIZE_VGA_2
                bool "VGA 640x480"
            config FRAMESIZE_SVGA_2
                bool "SVGA 800x600"
            config FRAMESIZE_HD_2
                bool "HD 1280x720"
            config FRAMESIZE_FHD_2
                bool "FHD 1920x1080"
        endchoice

        config UVC_CAM2_FRAMERATE
            int "Frame Rate (FPS)"
            default 30 if FRAMESIZE_QVGA_2
            default 30 if FRAMESIZE_HVGA_2
            default 15 if FRAMESIZE_VGA_2
            default 15 if FRAMESIZE_SVGA_2
            default 15 if FRAMESIZE_HD_2
            default 15 if FRAMESIZE_FHD_2

        config UVC_CAM2_FRAMESIZE_WIDTH
            int "Cam2 Frame Width"
            default 320 if FRAMESIZE_QVGA_2
            default 480 if FRAMESIZE_HVGA_2
            default 640 if FRAMESIZE_VGA_2
            default 800 if FRAMESIZE_SVGA_2
            default 1280 if FRAMESIZE_HD_2
            default 1920 if FRAMESIZE_FHD_2

        config UVC_CAM2_FRAMESIZE_HEIGT
            int "Cam2 Frame Height"
            default 240 if FRAMESIZE_QVGA_2
            default 320 if FRAMESIZE_HVGA_2
            default 480 if FRAMESIZE_VGA_2
            default 600 if FRAMESIZE_SVGA_2
            default 720 if FRAMESIZE_HD_2
            default 1080 if FRAMESIZE_FHD_2


        config UVC_CAM2_MULTI_FRAMESIZE
            bool "Enable cam2 multiple frames sizes"
            default y
            help
                If enable, add VGA and HVGA to list

    endmenu

    menu "UVC_MULTI_FRAME_CONFIG"

        menu  "FRAME_SIZE_1"
            config UVC_MULTI_FRAME_WIDTH_1
                int "Enable Multi Frame Size 1"
                default 640

            config UVC_MULTI_FRAME_HEIGHT_1
                int "Enable Multi Frame Size 1"
                default 480

            config UVC_MULTI_FRAME_FPS_1
                int "Enable Multi Frame Size 1"
                default 15
        endmenu

        menu  "FRAME_SIZE_2"
            config UVC_MULTI_FRAME_WIDTH_2
                int "Enable Multi Frame Size 2"
                default 480

            config UVC_MULTI_FRAME_HEIGHT_2
                int "Enable Multi Frame Size 2"
                default 320

            config UVC_MULTI_FRAME_FPS_2
                int "Enable Multi Frame Size 2"
                default 30
        endmenu

        menu  "FRAME_SIZE_3"
            config UVC_MULTI_FRAME_WIDTH_3
                int "Enable Multi Frame Size 3"
                default 320

            config UVC_MULTI_FRAME_HEIGHT_3
                int "Enable Multi Frame Size 3"
                default 240

            config UVC_MULTI_FRAME_FPS_3
                int "Enable Multi Frame Size 3"
                default 30
        endmenu

    endmenu

    menu "UVC Task Config"
        config UVC_TINYUSB_TASK_PRIORITY
            int "Tinyusb task priority"
            default 5
            range 1 15

        config UVC_TINYUSB_TASK_CORE
            int "Tinyusb task core"
            default -1
            range -1 1

        config UVC_CAM1_TASK_PRIORITY
            int "Cam1 task priority"
            default 4
            range 1 15

        config UVC_CAM1_TASK_CORE
            int "Cam1 task core"
            default -1
            range -1 1

        config UVC_CAM2_TASK_PRIORITY
            int "Cam2 task priority"
            default 4
            range 1 15
            depends on UVC_SUPPORT_TWO_CAM

        config UVC_CAM2_TASK_CORE
            int "Cam2 task core"
            default -1
            range -1 1
            depends on UVC_SUPPORT_TWO_CAM
    endmenu

endmenu
```

## components/usb/usb_stream/Kconfig
```kconfig
menu "USB Stream"

    config CTRL_TRANSFER_DATA_MAX_BYTES
        int "Max control transfer data size (Bytes)"
        range 64 2048
        default 1024
    config USB_STREAM_QUICK_START
        bool "usb stream quick start"
        default n
    config UVC_GET_DEVICE_DESC
        bool "Get device descriptor during emum"
        depends on !USB_STREAM_QUICK_START
        default y
    config UVC_GET_CONFIG_DESC
        bool "Get and parse config descriptor during emum"
        depends on !USB_STREAM_QUICK_START
        select UVC_GET_DEVICE_DESC
        default y
    config UVC_PRINT_DESC
        bool "Print descriptor info"
        depends on !USB_STREAM_QUICK_START
        default y
    config UVC_PRINT_DESC_VERBOSE
        bool "Print descriptor info in verbose mode"
        depends on UVC_PRINT_DESC
        default n
    config USB_PRE_ALLOC_CTRL_TRANSFER_URB
        bool "Pre-allocate control transfer urb, set to n if you want to use dynamic alloc"
        default y
    config USB_PROC_TASK_PRIORITY
        int "usb process task priority"
        range 1 25
        default 5
    config USB_PROC_TASK_CORE
        int "usb process task core id"
        range 0 1
        default 1 if IDF_TARGET_ESP32S3 && !FREERTOS_UNICORE
        default 0 if IDF_TARGET_ESP32S2
        default 0
    config USB_PROC_TASK_STACK_SIZE
        int "usb process task stack size (Bytes)"
        default 3072
    config USB_WAITING_AFTER_CONN_MS
        int "usb enum delay time(ms) after device connection"
        default 50
    config USB_CTRL_XFER_TIMEOUT_MS
        int "usb control transfer timeout(ms)"
        default 1000
    config USB_ENUM_FAILED_RETRY
        bool "usb enum retry if device enum failed"
        default y
    config USB_ENUM_FAILED_RETRY_COUNT
        int "usb enum retry max times, stop retry if times exceed"
        depends on USB_ENUM_FAILED_RETRY
        default 10
    config USB_ENUM_FAILED_RETRY_DELAY_MS
        int "usb enum retry delay time(ms)"
        depends on USB_ENUM_FAILED_RETRY
        default 200

    menu "UVC Stream Config"
        config SAMPLE_PROC_TASK_PRIORITY
            int "uvc sample process task priority"
            range 1 25
            default 2
        config SAMPLE_PROC_TASK_CORE
            int "uvc sample process task core id"
            range -1 1
            default 0
                help
                    -1: not affinity, 0: APP_CPU, 1: PRO_CPU
        config SAMPLE_PROC_TASK_STACK_SIZE
            int "uvc sample process task stack size (Bytes)"
            default 3072
        config UVC_PRINT_PROBE_RESULT
            bool "Print video cur probe result"
            default y
        config UVC_PRINT_PAYLOAD_HEX
            bool "Print video payload in hex format"
            default n
        config UVC_CHECK_HEADER_EOH
            bool "Check EOH bit in payload header"
            default n
        config UVC_CHECK_HEADER_EOF
            bool "Check EOF bit in payload header"
            default y
            help
                "If EOF(1 << 1) is set in the header, it means the current image frame has been completely received."
        config UVC_CHECK_BULK_JPEG_HEADER
            bool "Check JPEG (ff d8) header in bulk payload"
            default y
        config UVC_DROP_NO_EOF_FRAME
            bool "Drop no EOF image frames"
            depends on UVC_CHECK_HEADER_EOF
            default n
        config UVC_DROP_OVERFLOW_FRAME
            bool "Drop overflow image frames"
            default y
        config NUM_BULK_STREAM_URBS
            int "uvc bulk urb number"
            default 2
        config NUM_BULK_BYTES_PER_URB
            int "uvc bulk segment size in each urb transfer"
            default 2048
        config NUM_ISOC_UVC_URBS
            int "uvc isoc urb number"
            default 3
        config NUM_PACKETS_PER_URB
            int "uvc isoc packet number in each urb"
            default 4
    endmenu

    menu "UAC Stream Config"
        config NUM_ISOC_SPK_URBS
            int "uac speaker isoc urb number"
            default 3
        config NUM_ISOC_MIC_URBS
            int "uac microphone isoc urb number"
            default 3
        config UAC_MIC_CB_MIN_MS_DEFAULT
            int "uac microphone default cb interval (ms)"
            default 16
            range 1 32
        config UAC_SPK_ST_MAX_MS_DEFAULT
            int "uac speaker default max tx size (ms)"
            default 16
            range 1 32
        config UAC_MIC_PACKET_COMPENSATION
            bool "uac microphone packet compensation"
            default n
        config UAC_SPK_PACKET_COMPENSATION
            bool "uac speaker packet compensation"
            default y
        config UAC_SPK_PACKET_COMPENSATION_CONTINUOUS
            bool "speaker continuous compensation"
            depends on UAC_SPK_PACKET_COMPENSATION
            default y
        config UAC_SPK_PACKET_COMPENSATION_TIMEOUT_MS
            int "speaker compensation after buffer empty timeout(ms)"
            depends on UAC_SPK_PACKET_COMPENSATION
            default 80
            range 10 1000
        config UAC_SPK_PACKET_COMPENSATION_SIZE_MS
            int "speaker compensation size (ms)"
            depends on UAC_SPK_PACKET_COMPENSATION
            default 10
            range 1 32
    endmenu

endmenu
```

## components/usb/usb_stream/examples/usb_stream_lcd_display/components/esp_painter/Kconfig
```kconfig
menu "ESP Painter"
    config ESP_PAINTER_FORMAT_SIZE_MAX
        int "Size of format string buffer"
        default 128

    menu "fonts"
        config ESP_PAINTER_BASIC_FONT_12
            bool "Enable basic_font_12"
            default n

        config ESP_PAINTER_BASIC_FONT_16
            bool "Enable basic_font_16"
            default n

        config ESP_PAINTER_BASIC_FONT_20
            bool "Enable basic_font_20"
            default n

        config ESP_PAINTER_BASIC_FONT_24
            bool "Enable basic_font_24"
            default y

        config ESP_PAINTER_BASIC_FONT_28
            bool "Enable basic_font_28"
            default n

        config ESP_PAINTER_BASIC_FONT_32
            bool "Enable basic_font_32"
            default n

        config ESP_PAINTER_BASIC_FONT_36
            bool "Enable basic_font_36"
            default n

        config ESP_PAINTER_BASIC_FONT_40
            bool "Enable basic_font_40"
            default n

        config ESP_PAINTER_BASIC_FONT_44
            bool "Enable basic_font_44"
            default n

        config ESP_PAINTER_BASIC_FONT_48
            bool "Enable basic_font_48"
            default n
    endmenu
endmenu
```

## components/usb/usb_stream/examples/usb_stream_lcd_display/sdkconfig.defaults
```kconfig
CONFIG_IDF_TARGET="esp32s3"
CONFIG_IDF_TARGET_ESP32S3=y

#
# ESP System Settings
#
CONFIG_ESP_DEFAULT_CPU_FREQ_MHZ_240=y

#
# FreeRTOS
#

#
# Kernel
#
CONFIG_FREERTOS_HZ=1000

#
# Compiler options
#
CONFIG_COMPILER_OPTIMIZATION_PERF=y

#
# ESP PSRAM
#
CONFIG_SPIRAM=y
CONFIG_SPIRAM_MODE_OCT=y
CONFIG_SPIRAM_SPEED_80M=y
CONFIG_SPIRAM_FETCH_INSTRUCTIONS=y
CONFIG_SPIRAM_RODATA=y

#
# Serial flasher config
#
CONFIG_ESPTOOLPY_FLASHMODE_QIO=y
CONFIG_ESPTOOLPY_FLASHFREQ_80M=y

#
# LCD
#
CONFIG_BSP_LCD_RGB_BUFFER_NUMS=2
CONFIG_BSP_LCD_RGB_BOUNCE_BUFFER_MODE=y
```

## components/usb/usb_stream/examples/usb_stream_mic_spk/main/Kconfig.projbuild
```kconfig
menu "Example Configuration"

    choice DEVELOPMENT_BOARD_SELECTION
        prompt "Select the development board you are using"
        default ESP32_S3_GENERIC if IDF_TARGET_ESP32S3
        default ESP32_S2_GENERIC if IDF_TARGET_ESP32S2
        help
            Select this option to choose the board for the example.

        config ESP32_S3_USB_OTG
            bool "ESP32 S3 USB OTG"
            depends on IDF_TARGET_ESP32S3

        config ESP32_S3_GENERIC
            bool "ESP32 S3 GENERIC"
            depends on IDF_TARGET_ESP32S3

        config ESP32_S2_GENERIC
            bool "ESP32 S2 GENERIC"
            depends on IDF_TARGET_ESP32S2

    endchoice

endmenu
```
