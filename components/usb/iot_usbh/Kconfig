## components/usb/iot_usbh/Kconfig
```kconfig
menu "IoT USB Host"
    config USBH_GET_DEVICE_DESC
        bool "Get device descriptor during emum"
        default y
    config USBH_GET_CONFIG_DESC
        bool "Get config descriptor during emum"
        default y
    config USBH_TASK_CORE_ID
        int "usbh task core_id"
        default 0
        range 0 0 if IDF_TARGET_ESP32S2
        range 0 1 if IDF_TARGET_ESP32S3
        help
            pin usb task to specified core
    config USBH_TASK_BASE_PRIORITY
        int "usbh task base priority"
        default 5
        help
            usb task base priority
    config CTRL_TRANSFER_DATA_MAX_BYTES
        int "Max control transfer data size (Bytes)"
        range 64 2048
        default 512
endmenu
```

## components/usb/iot_usbh_cdc/Kconfig
```kconfig
menu "IoT USB Host CDC"

    config USBH_TASK_CORE_ID
        int "usbh CDC task core_id"
        default 0
        range -1 1
        help
            usb host CDC task to specified core

    config USBH_TASK_BASE_PRIORITY
        int "usbh CDC task base priority"
        default 5
        help
            usb host CDC task base priority

    config USBH_CDC_CONTROL_TRANSFER_BUFFER_SIZE
        int "usbh CDC control transfer size"
        default 256
        help
            usb host CDC control transfer buffer size

    config USBH_CDC_IN_EP_RETRY_COUNT
        int "usbh CDC IN EP retry count"
        default 3
        help
            usb host CDC IN EP retry count, exceed this count will stop transfer
endmenu
```

## components/usb/iot_usbh_ecm/Kconfig
```kconfig
menu "IoT USB Host ECM"

    config ECM_AUTO_LINK_UP_AFTER_NO_NOTIFICATION
        bool "Enable auto link up when no notify received"
        default y
        help
            Automatically establish connection when no notification is received

    config ECM_AUTO_LINK_UP_WAIT_TIME_MS
        int "Auto link up wait time ms"
        depends on ECM_AUTO_LINK_UP_AFTER_NO_NOTIFICATION
        default 4000
        range 2000 60000
        help
            Auto link up after not receive notification for a while

    config ECM_DISABLE_CDC_NOTIFICATION
        bool "Disable CDC notification"
        default n
        help
            Disable CDC notification for save channel of USB host

endmenu
```

## components/usb/iot_usbh_modem/Kconfig
```kconfig
menu "IoT USB Host Modem"

    config MODEM_OPERATION_RETRY_TIMES
        int "Retry Times During modem operation"
        default 5
        help
            Set retry times for modem operations

    config MODEM_OPERATION_RETRY_DELAY_MS
        int "Retry Delay(ms) During modem operation"
        default 2000
        help
            Set retry delay between modem operations

    config MODEM_RSSI_THRESHOLD
        int "RSSI Threshold"
        default 10
        help
            Set RSSI threshold for modem link with carrier base station

    config MODEM_EXIT_PPP_WITH_AT_CMD
        bool "Exit PPP by AT Command"
        default y
        help
            Enable to exit PPP mode by AT command

    config MODEM_EXIT_PPP_GAP_TIME_MS
        int "Exit PPP Gap Time(ms)"
        default 1000
        help
            Set gap time before exit PPP mode

endmenu
```

## components/usb/iot_usbh_modem/test_apps/sdkconfig.defaults
```kconfig
# For IDF 5.0
CONFIG_ESP_DEFAULT_CPU_FREQ_MHZ_240=y
CONFIG_FREERTOS_HZ=1000
CONFIG_ESP_TASK_WDT_EN=n
CONFIG_FREERTOS_TIMER_TASK_STACK_DEPTH=4096

# For IDF4.4
CONFIG_ESP32S2_DEFAULT_CPU_FREQ_240=y
CONFIG_ESP32S3_DEFAULT_CPU_FREQ_240=y
CONFIG_ESP_TASK_WDT=n

CONFIG_LWIP_IRAM_OPTIMIZATION=y
CONFIG_LWIP_IP4_REASSEMBLY=y
CONFIG_LWIP_IP_FORWARD=y
CONFIG_LWIP_IPV4_NAPT=y
CONFIG_LWIP_IPV6=n
CONFIG_LWIP_TCPIP_TASK_STACK_SIZE=4096
CONFIG_LWIP_PPP_SUPPORT=y
CONFIG_LWIP_PPP_NOTIFY_PHASE_SUPPORT=y
CONFIG_LWIP_PPP_PAP_SUPPORT=y
CONFIG_USB_HOST_CONTROL_TRANSFER_MAX_SIZE=1024
```

## components/usb/iot_usbh_rndis/Kconfig
```kconfig
menu "IoT USB Host RNDIS"

    config RNDIS_DISABLE_CDC_NOTIFICATION
        bool "Disable CDC notification"
        default n
        help
            Disable CDC notification for save channel of USB host

endmenu
```

## components/usb/usb_device_uac/Kconfig
```kconfig
menu "USB Device UAC Configuration"

    if !USB_DEVICE_UAC_AS_PART
        config UAC_TUSB_VID
            hex "USB Device VID"
            default 0x303A

        config UAC_TUSB_PID
            hex "USB Device PID"
            default 0x8000

        config UAC_TUSB_MANUFACTURER
            string "USB Device Manufacture"
            default "Espressif"

        config UAC_TUSB_PRODUCT
            string "Product Name"
            default "ESP UAC Device"

        config UAC_TUSB_SERIAL_NUM
            string "Product ID"
            default "12345678"

        choice TINYUSB_RHPORT
            prompt "TinyUSB Root Port"
            default TINYUSB_RHPORT_HS if IDF_TARGET_ESP32P4
            default TINYUSB_RHPORT_FS
            help
                Allows set the USB PHY Controller for TinyUSB: HS (USB OTG2.0 PHY for HighSpeed)

            config TINYUSB_RHPORT_HS
                depends on IDF_TARGET_ESP32P4
                bool "High Speed"

            config TINYUSB_RHPORT_FS
                bool "Full Speed"
        endchoice
    endif

    # Insert UAC config
    orsource "./Kconfig.uac"

endmenu
```

## components/usb/usb_device_uac/Kconfig.uac
```kconfig
menu "USB Device UAC"

    config USB_DEVICE_UAC_AS_PART
        bool "Using customer tinyusb configs and descriptors"
        default n
        help
            If enable this feature, will need to write the `tusb_config.h` and `usb_descriptors.c` files in the project.

    config UAC_SPEAKER_CHANNEL_NUM
        int "UAC Speaker channel number"
        range 0 8
        default 1

    config UAC_MIC_CHANNEL_NUM
        int "UAC mic channel number"
        range 0 4
        default 1

    config UAC_SAMPLE_RATE
        int "UAC sample rate"
        default 48000

    choice UAC_BIT_RESOLUTION
        prompt "UAC bit resolution"
        default UAC_BIT_RESOLUTION_16
        help
            Bit resolution used for both speaker (RX) and microphone (TX) streams.
            EP and software buffers scale automatically with the chosen width.

        config UAC_BIT_RESOLUTION_16
            bool "16-bit (in 16-bit slot)"

        config UAC_BIT_RESOLUTION_24_IN_24
            bool "24-bit (in 24-bit slot, packed)"

        config UAC_BIT_RESOLUTION_24_IN_32
            bool "24-bit (in 32-bit slot)"

        config UAC_BIT_RESOLUTION_32
            bool "32-bit (in 32-bit slot)"
    endchoice

    config UAC_BIT_RESOLUTION
        int
        default 16 if UAC_BIT_RESOLUTION_16
        default 24 if UAC_BIT_RESOLUTION_24_IN_24 || UAC_BIT_RESOLUTION_24_IN_32
        default 32 if UAC_BIT_RESOLUTION_32

    config UAC_BYTES_PER_SAMPLE
        int
        default 2 if UAC_BIT_RESOLUTION_16
        default 3 if UAC_BIT_RESOLUTION_24_IN_24
        default 4 if UAC_BIT_RESOLUTION_24_IN_32 || UAC_BIT_RESOLUTION_32

    config UAC_SPK_INTERVAL_MS
        int "UAC SPK interval(ms)"
        default 10
        help
            SPK: The first interval of reading data from UAC device, in ms. And make SPK FIFO to accommodate data of size n milliseconds.

    config UAC_MIC_INTERVAL_MS
        int "UAC MIC interval(ms)"
        default 10
        help
            MIC: The interval of writing data to UAC device, in ms. Batch fetching data helps reduce latency at the slave end. And make MIC FIFO to accommodate data of size n milliseconds.

    config UAC_SPK_NEW_PLAY_INTERVAL
        int "UAC SPK new play interval(ms)"
        default 100
        help
            SPK: A new playback is considered if it has been longer than a certain number of milliseconds since the last audio data was received.

    config UAC_SUPPORT_MACOS
        bool "Support MacOS"
        default n
        help
            Enable conversion from 16.16 to 10.14 format on full-speed devices on MacOS.

    menu "UAC Task Config"
            config UAC_TINYUSB_TASK_PRIORITY
                int "Tinyusb task priority"
                default 5
                range 1 15

            config UAC_TINYUSB_TASK_CORE
                int "Tinyusb task core"
                default -1
                range -1 1

            config UAC_SPK_TASK_PRIORITY
                int "SPK task priority"
                default 5
                range 1 15
                depends on UAC_SPEAKER_CHANNEL_NUM != 0

            config UAC_SPK_TASK_CORE
                int "SPK task core"
                default -1
                range -1 1
                depends on UAC_SPEAKER_CHANNEL_NUM != 0

            config UAC_MIC_TASK_PRIORITY
                int "MIC task priority"
                default 5
                range 1 15
                depends on UAC_MIC_CHANNEL_NUM != 0

            config UAC_MIC_TASK_CORE
                int "MIC task core"
                default -1
                range -1 1
                depends on UAC_MIC_CHANNEL_NUM != 0
    endmenu

endmenu
```
