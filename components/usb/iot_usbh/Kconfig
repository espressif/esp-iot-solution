## components/usb/usb_stream/test_apps/sdkconfig.defaults
```kconfig
# For IDF 5.0
CONFIG_ESP_DEFAULT_CPU_FREQ_MHZ_240=y
CONFIG_FREERTOS_HZ=1000
CONFIG_ESP_TASK_WDT_EN=n
CONFIG_FREERTOS_TIMER_TASK_STACK_DEPTH=4096

# For IDF4.4
CONFIG_ESP32S2_DEFAULT_CPU_FREQ_240=y
CONFIG_ESP32S3_DEFAULT_CPU_FREQ_240=y
CONFIG_ESP_TASK_WDT=n

CONFIG_FATFS_LONG_FILENAMES=y
CONFIG_FATFS_LFN_STACK=y
```

## components/usb/uvc_stream/Kconfig
```kconfig
menu "UVC Stream"

    config CTRL_TRANSFER_DATA_MAX_BYTES
        int "Max control transfer data size (Bytes)"
        range 64 2048
        default 1024
    config UVC_GET_DEVICE_DESC
        bool "Get camera device descriptor during emum"
        default y
    config UVC_GET_CONFIG_DESC
        bool "Get camera config descriptor during emum"
        default y
    config UVC_PRINT_DESC_VERBOSE
        bool "Print camera more descriptor info"
        default n
    config UVC_PRINT_PROBE_RESULT
        bool "Print video cur probe result"
        default y
    config SOURCE_SIMULATE
        bool "Enable Simulate Pictures From Flash"
        default n

    config TRIGGER_PIN
        bool "Enable Trigger Pin For Debug"
        default n
    config USB_PROC_TASK_PRIORITY
        int "usb handle task priority"
        default 5
    config USB_PROC_TASK_CORE
        int "usb handle task core id"
        default 0
    config SAMPLE_PROC_TASK_PRIORITY
        int "sample process task priority"
        default 2
    config SAMPLE_PROC_TASK_CORE
        int "sample process task core id"
        default 0
    config NUM_BULK_STREAM_URBS
        int "bulk: urb number"
        default 1
    config BULK_BYTES_PER_URB_SAME_AS_FRAME
        bool "bulk: transfer size in each urb same as frame buffer"
        default y
        help
            According to UVC 1.5 2.4.3.2.1, each packet should have a header added, but most cameras don't.
            Therefore, a large buffer should be prepared to ensure that a frame can be received.
    config NUM_BULK_BYTES_PER_URB
        int "bulk: transfer size in each urb"
        depends on !BULK_BYTES_PER_URB_SAME_AS_FRAME
        default 512
    config NUM_ISOC_STREAM_URBS
        int "isoc: urb number"
        default 3
    config NUM_PACKETS_PER_URB_URB
        int "isoc: packet number in each urb"
        default 4


endmenu
```

## components/utilities/log_router/Kconfig
```kconfig
menu "LOG ROUTER"

    config LOG_ROUTER_BUFFER_SIZE
        int "Buffer size (bytes)"
        range 2048 10240
        default 4096
        help
            Size of the buffer used for log buffering.
            Larger buffer reduces flash write frequency but uses more RAM.
            Range: 2KB (2048) to 10KB (10240)

    config LOG_ROUTER_FLUSH_THRESHOLD_PERCENT
        int "Flush threshold percentage"
        range 50 90
        default 75
        help
            Percentage of buffer size at which to trigger a flush.
            Higher percentage means more data buffered before writing to flash.
            Range: 50% to 90%

    config LOG_ROUTER_FLUSH_TIMEOUT_MS
        int "Flush timeout (milliseconds)"
        range 2000 10000
        default 2000
        help
            Maximum time to wait before flushing buffer to flash.
            Shorter timeout ensures more frequent writes but may reduce performance.
            Range: 2 seconds (2000ms) to 10 seconds (10000ms)

    config LOG_ROUTER_FORMAT_BUFFER_SIZE
        int "Log format buffer size (bytes)"
        range 256 1024
        default 256
        help
            Size of the buffer used for formatting log messages in log_router.
            Larger buffer can handle longer log messages but uses more stack space.
            Range: 256 to 1024 bytes

    config LOG_ROUTER_APPEND_STRING_ON_TRUNCATE
        bool "Show message on truncate"
        default y
        help
            When enabled, log messages that are truncated because they do not fit
            into LOG_ROUTER_FORMAT_BUFFER_SIZE will have a string appended to them,
            to indicate that the log message is incomplete.

    if LOG_ROUTER_APPEND_STRING_ON_TRUNCATE
		config LOG_ROUTER_TRUNCATE_STRING
			string
			default "<TRUNCATED>"
			prompt "Append this string to truncated logs"
			help
				String appended to truncated log messages. If log colors are enabled,
				it will be formatted as purple italics: see CONFIG_LOG_COLORS

				A newline character is also added, so that the next log message starts
				on its own line.


	endif #LOG_ROUTER_APPEND_STRING_ON_TRUNCATE

    config LOG_ROUTER_DEBUG_OUTPUT
        bool "Enable debug output"
        default y
        help
            Enable debug output for log router operations.
            When enabled, printf statements will show buffer flush events,
            timeout triggers, and error conditions.
            Disable this in production to improve performance.

endmenu
```

## components/wifi/iot_espnow/Kconfig
```kconfig
config IOT_ESPNOW_ENABLE
bool "IOT_ESPNOW_ENABLE"
default y
help
    "Select this one to enable espnow component"
    
menu IOT_ESPNOW_OPTIONS
    depends on IOT_ESPNOW_ENABLE
    config IOT_ESPNOW_PMK
    string "ESPNOW primary master key"
    default "pmk1234567890123"
    help
        "primary master key is used to encrypt local master key"

endmenu
```

## components/zero_detection/Kconfig
```kconfig
menu "Zero Cross Detection"

    config USE_GPTIMER
        bool "USE GPTIMER"
        default "n"
        help
            Use GPTimer instead of ESPTimer.
endmenu
```

## examples/ai/esp_dl/emotion_recognition/components/emotion_cls/Kconfig
```kconfig
menu "models: emotion_cls"
    config FLASH_EMOTION_CLS
        bool "flash emotion_cls"
        default y

    choice
        prompt "default model"
        default EMOTION_CLS
        help
            default emotion_cls model
        config EMOTION_CLS
            bool "emotion_cls"
            depends on FLASH_EMOTION_CLS
    endchoice

    config DEFAULT_EMOTION_CLS_MODEL
        int
        default 0 if EMOTION_CLS

    choice
        prompt "model location"
        default EMOTION_CLS_MODEL_IN_FLASH_RODATA
        help
            emotion_cls model location
        config EMOTION_CLS_MODEL_IN_FLASH_RODATA
            bool "flash_rodata"
        config EMOTION_CLS_MODEL_IN_FLASH_PARTITION
            bool "flash_partition"
    endchoice

    config EMOTION_CLS_MODEL_LOCATION
        int
        default 0 if EMOTION_CLS_MODEL_IN_FLASH_RODATA
        default 1 if EMOTION_CLS_MODEL_IN_FLASH_PARTITION
endmenu
```

## examples/ai/esp_dl/emotion_recognition/sdkconfig.defaults
```kconfig
# Common defaults shared by all targets.
CONFIG_ESPTOOLPY_FLASHSIZE_16MB=y
CONFIG_PARTITION_TABLE_CUSTOM=y
CONFIG_SPIRAM=y
CONFIG_SPIRAM_SPEED_250M=y
CONFIG_FREERTOS_HZ=1000
CONFIG_ESP_PAINTER_BASIC_FONT_24=y
CONFIG_ESP_PAINTER_BASIC_FONT_40=y
CONFIG_FLASH_HUMAN_FACE_DETECT_MSRMNP_S8_V1=n
CONFIG_FLASH_ESPDET_PICO_224_224_FACE=y
```

## examples/ai/esp_dl/emotion_recognition/sdkconfig.defaults.esp32p4
```kconfig
CONFIG_IDF_TARGET="esp32p4"
CONFIG_BSP_LCD_DPI_BUFFER_NUMS=3
CONFIG_BSP_DISPLAY_LVGL_AVOID_TEAR=y
CONFIG_CAMERA_SC2336=y
CONFIG_CAMERA_SC2336_MIPI_RAW8_1024X600_30FPS=y
CONFIG_CAMERA_SC2336_MIPI_RAW8_1280X720_30FPS=n
CONFIG_ESP_VIDEO_ENABLE_ISP_PIPELINE_CONTROLLER=y
# Only show errors (hides the noisy ISP_AWB subwindow warnings).
CONFIG_LOG_DEFAULT_LEVEL_ERROR=y
```

## examples/ai/esp_dl/human_activity_recognition/sdkconfig.defaults.esp32p4
```kconfig
CONFIG_IDF_TARGET="esp32p4"
CONFIG_ESPTOOLPY_FLASHMODE_QIO=y
CONFIG_ESPTOOLPY_FLASHSIZE_16MB=y
CONFIG_PARTITION_TABLE_CUSTOM=y
CONFIG_PARTITION_TABLE_CUSTOM_FILENAME="partitions.csv"
CONFIG_MODEL_FILE_PATH="models/esp32p4/har.espdl"
CONFIG_SPIRAM=y
CONFIG_SPIRAM_SPEED_200M=y
CONFIG_SPIRAM_XIP_FROM_PSRAM=y
CONFIG_CACHE_L2_CACHE_256KB=y
CONFIG_CACHE_L2_CACHE_LINE_128B=y
CONFIG_ESP_SYSTEM_ALLOW_RTC_FAST_MEM_AS_HEAP=n
CONFIG_FATFS_LFN_HEAP=y
CONFIG_JD_FASTDECODE_BASIC=y
CONFIG_IDF_EXPERIMENTAL_FEATURES=y
```

## examples/ai/esp_dl/human_activity_recognition/sdkconfig.defaults.esp32s3
```kconfig
CONFIG_IDF_TARGET="esp32s3"
CONFIG_BOOTLOADER_COMPILER_OPTIMIZATION_PERF=y
CONFIG_BOOTLOADER_LOG_LEVEL_NONE=y
CONFIG_ESPTOOLPY_FLASHMODE_QIO=y
CONFIG_ESPTOOLPY_FLASHSIZE_16MB=y
CONFIG_PARTITION_TABLE_CUSTOM=y
CONFIG_PARTITION_TABLE_CUSTOM_FILENAME="partitions.csv"
CONFIG_MODEL_FILE_PATH="models/esp32s3/har.espdl"
CONFIG_SPIRAM=y
CONFIG_SPIRAM_MODE_OCT=y
CONFIG_SPIRAM_SPEED_80M=y
CONFIG_SPIRAM_MEMTEST=n
CONFIG_ESP_DEFAULT_CPU_FREQ_MHZ_240=y
CONFIG_ESP32S3_INSTRUCTION_CACHE_32KB=y
CONFIG_ESP32S3_DATA_CACHE_64KB=y
CONFIG_ESP32S3_DATA_CACHE_LINE_64B=y
CONFIG_ESP_SYSTEM_ALLOW_RTC_FAST_MEM_AS_HEAP=n
CONFIG_ESP_INT_WDT=n
CONFIG_ESP_TASK_WDT_EN=n
```
