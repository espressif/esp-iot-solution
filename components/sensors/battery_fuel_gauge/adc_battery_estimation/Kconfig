## components/sensors/sensor_hub/Kconfig.projbuild
```kconfig
menu "Sensor Hub Options"

    menu "Sensor Build Options"
        config SENSOR_INCLUDED_IMU
            bool "include imu sensor driver in sensor hub"
            default y
        config SENSOR_INCLUDED_HUMITURE
            bool "include humiture sensor driver in sensor hub"
            default y
        config SENSOR_INCLUDED_LIGHT
            bool "include light sensor driver in sensor hub"
            default y
    endmenu

    menu "Sensor Task Options"
        config SENSOR_TASK_PRIORITY_INHERIT
            bool "sensor task priority inherit from parent"
            default y
        config SENSOR_TASK_PRIORITY
            int "sensor task priority"
            depends on !SENSOR_TASK_PRIORITY_INHERIT
            default 4 if !SENSOR_TASK_PRIORITY_INHERIT
        config SENSOR_TASK_STACK_SIZE
            int "sensor task stack size"
            default 4096
    endmenu

    menu "Sensor Event Loop Options"
        config SENSORS_EVENT_TASK_PRIORITY_INHERIT
            bool "sensor event loop task priority inherit from parent"
            default y
        config SENSORS_EVENT_TASK_PRIORITY
            int "sensor event loop task priority"
            depends on !SENSORS_EVENT_TASK_PRIORITY_INHERIT
            default 5 if !SENSORS_EVENT_TASK_PRIORITY_INHERIT
        config SENSOR_EVENT_LOOP_AUTO
            bool "creat sensor event loop automatically"
            default y
        config SENSORS_EVENT_QUEUE_SIZE
            int "sensor event loop queue size"
            default 32
        config SENSORS_EVENT_STACK_SIZE
            int "sensor event loop task stack size"
            default 4096
        config SENSOR_DEFAULT_HANDLER
            bool "enable sensor default handler"
            default n
        config SENSOR_DEFAULT_HANDLER_DATA
            bool "print data in sensor default handler"
            depends on SENSOR_DEFAULT_HANDLER
            default n
    endmenu

endmenu
```

## components/spi_devices/Kconfig
```kconfig
menu "SPI devices"
    config IOT_LCD_ENABLE
        bool "SPI_LCD_ENABLE"
        default y
        help
            "Select this one to enable SPI LCD device" 
    config IOT_EINK_ENABLE
        bool "SPI_E-INK_ENABLE"
        default y
        help
            "Select this one to enable SPI E-INK SCREEN device"
    config IOT_TOUCH_SCREEN_ENABLE
        bool "SPI_TOUCH_SCERRN_ENABLE"
        default y
        help
            "Select this one to enable SPI TOUCH SCREEN device"
endmenu
```

## components/storage/ramfs/test_apps/sdkconfig.defaults
```kconfig
# CONFIG_ESP_TASK_WDT_EN is not set
CONFIG_FREERTOS_HZ=1000
CONFIG_VFS_SUPPORT_DIR=y
CONFIG_PARTITION_TABLE_CUSTOM=y
CONFIG_PARTITION_TABLE_CUSTOM_FILENAME="partitions.csv"
# FATFS sync tests use directory names longer than 8.3, so enable long filename support.
CONFIG_FATFS_LFN_STACK=y
CONFIG_FATFS_MAX_LFN=255
```

## components/touch/touch_button/test_apps/sdkconfig.defaults.esp32p4
```kconfig
CONFIG_IDF_TARGET="esp32p4"

# Default to test REV < 3
CONFIG_ESP32P4_SELECTS_REV_LESS_V3=y
```

## components/touch/touch_button_sensor/Kconfig
```kconfig
menu "Touch Button Sensor Configuration"

    config TOUCH_BUTTON_SENSOR_DEBUG
        bool "Enable touch button sensor debug mode"
        default n
        help
            Enable touch button sensor debug mode.

    config TOUCH_BUTTON_SENSOR_CALIBRATION_TIMES
        int "Calibration times"
        default 20
        range 10 1000
        help
            Number of readings used for initial calibration.

    config TOUCH_BUTTON_SENSOR_DEBOUNCE_INACTIVE
        int "Debounce inactive count"
        default 1 if IDF_TARGET_ESP32
        default 2
        range 1 50
        help
            Number of consecutive readings below threshold needed to confirm inactive state.

    config TOUCH_BUTTON_SENSOR_POLLING_INTERVAL
        int "Polling interval (ms)"
        default 20
        range 5 100
        depends on IDF_TARGET_ESP32
        help
            Interval between polling touch readings in milliseconds (for ESP32 only).

    config TOUCH_BUTTON_SENSOR_SMOOTH_COEF_X1000
        int "Smooth coefficient (/1000)"
        default 400
        range 0 1000
        help
            Coefficient for smooth filter, multiplied by 1000.
            For example, 200 means 0.2

    config TOUCH_BUTTON_SENSOR_BASELINE_COEF_X1000
        int "Baseline coefficient (/1000)"
        default 150 if IDF_TARGET_ESP32
        default 100
        range 0 1000
        help
            Coefficient for baseline filter, multiplied by 1000.
            For example, 100 means 0.1

    config TOUCH_BUTTON_SENSOR_MAX_P_X1000
        int "Maximum positive change ratio (/1000)"
        default 0
        range 0 1000
        help
            Maximum positive change ratio from baseline, multiplied by 1000.
            For example, 200 means 0.2. 0 means automatically set limit based on threshold.

    config TOUCH_BUTTON_SENSOR_MIN_N_X1000
        int "Minimum negative change ratio (/1000)"
        default 0
        range 0 1000
        help
            Minimum negative change ratio from baseline, multiplied by 1000.
            For example, 200 means 0.2. 0 means automatically set limit based on threshold.

    config TOUCH_BUTTON_SENSOR_NEGATIVE_LOGIC
        bool "Using negative logic to detect touch"
        default n
        help
            Using both positive and negative threshold to detect touch.

    config TOUCH_BUTTON_SENSOR_NOISE_P_SNR
        int "Positive noise SNR"
        default 4
        range 3 100
        help
            Signal-to-noise for positive Noise

    config TOUCH_BUTTON_SENSOR_NOISE_N_SNR
        int "Negative noise SNR"
        default 4
        range 2 100
        help
            Signal-to-noise for negative Noise

    config TOUCH_BUTTON_SENSOR_RESET_COVER
        int "Reset count from cover"
        default 1000
        range 0 5000
        help
            Reset count if cover is detected. 0 means no reset.

    config TOUCH_BUTTON_SENSOR_RESET_CALIBRATION
        int "Reset count from calibration error"
        default 3
        range 0 100
        help
            Reset count for negative threshold. 0 means no reset.

    config TOUCH_BUTTON_SENSOR_RAW_BUF_SIZE
        int "Raw buffer size"
        default 10
        range 5 100
        help
            Size of raw data buffer.

    config TOUCH_BUTTON_SENSOR_SCALE_FACTOR
        int "Scale factor"
        default 100 if !IDF_TARGET_ESP32
        default 1000
        range 10 1000
        help
            Scale factor for threshold calculation.

    config TOUCH_BUTTON_SENSOR_SIMULTANEOUS_TRIGGER_WINDOW_MS
        int "Simultaneous trigger window (ms)"
        default 40
        range 10 200
        help
            Time window in milliseconds for considering triggers as simultaneous.
            Multiple frequency triggers within this window will be considered as
            a single touch event. Smaller values make detection more strict,
            larger values make detection more tolerant to timing variations.

    config TOUCH_BUTTON_SENSOR_TRIGGER_CLEANUP_TIMEOUT_MS
        int "Trigger cleanup timeout (ms)"
        default 200
        range 50 1000
        help
            Timeout in milliseconds for cleaning up old trigger records.
            Trigger records older than this timeout will be automatically
            cleared to prevent memory accumulation and false detections.

endmenu
```

## components/usb/esp_msc_ota/test_apps/sdkconfig.defaults
```kconfig
CONFIG_PARTITION_TABLE_CUSTOM=y
CONFIG_ESPTOOLPY_FLASHSIZE_4MB=y
CONFIG_FREERTOS_HZ=1000
CONFIG_ESP_TASK_WDT_EN=n
```

## components/usb/esp_tinyuf2/Kconfig
```kconfig
menu "TinyUF2 Config"
    # We not support disable now
    config ENABLE_UF2_FLASHING
        bool
        default y if IDF_TARGET_ESP32S2 || IDF_TARGET_ESP32S3 || IDF_TARGET_ESP32P4
        select TINYUSB_SOURCE_CODE_ONLY
        help
            Enable UF2, only support ESP SoC with USB-OTG
    config ENABLE_UF2_USB_CONSOLE
        bool "Enable USB Console For log"
        depends on ENABLE_UF2_FLASHING
        default n
    config UF2_DISK_SIZE_MB
        int "USB Virtual Disk size(MB)"
        depends on ENABLE_UF2_FLASHING
        default 8
        range 4 32
    config UF2_FLASH_SIZE_MB
        int "Max APP size(MB)"
        depends on ENABLE_UF2_FLASHING
        default 4
        range 2 8
    config FLASH_CACHE_SIZE
        int "Flash cache size(KB)"
        depends on ENABLE_UF2_FLASHING
        default 32
        range 4 64
    config TUSB_VID
        hex "USB Device VID"
        depends on ENABLE_UF2_FLASHING
        default 0x303A
    config TUSB_PID
        hex "USB Device PID"
        depends on ENABLE_UF2_FLASHING
        default 0x8000
    config UF2_VOLUME_LABEL
        string "USB Disk Name"
        depends on ENABLE_UF2_FLASHING
        default "ESP32S2-UF2" if IDF_TARGET_ESP32S2
        default "ESP32S3-UF2" if IDF_TARGET_ESP32S3
        default "ESP32P4-UF2" if IDF_TARGET_ESP32P4
    config TUSB_MANUFACTURER
        string "USB Device Manufacture"
        depends on ENABLE_UF2_FLASHING
        default "Espressif"
    config TUSB_PRODUCT
        string "Product Name"
        depends on ENABLE_UF2_FLASHING
        default "ESP TinyUF2"
    config UF2_SERIAL_NUM
        string "Product ID"
        depends on ENABLE_UF2_FLASHING
        default "12345678"
    config UF2_INDEX_URL
        string "Product URL"
        depends on ENABLE_UF2_FLASHING
        default "https://products.espressif.com/"
    config UF2_INI_FILE_SIZE
        int "UF2 NVS ini file size"
        depends on ENABLE_UF2_FLASHING
        default 512
        range 256 2048
    config UF2_INI_NVS_VALUE_HIDDEN
        bool "Enable UF2 ini file hide NVS value"
        depends on ENABLE_UF2_FLASHING
        default n
    config UF2_INI_NVS_HIDDEN_MAX_NUM
        int "UF2 ini file hide NVS value max number"
        depends on UF2_INI_NVS_VALUE_HIDDEN
        default 32
    config UF2_OTA_FACTORY_ONLY
        bool "OTA Factory Only"
        help
            Enable this option to limit the OTA updates to the factory partition only.
    config UF2_OTA_RESET_REASON_VALUE
        hex "OTA Reset Reason Value"
        depends on ENABLE_UF2_FLASHING
        default 0xF2
        help
            The reset value for uf2 ota reset.

    choice TINYUSB_RHPORT
        prompt "TinyUSB Root Port"
        default TINYUSB_RHPORT_HS if IDF_TARGET_ESP32P4
        default TINYUSB_RHPORT_FS
        help
            Allows set the USB PHY Controller for TinyUSB: HS (USB OTG2.0 PHY for HighSpeed)

        config TINYUSB_RHPORT_HS
            depends on IDF_TARGET_ESP32P4
            bool "High Speed"

        config TINYUSB_RHPORT_FS
            bool "Full Speed"
    endchoice

endmenu
```

## components/usb/esp_usbh_cdc/Kconfig
```kconfig
menu "USB Host CDC"
    config CDC_GET_DEVICE_DESC
        bool "Get device descriptor during emum"
        default y
    config CDC_GET_CONFIG_DESC
        bool "Get config descriptor during emum"
        default y
    config CDC_SEND_DTE_ACTIVE
        bool "Set control line state during init"
        default y
    config USB_TASK_CORE_ID
        int "usb task core_id"
        default 0
        range 0 0 if IDF_TARGET_ESP32S2
        range 0 1 if IDF_TARGET_ESP32S3
        help
            pin usb task to specified core
    config USB_TASK_BASE_PRIORITY
        int "usb task base priority"
        default 5
        help
            usb task base priority, usb task = base + 2, cdc task = base + 1
    config CTRL_TRANSFER_DATA_MAX_BYTES
        int "Max control transfer data size (Bytes)"
        range 64 2048
        default 256
    config CDC_BULK_IN_URB_NUM
        int "cdc bulk_in urb num"
        default 2
        help
            bulk in urb numbers, increase this to handle heavy traffic
    config CDC_BULK_OUT_URB_NUM
        int "cdc bulk_out urb num"
        default 2
        help
            bulk out urb numbers, increase this to handle heavy traffic
    config CDC_BULK_IN_URB_BUFFER_SIZE
        int "cdc bulk_in urb buffer size"
        default 512
        help
            buffer size of each bulk in urb, should be multiple of endpoint mps
    config CDC_BULK_OUT_URB_BUFFER_SIZE
        int "cdc bulk_out urb buffer size"
        default 512
        help
            buffer size of each bulk out urb
    config CDC_USE_TRACE_FACILITY
        bool "Trace internal memory status"
        default n
        help
            set to trace internal buffer usage for debug 

endmenu
```
