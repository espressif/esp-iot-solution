## components/sensors/battery_fuel_gauge/adc_battery_estimation/Kconfig
```kconfig
menu "ADC Battery Estimation"

    choice OCV_SOC_MODEL
        bool "Select default OCV and battery capacity model"
        default OCV_SOC_MODEL_1
        help
            Select Model

        config OCV_SOC_MODEL_1
            bool "OCV_SOC Model 1"
            help
                This model is based on TI's document: Battery Fuel Gauging Algorithm Comparison
                You can find the document here: https://www.ti.com/lit/SLUAAR3

        config OCV_SOC_MODEL_2
            bool "OCV_OSC Model 2"
            help
                This model is based on Analog Devices' document:
                "Characterizing a Lithium-Ion (Li+) Cell for Use with an Open-Circuit-Voltage (OCV) Based Fuel Gauge"
                You can find the document at:
                https://www.analog.com/en/resources/design-notes/characterizing-a-lithiumion-li-cell-for-use-with-an-opencircuitvoltage-ocv-based-fuel-gauge.html
    endchoice

    config ADC_FILTER_WINDOW_SIZE
        int "ADC Filter Window size"
        range 5 15
        default 10
        help
            The number of ADC measurements to take before filtering the battery voltage, the
            higher the value the more stable the battery voltage will be, but will take longer
            to update

    config BATTERY_CAPACITY_LPF_COEFFICIENT
        int "Battery Capacity LPF Coefficient (/10)"
        range 1 10
        default 2
        help
            First-order low-pass filter coefficient for battery capacity calculation.
            The value is divided by 10 to get the actual coefficient (e.g., 2 means 0.2).
            Lower values provide more smoothing but slower response to changes.
            Higher values provide less smoothing but faster response to changes.

    config BATTERY_STATE_SOFTWARE_ESTIMATION
        bool "Battery State Software Estimation"
        default y
        help
            Enable software-based estimation of the battery state to determine
            whether the battery is charging or discharging.

    menu "Software Estimation Configuration"
        depends on BATTERY_STATE_SOFTWARE_ESTIMATION

        config SOFTWARE_ESTIMATION_SAMPLE_COUNT
            int "Software Estimation Sample Count"
            range 10 15
            default 10
            help
                The number of samples to collect for software-based battery state estimation.
                A higher number of samples can provide more accurate estimation but may increase
                the time required for estimation.

        config SOFTWARE_ESTIMATION_SAMPLE_INTERVAL
            int "Software Estimation Sample Interval (ms)"
            range 10000 100000
            default 20000
            help
                The interval in milliseconds between each sample for software-based battery state estimation.
                A shorter interval allows for quicker detection of changes in battery state but may consume
                more power.
    endmenu

endmenu
```

## components/sensors/battery_fuel_gauge/adc_battery_estimation/test_apps/sdkconfig.defaults
```kconfig
CONFIG_ESP_DEFAULT_CPU_FREQ_MHZ_240=y
CONFIG_FREERTOS_HZ=1000
CONFIG_ESP_TASK_WDT_EN=n
```

## components/sensors/battery_fuel_gauge/bq27220/tools/sample-data-app/main/Kconfig.projbuild
```kconfig
menu "BQ27220 Sample APP Config"
    config I2C_SCL_IO
        int "GPIO number for I2C SCL"
        default 1
    config I2C_SDA_IO
        int "GPIO number for I2C SDA"
        default 2
    config DISCHARGE_ENABLE_IO
        int "GPIO number for discharge enable"
        default 4
    config END_DISCHAGE_VOLTAGE
        int "End discharge voltage (mV)"
        default 3300
endmenu
```

## components/sensors/gas/bme690/Kconfig
```kconfig
menu "BME690 Configuration"
    config BME690_I2C_TIMEOUT_VALUE_MS
        int "I2C timeout value in milliseconds"
        default 50
        range 1 1000
        help
            Set the I2C timeout value in milliseconds.

    config BME690_AMBIENT_TEMP
        int "Ambient temperature"
        default 25
        range 10 50
        help
            Set the ambient temperature in degrees Celsius, used for defining
            the heater temperature.
endmenu
```

## components/sensors/humiture/aht20/Kconfig
```kconfig
menu "AHT20 : CONFIGURATION"

    config AHT20_CHECK_CRC
        bool "perform crc check on AHT20 readings"
        help
            CRC check to be performed on results or not?.
	default n

endmenu
```

## components/sensors/humiture/aht20/test_apps/aht20_driver_test/main/Kconfig.projbuild
```kconfig
menu "Example Configuration"

    config I2C_MASTER_SCL
        int "SCL GPIO Num"
        default 40
        help
            GPIO number for I2C Master clock line.

    config I2C_MASTER_SDA
        int "SDA GPIO Num"
        default 41
        help
            GPIO number for I2C Master data line.

endmenu
```

## components/sensors/humiture/aht20/test_apps/aht20_driver_test/sdkconfig.defaults
```kconfig
# For IDF 5.0
CONFIG_ESP_TASK_WDT_EN=n

# For IDF4.4
CONFIG_ESP_TASK_WDT=n

CONFIG_ESP_CONSOLE_USB_SERIAL_JTAG=y
```

## components/sensors/humiture/aht20/test_apps/main/Kconfig.projbuild
```kconfig
menu "Example Configuration"

    config I2C_MASTER_SCL
        int "SCL GPIO Num"
        default 22
        help
            GPIO number for I2C Master clock line.

    config I2C_MASTER_SDA
        int "SDA GPIO Num"
        default 21
        help
            GPIO number for I2C Master data line.

endmenu
```

## components/sensors/humiture/humiture_hal/Kconfig
```kconfig
menu "Humiture Hal Options"
    config SENSOR_HUMITURE_INCLUDED_SHT3X
        bool "include SHT3X driver"
        default y
    config SENSOR_HUMITURE_INCLUDED_HTS221
        bool "include HTS221 driver"
        default y
endmenu
```

## components/sensors/imu/imu_hal/Kconfig
```kconfig
menu "IMU Hal Options"
    config SENSOR_IMU_INCLUDED_MPU6050
        bool "include MPU6050 driver"
        default y
    config SENSOR_IMU_INCLUDED_LIS2DH12
        bool "include LIS2DH12 driver"
        default y
endmenu
```

## components/sensors/light_sensor/light_sensor_hal/Kconfig
```kconfig
menu "Light Sensor Hal Options"
    config SENSOR_LIGHT_INCLUDED_BH1750
        bool "include BH1750 driver"
        default y
    config SENSOR_LIGHT_INCLUDED_VEML6040
        bool "include VEML6040 driver"
        default y
    config SENSOR_LIGHT_INCLUDED_VEML6075
        bool "include VEML6075 driver"
        default y
endmenu
```

## components/sensors/ntc_driver/Kconfig
```kconfig
menu "NTC Driver Configuration"

    config ENABLE_NTC_ADC_FILTER
        bool "Enable ADC Filter for NTC"
        default y
        help
        Enable ADC Filter for NTC, the driver will take multiple ADC measurements
        and then filters them to avoid ADC noise

    config NTC_FILTER_WINDOW_SIZE
        int "NTC Filter Window Size"
        default 50
        depends on ENABLE_NTC_ADC_FILTER
        help
        The number of ADC measurements to take before filtering the NTC value, the
        higher the value the more stable the NTC value will be, but will take longer
        to update

endmenu
```

## components/sensors/ntc_driver/test_apps/sdkconfig.defaults
```kconfig
# For IDF 5.0
CONFIG_ESP_DEFAULT_CPU_FREQ_MHZ_240=y
CONFIG_FREERTOS_HZ=1000
CONFIG_ESP_TASK_WDT_EN=n
CONFIG_FREERTOS_TIMER_TASK_STACK_DEPTH=4096

CONFIG_FATFS_LONG_FILENAMES=y
CONFIG_FATFS_LFN_STACK=y

CONFIG_MCPWM_ISR_IN_IRAM=y
CONFIG_GPTIMER_CTRL_FUNC_IN_IRAM=y
```

## components/sensors/power_measure/Kconfig
```kconfig
menu "power_measure"
    choice POWER_MEASURE_CHIP_TYPE
        prompt "Power measurement chip type"
        default POWER_MEASURE_CHIP_BL0937
        help
            Select the power measurement chip type to use

        config POWER_MEASURE_CHIP_BL0937
            bool "BL0937"
            help
                BL0937 is a single-phase power measurement IC with high accuracy
                Features: Voltage, Current, Power, Power Factor, Energy measurement
                Interface: GPIO (CF, CF1, SEL pins)

        config POWER_MEASURE_CHIP_INA236
            bool "INA236"
            help
                INA236 is a precision digital power monitor with I2C interface
                Features: Voltage, Current, Power measurement
                Interface: I2C
                Note: Does not support energy measurement or power factor

        config POWER_MEASURE_CHIP_BL0942
            bool "BL0942"
            help
                BL0942 is a single-phase power measurement IC with UART/SPI interface
                Features: Voltage, Current, Power, Power Factor, Energy measurement
                Interface: UART or SPI
                Note: Supports both UART and SPI communication modes
    endchoice

    config BL0937_IRAM_OPTIMIZED
        bool "Enable IRAM optimization for BL0937"
        default n
        depends on POWER_MEASURE_CHIP_BL0937
        help
            Enable IRAM optimization for BL0937

    config BL0942_UART_OPTIMIZED
        bool "Enable UART optimization for BL0942"
        default n
        depends on POWER_MEASURE_CHIP_BL0942
        help
            Enable UART optimization for BL0942 communication

    menu "BL0937 Hardware Configuration"
        config BL0937_VREF_MV
            int "Internal voltage reference (mV)"
            default 1218
            help
                Internal voltage reference value for BL0937 in millivolts (1218 = 1.218V)

        config BL0937_R_CURRENT_MOHM
            int "Current sampling resistor (mOhm)"
            default 1
            help
                Value of the current sampling resistor in milliohms (1 = 1mOhm for ~30A max measurement)

        config BL0937_R_VOLTAGE
            int "Voltage divider resistor (Ohm)"
            default 2010
            help
                Value of the voltage divider resistor (typically 6x 470K upstream + 1K downstream = 2010)

        config BL0937_F_OSC
            int "Internal oscillator frequency (Hz)"
            default 2000000
            help
                Frequency of the BL0937 internal clock

        config BL0937_PULSE_TIMEOUT_US
            int "Pulse timeout (microseconds)"
            default 1000000
            help
                Timeout for pulse detection. Higher values allow better precision but reduce sampling rate.
                Lower values increase sampling rate but reduce precision.
                Values below 500000 (0.5s) are not recommended.
    endmenu

    menu "BL0942 Hardware Configuration"
        config BL0942_UART_BAUD_RATE
            int "UART baud rate"
            default 4800
            depends on POWER_MEASURE_CHIP_BL0942
            help
                UART baud rate for BL0942 communication

        config BL0942_DEVICE_ADDRESS
            int "Device address"
            default 0
            depends on POWER_MEASURE_CHIP_BL0942
            help
                BL0942 device address (0-255)

        config BL0942_USE_SPI
            bool "Use SPI interface instead of UART"
            default n
            depends on POWER_MEASURE_CHIP_BL0942
            help
                Enable SPI interface for BL0942 communication
    endmenu

    menu "GPIO Pin Configuration"
        menu "BL0937 GPIO Pins"
            config BL0937_CF_GPIO
                int "CF GPIO pin number"
                default 3
                help
                    GPIO pin connected to BL0937 CF pin (current frequency output)

            config BL0937_SEL_GPIO
                int "SEL GPIO pin number"
                default 4
                help
                    GPIO pin connected to BL0937 SEL pin (selection pin)

            config BL0937_CF1_GPIO
                int "CF1 GPIO pin number"
                default 7
                help
                    GPIO pin connected to BL0937 CF1 pin (power frequency output)
        endmenu

        menu "INA236 I2C GPIO Pins"
            config INA236_I2C_SCL_GPIO
                int "I2C SCL GPIO pin number"
                default 13
                help
                    GPIO pin for I2C clock line

            config INA236_I2C_SDA_GPIO
                int "I2C SDA GPIO pin number"
                default 20
                help
                    GPIO pin for I2C data line
        endmenu

        menu "BL0942 GPIO Pins"
            config BL0942_UART_TX_GPIO
                int "UART TX GPIO pin number"
                default 6
                depends on POWER_MEASURE_CHIP_BL0942
                help
                    GPIO pin for BL0942 UART TX

            config BL0942_UART_RX_GPIO
                int "UART RX GPIO pin number"
                default 7
                depends on POWER_MEASURE_CHIP_BL0942
                help
                    GPIO pin for BL0942 UART RX

            config BL0942_SPI_MOSI_GPIO
                int "SPI MOSI GPIO pin number"
                default -1
                depends on POWER_MEASURE_CHIP_BL0942
                help
                    GPIO pin for BL0942 SPI MOSI (set to -1 if not used)

            config BL0942_SPI_MISO_GPIO
                int "SPI MISO GPIO pin number"
                default -1
                depends on POWER_MEASURE_CHIP_BL0942
                help
                    GPIO pin for BL0942 SPI MISO (set to -1 if not used)

            config BL0942_SPI_SCLK_GPIO
                int "SPI SCLK GPIO pin number"
                default -1
                depends on POWER_MEASURE_CHIP_BL0942
                help
                    GPIO pin for BL0942 SPI SCLK (set to -1 if not used)

            config BL0942_SPI_CS_GPIO
                int "SPI CS GPIO pin number"
                default -1
                depends on POWER_MEASURE_CHIP_BL0942
                help
                    GPIO pin for BL0942 SPI CS (set to -1 if not used)
        endmenu
    endmenu
endmenu
```

## components/sensors/power_monitor/ina236/test_apps/sdkconfig.defaults
```kconfig
CONFIG_ESP_DEFAULT_CPU_FREQ_MHZ_240=y
CONFIG_FREERTOS_HZ=1000
CONFIG_ESP_TASK_WDT_EN=n
CONFIG_ESP_CONSOLE_USB_SERIAL_JTAG=y
CONFIG_FREERTOS_TIMER_TASK_STACK_DEPTH=4096
```
