## components/display/tools/esp_lv_eaf_player/test_apps/lvgl8/sdkconfig.defaults
```kconfig
# For IDF 5.0
CONFIG_ESP_TASK_WDT_EN=n

CONFIG_ESPTOOLPY_FLASHSIZE_4MB=y
CONFIG_PARTITION_TABLE_CUSTOM=y
CONFIG_ESP_MAIN_TASK_STACK_SIZE=8192

CONFIG_ESP_CONSOLE_USB_SERIAL_JTAG=y
CONFIG_IDF_TARGET="esp32s3"
```

## components/display/tools/esp_lv_lottie_player/test_apps/lvgl9/sdkconfig.defaults
```kconfig
# For IDF 5.0
CONFIG_ESP_TASK_WDT_EN=n

CONFIG_ESPTOOLPY_FLASHSIZE_2MB=y
CONFIG_PARTITION_TABLE_CUSTOM=y

CONFIG_ESP_MAIN_TASK_STACK_SIZE=8192

CONFIG_ESP_CONSOLE_USB_SERIAL_JTAG=y
CONFIG_IDF_TARGET="esp32s3"

# PSRAM configuration (required for lottie player)
CONFIG_SPIRAM=y
CONFIG_SPIRAM_MODE_OCT=y
```

## components/display/tools/esp_lvgl_adapter/Kconfig
```kconfig
menu "ESP LV Adapter"

config ESP_LVGL_ADAPTER_ENABLE_FS
    bool "Enable esp_lv_fs integration"
    default n

config ESP_LVGL_ADAPTER_ENABLE_DECODER
    bool "Enable esp_lv_decoder integration"
    default n

config ESP_LVGL_ADAPTER_ENABLE_FREETYPE
    bool "Enable FreeType font support"
    default n
    help
        Enable FreeType library for rendering TrueType/OpenType vector fonts.
        Fonts are auto-cleaned up in esp_lv_adapter_deinit().

        Requirements:
        - Enable CONFIG_LV_USE_FREETYPE in LVGL configuration

        Stack Configuration:
        - LVGL v8: Set CONFIG_ESP_MAIN_TASK_STACK_SIZE >= 32768
        - LVGL v9: Set CONFIG_LV_DRAW_THREAD_STACK_SIZE >= 32768

        Limitations:
        - LVGL v8: Cannot use LVGL virtual filesystem (lv_fs) for fonts
        - LVGL v9: Can use virtual filesystem paths like "F:font.ttf"

config ESP_LVGL_ADAPTER_ENABLE_FPS_STATS
    bool "Enable FPS statistics"
    default n
    help
        Enable FPS (Frames Per Second) statistics for display performance monitoring.
        When enabled, you can use esp_lv_adapter_fps_* APIs to get real-time FPS.
        Performance overhead is negligible (< 2 microseconds per frame).

config ESP_LVGL_ADAPTER_ENABLE_BUTTON
    bool "Enable button input support"
    default n
    help
        Enable navigation buttons input device support.
        Requires espressif/button component.

        When enabled:
        - Button navigation APIs are available
        - Supports 3-button navigation (prev, next, enter)
        - Compatible with both button component v3 and v4+

        When disabled:
        - Button-related code will not be compiled
        - Saves ~5-10KB of flash space
        - espressif/button dependency can be removed from your project

config ESP_LVGL_ADAPTER_ENABLE_KNOB
    bool "Enable knob/encoder input support"
    default n
    help
        Enable rotary encoder (knob) input device support.
        Requires espressif/knob component.

        When enabled:
        - Encoder APIs are available
        - Supports rotary encoder with optional button
        - Ideal for menu navigation without touch screen

        When disabled:
        - Knob-related code will not be compiled
        - Saves ~8-12KB of flash space
        - espressif/knob dependency can be removed from your project

endmenu
```

## components/display/tools/esp_lvgl_adapter/benchmark/sdkconfig.defaults.esp32p4
```kconfig
CONFIG_IDF_TARGET="esp32p4"

CONFIG_CACHE_L2_CACHE_256KB=y
CONFIG_CACHE_L2_CACHE_LINE_128B=y
CONFIG_IDF_EXPERIMENTAL_FEATURES=y

CONFIG_LV_DRAW_SW_DRAW_UNIT_CNT=2

# Default to test REV < 3
CONFIG_ESP32P4_SELECTS_REV_LESS_V3=y
```

## components/display/tools/esp_lvgl_adapter/benchmark/sdkconfig.defaults.esp32s3
```kconfig
CONFIG_IDF_TARGET="esp32s3"

CONFIG_ESP_DEFAULT_CPU_FREQ_MHZ_240=y
CONFIG_ESP32S3_INSTRUCTION_CACHE_32KB=y
CONFIG_ESP32S3_DATA_CACHE_64KB=y
CONFIG_ESP32S3_DATA_CACHE_LINE_64B=y

CONFIG_LV_DRAW_SW_DRAW_UNIT_CNT=2
```

## components/display/tools/esp_lvgl_adapter/test_apps/lvgl8/sdkconfig.defaults
```kconfig
CONFIG_ESPTOOLPY_FLASHSIZE_4MB=y
CONFIG_PARTITION_TABLE_CUSTOM=y
CONFIG_PARTITION_TABLE_CUSTOM_FILENAME="partitions.csv"
CONFIG_COMPILER_OPTIMIZATION_PERF=y
CONFIG_ESP_MAIN_TASK_STACK_SIZE=32000
CONFIG_ESP_TASK_WDT_EN=n
CONFIG_FREERTOS_HZ=1000
CONFIG_ESP_LVGL_ADAPTER_ENABLE_FS=y
CONFIG_ESP_LVGL_ADAPTER_ENABLE_DECODER=y
CONFIG_ESP_LVGL_ADAPTER_ENABLE_FREETYPE=y
CONFIG_LV_MEM_CUSTOM=y
CONFIG_LV_MEMCPY_MEMSET_STD=y
CONFIG_LV_DISP_DEF_REFR_PERIOD=15
CONFIG_LV_DPI_DEF=60
CONFIG_LV_GRADIENT_MAX_STOPS=4
CONFIG_LV_USE_PERF_MONITOR=y
CONFIG_LV_USE_FS_POSIX=y
CONFIG_LV_FS_POSIX_LETTER=65
CONFIG_LV_USE_FREETYPE=y
CONFIG_LV_FREETYPE_SBIT_CACHE=y
```

## components/display/tools/esp_lvgl_adapter/test_apps/lvgl8/sdkconfig.defaults.esp32c3
```kconfig
# ESP32-C3 default configuration

CONFIG_IDF_TARGET="esp32c3"

# ESP32-C3 typically uses SPI without PSRAM with encoder/knob input
CONFIG_ESP_LVGL_ADAPTER_ENABLE_BUTTON=y
CONFIG_ESP_LVGL_ADAPTER_ENABLE_KNOB=y

CONFIG_LV_COLOR_16_SWAP=y

# ESP32C3 LCDKit
CONFIG_ESP_CONSOLE_USB_SERIAL_JTAG=y
```

## components/display/tools/esp_lvgl_adapter/test_apps/lvgl9/sdkconfig.defaults
```kconfig
CONFIG_ESPTOOLPY_FLASHSIZE_4MB=y
CONFIG_COMPILER_OPTIMIZATION_PERF=y

# Unity test framework
CONFIG_ESP_TASK_WDT_EN=n
CONFIG_ESP_MAIN_TASK_STACK_SIZE=3884

# FreeRTOS configuration
CONFIG_FREERTOS_HZ=1000

# LVGL configuration
CONFIG_LV_USE_CLIB_MALLOC=y
CONFIG_LV_USE_CLIB_STRING=y
CONFIG_LV_USE_CLIB_SPRINTF=y
CONFIG_LV_DEF_REFR_PERIOD=15
CONFIG_LV_DPI_DEF=60
CONFIG_LV_OS_FREERTOS=y
CONFIG_LV_DRAW_LAYER_SIMPLE_BUF_SIZE=48000
CONFIG_LV_DRAW_THREAD_PRIO=4
CONFIG_LV_DRAW_SW_SHADOW_CACHE_SIZE=4
CONFIG_LV_GRADIENT_MAX_STOPS=4
CONFIG_LV_OBJ_STYLE_CACHE=y
CONFIG_LV_USE_SYSMON=y
CONFIG_LV_USE_PERF_MONITOR=y
CONFIG_LV_USE_FS_POSIX=y
CONFIG_LV_FS_POSIX_LETTER=65
CONFIG_LV_USE_FREETYPE=y
CONFIG_LV_DRAW_THREAD_STACK_SIZE=32768
CONFIG_LV_FREETYPE_SBIT_CACHE=y
CONFIG_LV_FREETYPE_USE_LVGL_PORT=y

# LVGL adapter extensions
CONFIG_ESP_LVGL_ADAPTER_ENABLE_DECODER=y
CONFIG_ESP_LVGL_ADAPTER_ENABLE_FS=y
CONFIG_ESP_LVGL_ADAPTER_ENABLE_FREETYPE=y

# Partition table configuration
CONFIG_PARTITION_TABLE_CUSTOM=y
CONFIG_PARTITION_TABLE_CUSTOM_FILENAME="partitions.csv"
```

## components/display/tools/esp_lvgl_adapter/test_apps/lvgl9/sdkconfig.defaults.esp32c3
```kconfig
CONFIG_IDF_TARGET="esp32c3"

CONFIG_ESP_LVGL_ADAPTER_ENABLE_BUTTON=y
CONFIG_ESP_LVGL_ADAPTER_ENABLE_KNOB=y

# ESP32C3 LCDKit
CONFIG_ESP_CONSOLE_USB_SERIAL_JTAG=y
```

## components/display/tools/esp_lvgl_adapter/test_apps/lvgl9/sdkconfig.defaults.esp32s3
```kconfig
CONFIG_IDF_TARGET="esp32s3"
CONFIG_ESPTOOLPY_FLASHFREQ_80M=y

CONFIG_SPIRAM=y
CONFIG_SPIRAM_MODE_OCT=y
CONFIG_SPIRAM_XIP_FROM_PSRAM=y
CONFIG_SPIRAM_SPEED_80M=y
CONFIG_SPIRAM_MEMTEST=n
CONFIG_ESP_DEFAULT_CPU_FREQ_MHZ_240=y
CONFIG_ESP32S3_INSTRUCTION_CACHE_32KB=y
CONFIG_ESP32S3_DATA_CACHE_64KB=y
CONFIG_ESP32S3_DATA_CACHE_LINE_64B=y

CONFIG_LV_DRAW_SW_DRAW_UNIT_CNT=2

# ESP32S3 ESP BOX 3
CONFIG_ESP_CONSOLE_USB_SERIAL_JTAG=y
```

## components/display/tools/esp_mmap_assets/Kconfig
```kconfig
# Kconfig file for MMAP

menu "mmap file support format"
    config MMAP_FILE_NAME_LENGTH
        int "Max file name length (Deprecated: for legacy fallback only)"
        default 16
        range 1 32
        help
            This parameter is DEPRECATED.
            New version of mmap assets (.bin) store name length in the binary header.
            This value is ONLY used when a legacy binary (v0) is detected to determine the name stride.
endmenu
```

## components/display/tools/esp_mmap_assets/test_apps/sdkconfig.defaults
```kconfig
# For IDF 5.0
CONFIG_ESP_TASK_WDT_EN=n

CONFIG_ESPTOOLPY_FLASHSIZE_4MB=y
CONFIG_PARTITION_TABLE_CUSTOM=y
```

## components/display/touch_panel/Kconfig
```kconfig
menu "Touch Screen Driver"
    menu "Choose Touch Screen Driver"
        config TOUCH_DRIVER_XPT2046
            bool "XPT2046"
            default n
        config TOUCH_DRIVER_FT5X06
            bool "FT5X06"
            default y
        config TOUCH_DRIVER_NS2016
            bool "NS2016"
            default n
    endmenu

    config TOUCH_PANEL_MAX_CALIBRATE_ERROR
        int "Calibrate Max Error"
        range 10 1000
        default 100
        help 
            Only used to verify calibration parameter for the resister touch panel. Consider as a failure when the square of the error is greater than TOUCH_PANEL_MAX_CALIBRATE_ERROR.

    config TOUCH_PANEL_THRESHOLD_PRESS
        int "Press Threshold"
        range 64 1024
        default 150
        help 
            Only used to judge whether to press for the resister touch panel.
endmenu
```

## components/display/touch_panel/test_apps/sdkconfig.defaults
```kconfig
# For IDF 5.0
CONFIG_FREERTOS_HZ=1000
CONFIG_ESP_TASK_WDT_EN=n

# For IDF4.4
CONFIG_ESP_TASK_WDT=n
```

## components/elf_loader/Kconfig
```kconfig
menu "Espressif ELF Loader Configuration"
    visible if (IDF_TARGET_ESP32 || IDF_TARGET_ESP32S2 || IDF_TARGET_ESP32S3 || IDF_TARGET_ESP32C6 || IDF_TARGET_ESP32P4 || IDF_TARGET_ESP32C61)

    config ELF_LOADER_BUS_ADDRESS_MIRROR
        bool
        default y if (IDF_TARGET_ESP32 || IDF_TARGET_ESP32S2 || IDF_TARGET_ESP32S3)
        default n if (IDF_TARGET_ESP32C6 || IDF_TARGET_ESP32P4 || IDF_TARGET_ESP32C61)

    config ELF_LOADER
        bool "Enable Espressif ELF Loader"
        default y
        depends on (IDF_TARGET_ESP32 || IDF_TARGET_ESP32S2 || IDF_TARGET_ESP32S3 || IDF_TARGET_ESP32C6 || IDF_TARGET_ESP32P4 || IDF_TARGET_ESP32C61)
        help
            Select this option to enable ELF Loader and show the submenu with ELF Loader configuration choices.

    if ELF_LOADER
        config ELF_LOADER_CACHE_OFFSET
            bool
            default n
            help
                Select this option if D-cache and I-cache has different offset to access the same physical address.

        config ELF_LOADER_SET_MMU
            bool
            default n
            help
                Select this option if D-cache and I-cache is not symmetry。

        config ELF_LOADER_LOAD_PSRAM
            bool "Load ELF to PSRAM"
            default y
            depends on (IDF_TARGET_ESP32S2 || IDF_TARGET_ESP32S3 || IDF_TARGET_ESP32P4 || IDF_TARGET_ESP32C61) && SPIRAM
            select ELF_LOADER_CACHE_OFFSET if (IDF_TARGET_ESP32S2 || IDF_TARGET_ESP32S3)
            select ELF_LOADER_SET_MMU if IDF_TARGET_ESP32S2
            help
                Load ELF file into PSRAM instead of internal SRAM.

        menu "ELF Symbols Table"

            config ELF_LOADER_LIBC_SYMBOLS
                bool "Libc Symbols Table"
                default y

            config ELF_LOADER_ESPIDF_SYMBOLS
                bool "ESP-IDF Symbols Table"
                default y

            config ELF_LOADER_CUSTOMER_SYMBOLS
                bool "Customer Symbols Table"
                default n
        endmenu
    endif
endmenu
```

## components/esp_weaver/Kconfig
```kconfig
menu "ESP Weaver"

    config ESP_WEAVER_LOCAL_CTRL_HTTP_PORT
        int "Local control HTTP port"
        default 8080
        range 1 65535
        help
            HTTP port for local control service.

    config ESP_WEAVER_LOCAL_CTRL_HTTP_CTRL_PORT
        int "Local control HTTP internal control port"
        default 12312
        range 1 65535
        help
            Internal control port for the HTTP server used by esp_local_ctrl.
            Must be different from the HTTP port above. Change if it conflicts
            with other services on the device.

    config ESP_WEAVER_LOCAL_CTRL_STACK_SIZE
        int "Local control HTTP server task stack size"
        default 6144
        help
            Stack size for the HTTP server task used by local control.
            Increase if you encounter stack overflow, decrease to save memory.

    config ESP_WEAVER_LOCAL_CTRL_SECURITY_VERSION
        int "Local control security version"
        default 1
        range 0 1
        help
            Security version for local control.

            0 = SEC0 (No security)
                WARNING: SEC0 provides NO encryption or authentication.
                Communication is transmitted in plaintext and can be
                intercepted or modified by attackers on the network.
                Do NOT use SEC0 in production environments.

            1 = SEC1 (Security with Proof of Possession) [RECOMMENDED]
                Provides encrypted communication using a shared secret (PoP).
                This is the recommended setting for all production deployments.

            The default is SEC1 (secure-by-default). Only use SEC0 for
            debugging purposes in isolated development environments.

    config ESP_WEAVER_NVS_PARTITION_NAME
        string "NVS partition name"
        default "nvs"
        help
            Name of the NVS partition used for storing PoP.
            Change if your application uses a custom NVS partition name
            (e.g. "fctry").

    config ESP_WEAVER_LOCAL_CTRL_MAX_PROPERTIES
        int "Maximum number of local control properties"
        default 4
        range 2 32
        help
            Maximum number of properties registered with esp_local_ctrl.
            Default is 4 (config + params + 2 reserved for future use).

endmenu
```

## components/esp_weaver/test_apps/sdkconfig.defaults
```kconfig
CONFIG_ESP_TASK_WDT_EN=n

CONFIG_PARTITION_TABLE_CUSTOM=y
CONFIG_PARTITION_TABLE_CUSTOM_FILENAME="partitions.csv"

CONFIG_ESPTOOLPY_FLASHSIZE_4MB=y
CONFIG_ESP_MAIN_TASK_STACK_SIZE=5120

CONFIG_UNITY_ENABLE_FLOAT=y

CONFIG_LOG_DEFAULT_LEVEL_INFO=y
```
