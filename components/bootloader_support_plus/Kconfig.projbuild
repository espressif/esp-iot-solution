## components/bootloader_support_plus/Kconfig.projbuild
```kconfig
menu "Bootloader config (Custom)"
    config BOOTLOADER_COMPRESSED_ENABLED
        bool "Enable compressed OTA support"
        default n

    choice BOOTLOADER_CUSTOM_DECOMPRESSOR
        prompt "Choose decompressor"
        default BOOTLOADER_DECOMPRESSOR_XZ
        depends on BOOTLOADER_COMPRESSED_ENABLED
        help
            Choose the corresponding decompression method to decompress the compressed OTA binary.

        config BOOTLOADER_DECOMPRESSOR_XZ
        bool "XZ"
        help
            Using XZ decompressor in custom bootloader.

    endchoice

    config BOOTLOADER_DIFF_DDELTA
        bool "Enable ddelta patch apply"
        depends on BOOTLOADER_COMPRESSED_ENABLED && !ENABLE_LEGACY_ESP_BOOTLOADER_PLUS_V2_SUPPORT
        default n
        help
            Apply an xz-compressed ddelta patch in the bootloader.
            The patch is stored in the last app partition. The new firmware
            is written to the app slot that is neither the base firmware nor
            that last partition, so the table needs at least three app slots.
            Legacy esp-bootloader-plus v2 mode does not support ddelta.

    config SKIP_VALIDATE_FULL_BASE_IMAGE
        bool "Skip full base image validation in ddelta OTA"
        depends on BOOTLOADER_DIFF_DDELTA
        default y
        help
            The patch header carries a CRC32 of the whole base firmware file.
            A mismatch rejects the patch before the destination slot is erased.
            Set this option to n to also run esp_image_verify() on the base
            app before the patch is applied. That checks image structure and,
            with secure boot, the signature. The file CRC still runs. Leave
            this y to keep the file CRC only.

    config SKIP_VALIDATE_FULL_NEW_IMAGE
        bool "Skip full new image validation in ddelta OTA"
        depends on BOOTLOADER_DIFF_DDELTA
        default y
        help
            After a ddelta patch is applied, the bootloader updates otadata and
            then boots. The next load validates the new app. A failed image is
            rejected there and another bootable app is started.
            Set this option to n to run esp_image_verify() on the rebuilt app
            before otadata is switched. A failed check restores otadata to the
            previously running slot. Flash encryption and secure boot verify
            the signature again at load time, so this extra pass lengthens boot.
            Leave it y to skip that pass.

    config BOOTLOADER_CUSTOM_DEBUG_ON
        bool "Turn on debug log in custom bootloader"
        default n

    config SKIP_VALIDATE_CUSTOM_COMPRESSED_HEADER
        bool "Skip compressed header validation after downloading compressed image"
        default n

    config SKIP_VALIDATE_CUSTOM_COMPRESSED_DATA
        bool "Skip compressed data validation in custom bootloader"
        default n

    config ENABLE_LEGACY_ESP_BOOTLOADER_PLUS_V2_SUPPORT
        bool "Enable legacy esp bootloader plus v2 support"
        default n
        depends on IDF_TARGET_ESP32 || IDF_TARGET_ESP32C2 || IDF_TARGET_ESP32C3
        help
            This option is reserved to support devices already using esp-bootloader-plus scheme.
            The triggering decompression mechanism in esp-bootloader-plus scheme and bootloader-support-plus scheme is different,
            so they are not compatible. Please make sure you only enable this option when you need the support of esp-bootloader-plus scheme.
            ddelta differential OTA is not supported in this mode.
endmenu
```

## components/display/tools/esp_lv_eaf_player/Kconfig
```kconfig
menu "ESP LV EAF Player"

    config ESP_LV_EAF_ENABLE_LVGL_ADAPTER
        bool "Enable LVGL adapter when LVGL is available"
        default y
        help
            Disable to build only the GUI-independent player even when another
            part of the application depends on LVGL.

    config ESP_LV_EAF_ENABLE_SW_JPEG
        bool "Enable Software JPEG Decoding"
        default y
        help
            Enable software JPEG decoder for EAF files with JPEG-encoded blocks.
            Disabling this option removes the software fallback. Hardware JPEG on
            supported SoCs remains available; unsupported dimensions or formats
            then return an error instead of falling back to software.

            You can disable this when all assets use Palette RLE/Huffman,
            Lossless or Bounded and contain no JPEG/JPEG Delta blocks.

endmenu
```

## components/display/tools/esp_lv_eaf_player/test_apps/core/main/Kconfig.projbuild
```kconfig
# SPDX-FileCopyrightText: 2026 Espressif Systems (Shanghai) CO LTD
# SPDX-License-Identifier: Apache-2.0
config EAF_TEST_ALL_MODES
    bool "Run continuous all-mode conformance checks"
    default n
    help
        Generate a procedural reference pack and verify all codecs/frame modes.
        Requires NumPy and Pillow in EAF_TEST_FIXTURE_PYTHON at configure time.
```

## components/display/tools/esp_lv_eaf_player/test_apps/core/sdkconfig.defaults.esp32p4
```kconfig
CONFIG_SPIRAM=y
CONFIG_SPIRAM_MODE_HEX=y
CONFIG_SPIRAM_SPEED_200M=y
CONFIG_ESPTOOLPY_FLASHSIZE_16MB=y
```

## examples/display/lcd/lcd_low_power_always_on/main/Kconfig.projbuild
```kconfig
menu "Standby clock"
    config EXAMPLE_DSI_SOFTWARE_RESET
        bool "Use DSI software reset for EK79007"
        depends on IDF_TARGET_ESP32P4
        default n
        help
            Send DCS SWRESET through the DSI command channel. Enable only on
            boards that hold the panel RESET input at a valid inactive level
            without the ESP32-P4 driving it.
endmenu
```

## examples/ota/simple_ota_example/main/Kconfig.projbuild
```kconfig
menu "Example Configuration"

    config EXAMPLE_DIFF_OTA
        bool "Support differential compressed OTA"
        default n
        depends on !ENABLE_LEGACY_ESP_BOOTLOADER_PLUS_V2_SUPPORT
        select BOOTLOADER_COMPRESSED_ENABLED
        select BOOTLOADER_DIFF_DDELTA
        help
            Use partition_for_diff_ota.csv and apply an xz-compressed ddelta
            patch in the bootloader. The patch is stored in ota_2.
            Leave this off for a pure compressed update, which keeps
            partition_for_compressed_ota.csv. Selecting this option enables
            the bootloader ddelta engine; switch the partition table itself
            by building with sdkconfig.defaults.diff_ota (see README).

    config EXAMPLE_FIRMWARE_UPGRADE_URL
        string "firmware upgrade url endpoint"
        default "https://192.168.0.3:8070/hello_world.bin"
        help
            URL of server which hosts the firmware
            image.

    config EXAMPLE_USE_CERT_BUNDLE
        bool "Enable certificate bundle"
        default y
        depends on MBEDTLS_CERTIFICATE_BUNDLE
        help
            Enable trusted root certificate bundle. This approach allows to have
            OTA updates functional with any public server without requirement
            to explicitly add its server certificate.

    config EXAMPLE_FIRMWARE_UPGRADE_URL_FROM_STDIN
        bool
        default y if EXAMPLE_FIRMWARE_UPGRADE_URL = "FROM_STDIN"

    config EXAMPLE_SKIP_COMMON_NAME_CHECK
        bool "Skip server certificate CN fieldcheck"
        default n
        help
            This allows you to skip the validation of OTA server certificate CN field.

    config EXAMPLE_FIRMWARE_UPGRADE_BIND_IF
        bool "Support firmware upgrade bind specified interface"
        default n
        help
            This allows you to bind specified interface in OTA example.

    choice EXAMPLE_FIRMWARE_UPGRADE_BIND_IF_TYPE
        prompt "Choose OTA data bind interface"
        default EXAMPLE_FIRMWARE_UPGRADE_BIND_IF_STA
        depends on EXAMPLE_FIRMWARE_UPGRADE_BIND_IF
        help
            Select which interface type of OTA data go through.

        config EXAMPLE_FIRMWARE_UPGRADE_BIND_IF_STA
            bool "Bind wifi station interface"
            depends on EXAMPLE_CONNECT_WIFI
            help
                Select wifi station interface to pass the OTA data.

        config EXAMPLE_FIRMWARE_UPGRADE_BIND_IF_ETH
            bool "Bind ethernet interface"
            depends on EXAMPLE_CONNECT_ETHERNET
            help
                Select ethernet interface to pass the OTA data.
    endchoice
endmenu
```

## examples/power/tps55288/main/Kconfig.projbuild
```kconfig
menu "Example Configuration"

    orsource "$IDF_PATH/examples/common_components/env_caps/$IDF_TARGET/Kconfig.env_caps"

    config I2C_MASTER_SCL
        int "SCL GPIO Num"
        range ENV_GPIO_RANGE_MIN ENV_GPIO_OUT_RANGE_MAX
        default 4 if IDF_TARGET_ESP32
        default 5
        help
            GPIO number for the I2C master clock line.
            ESP32 defaults to GPIO4. GPIO6 is the SPI flash clock on ESP32.

    config I2C_MASTER_SDA
        int "SDA GPIO Num"
        range ENV_GPIO_RANGE_MIN ENV_GPIO_OUT_RANGE_MAX
        default 5 if IDF_TARGET_ESP32
        default 6
        help
            GPIO number for the I2C master data line.
            ESP32 defaults to GPIO5. GPIO6 is the SPI flash clock on ESP32.

    config I2C_MASTER_FREQUENCY
        int "Master Frequency"
        default 400000
        help
            I2C speed of the master device.

endmenu
```
