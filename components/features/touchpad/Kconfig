## components/led/indicator/Kconfig
```kconfig
menu "Status LED"
    config STATUS_LED_QUICK_BLINK_FREQ
        int "Quick blink frequency(Hz)"
        range 1 20
        default 5
    config STATUS_LED_SLOW_BLINK_FREQ
        int "Slow blink frequency(Hz)"
        range 1 20
        default 1
    
    choice STATUS_LED_SPEED_MODE_CHOICE
        bool "LEDC speed mode"
        default USE_LEDC_HIGHSPEED_MODE
        config USE_LEDC_HIGHSPEED_MODE
            bool "Select LEDC high-speed mode for status LED"
        config USE_LEDC_LOWSPEED_MODE
            bool "Select LEDC low-speed mode for status LED" 
    endchoice
    config STATUS_LED_SPEED_MODE
        int
        default 0 if USE_LEDC_HIGHSPEED_MODE
        default 1 if USE_LEDC_LOWSPEED_MODE
        
    # -------------- led quick blink config ---------------
        
    choice STATUS_LED_QUICK_BLINK_CHANNEL_CHOICE
        bool  "Status LED quick blink channel"
        default STATUS_LED_QUICK_BLINK_CHANNEL_0
        
        config STATUS_LED_QUICK_BLINK_CHANNEL_0
            bool "channel 0"
        config STATUS_LED_QUICK_BLINK_CHANNEL_1
            bool "channel 1"
        config STATUS_LED_QUICK_BLINK_CHANNEL_2
            bool "channel 2"                
        config STATUS_LED_QUICK_BLINK_CHANNEL_3
            bool "channel 3"                
        config STATUS_LED_QUICK_BLINK_CHANNEL_4
            bool "channel 4"                
        config STATUS_LED_QUICK_BLINK_CHANNEL_5
            bool "channel 5"
        config STATUS_LED_QUICK_BLINK_CHANNEL_6
            bool "channel 6"                
        config STATUS_LED_QUICK_BLINK_CHANNEL_7
            bool "channel 7" 
        config STATUS_LED_QUICK_BLINK_CHANNEL_DEF
            bool "channel default(0)"                                 
    endchoice
    config STATUS_LED_QUICK_BLINK_CHANNEL
        int 
        default 0 if STATUS_LED_QUICK_BLINK_CHANNEL_0
        default 1 if STATUS_LED_QUICK_BLINK_CHANNEL_1
        default 2 if STATUS_LED_QUICK_BLINK_CHANNEL_2
        default 3 if STATUS_LED_QUICK_BLINK_CHANNEL_3
        default 4 if STATUS_LED_QUICK_BLINK_CHANNEL_4
        default 5 if STATUS_LED_QUICK_BLINK_CHANNEL_5
        default 6 if STATUS_LED_QUICK_BLINK_CHANNEL_6
        default 7 if STATUS_LED_QUICK_BLINK_CHANNEL_7
        default 0 if STATUS_LED_QUICK_BLINK_CHANNEL_DEF
    
    choice STATUS_LED_QUICK_BLINK_TIMER_CHOICE
        bool  "Status LED quick blink timer"
        default STATUS_LED_QUICK_BLINK_TIMER_0
        
        config STATUS_LED_QUICK_BLINK_TIMER_0
            bool "TIMER 0"
        config STATUS_LED_QUICK_BLINK_TIMER_1
            bool "TIMER 1"
        config STATUS_LED_QUICK_BLINK_TIMER_2
            bool "TIMER 2"                
        config STATUS_LED_QUICK_BLINK_TIMER_3
            bool "TIMER 3"       
        config STATUS_LED_QUICK_BLINK_TIMER_DEF
            bool "TIMER default(0)"                                            
    endchoice
    config STATUS_LED_QUICK_BLINK_TIMER
        int 
        default 0 if STATUS_LED_QUICK_BLINK_TIMER_0
        default 1 if STATUS_LED_QUICK_BLINK_TIMER_1
        default 2 if STATUS_LED_QUICK_BLINK_TIMER_2
        default 3 if STATUS_LED_QUICK_BLINK_TIMER_3
        default 0 if STATUS_LED_QUICK_BLINK_TIMER_DEF
    
    
        
    # --------------- led slow blink config ----------------
    
    choice STATUS_LED_SLOW_BLINK_CHANNEL_CHOICE
        bool  "Status LED slow blink channel"
        default STATUS_LED_SLOW_BLINK_CHANNEL_1
        
        config STATUS_LED_SLOW_BLINK_CHANNEL_0
            bool "channel 0"
        config STATUS_LED_SLOW_BLINK_CHANNEL_1
            bool "channel 1"
        config STATUS_LED_SLOW_BLINK_CHANNEL_2
            bool "channel 2"                
        config STATUS_LED_SLOW_BLINK_CHANNEL_3
            bool "channel 3"                
        config STATUS_LED_SLOW_BLINK_CHANNEL_4
            bool "channel 4"                
        config STATUS_LED_SLOW_BLINK_CHANNEL_5
            bool "channel 5"
        config STATUS_LED_SLOW_BLINK_CHANNEL_6
            bool "channel 6"                
        config STATUS_LED_SLOW_BLINK_CHANNEL_7
            bool "channel 7"  
        config STATUS_LED_SLOW_BLINK_CHANNEL_DEF
            bool "channel default(1)"                                                  
    endchoice
    config STATUS_LED_SLOW_BLINK_CHANNEL
        int 
        default 0 if STATUS_LED_SLOW_BLINK_CHANNEL_0
        default 1 if STATUS_LED_SLOW_BLINK_CHANNEL_1
        default 2 if STATUS_LED_SLOW_BLINK_CHANNEL_2
        default 3 if STATUS_LED_SLOW_BLINK_CHANNEL_3
        default 4 if STATUS_LED_SLOW_BLINK_CHANNEL_4
        default 5 if STATUS_LED_SLOW_BLINK_CHANNEL_5
        default 6 if STATUS_LED_SLOW_BLINK_CHANNEL_6
        default 7 if STATUS_LED_SLOW_BLINK_CHANNEL_7   
        default 1 if STATUS_LED_SLOW_BLINK_CHANNEL_DEF
         
    choice STATUS_LED_SLOW_BLINK_TIMER_CHOICE
        bool  "Status LED slow blink timer"
        default STATUS_LED_SLOW_BLINK_TIMER_1
        
        config STATUS_LED_SLOW_BLINK_TIMER_0
            bool "TIMER 0"
        config STATUS_LED_SLOW_BLINK_TIMER_1
            bool "TIMER 1"
        config STATUS_LED_SLOW_BLINK_TIMER_2
            bool "TIMER 2"                
        config STATUS_LED_SLOW_BLINK_TIMER_3
            bool "TIMER 3"     
        config STATUS_LED_SLOW_BLINK_TIMER_DEF
            bool "TIMER default(1)"                                              
    endchoice
    config STATUS_LED_SLOW_BLINK_TIMER
        int 
        default 0 if STATUS_LED_SLOW_BLINK_TIMER_0
        default 1 if STATUS_LED_SLOW_BLINK_TIMER_1
        default 2 if STATUS_LED_SLOW_BLINK_TIMER_2
        default 3 if STATUS_LED_SLOW_BLINK_TIMER_3   
        default 1 if STATUS_LED_SLOW_BLINK_TIMER_DEF   
        
                 
    # ---------------- led night mode config ------------------
    
    config STATUS_LED_NIGHT_MODE_ENABLE
        bool "Status LED night mode enable"
        default y
        
        choice STATUS_LED_NIGHT_MODE_CHANNEL_CHOICE
            bool  "Status LED night mode channel"
            default STATUS_LED_NIGHT_MODE_CHANNEL_2
            depends on STATUS_LED_NIGHT_MODE_ENABLE
            
            config STATUS_LED_NIGHT_MODE_CHANNEL_0
                bool "channel 0"
            config STATUS_LED_NIGHT_MODE_CHANNEL_1
                bool "channel 1"
            config STATUS_LED_NIGHT_MODE_CHANNEL_2
                bool "channel 2"                
            config STATUS_LED_NIGHT_MODE_CHANNEL_3
                bool "channel 3"                
            config STATUS_LED_NIGHT_MODE_CHANNEL_4
                bool "channel 4"                
            config STATUS_LED_NIGHT_MODE_CHANNEL_5
                bool "channel 5"
            config STATUS_LED_NIGHT_MODE_CHANNEL_6
                bool "channel 6"                
            config STATUS_LED_NIGHT_MODE_CHANNEL_7
                bool "channel 7"      
            config STATUS_LED_NIGHT_MODE_CHANNEL_DEF
                bool "channel default(2)"                                                  
        endchoice
        config STATUS_LED_NIGHT_MODE_CHANNEL
            int 
            default 0 if STATUS_LED_NIGHT_MODE_CHANNEL_0
            default 1 if STATUS_LED_NIGHT_MODE_CHANNEL_1
            default 2 if STATUS_LED_NIGHT_MODE_CHANNEL_2
            default 3 if STATUS_LED_NIGHT_MODE_CHANNEL_3
            default 4 if STATUS_LED_NIGHT_MODE_CHANNEL_4
            default 5 if STATUS_LED_NIGHT_MODE_CHANNEL_5
            default 6 if STATUS_LED_NIGHT_MODE_CHANNEL_6
            default 7 if STATUS_LED_NIGHT_MODE_CHANNEL_7  
            default 2 if STATUS_LED_NIGHT_MODE_CHANNEL_DEF
        
        choice STATUS_LED_NIGHT_MODE_TIMER_CHOICE
            bool  "Status LED night mode timer"
            default STATUS_LED_NIGHT_MODE_TIMER_2
            depends on STATUS_LED_NIGHT_MODE_ENABLE
            
            config STATUS_LED_NIGHT_MODE_TIMER_0
                bool "TIMER 0"
            config STATUS_LED_NIGHT_MODE_TIMER_1
                bool "TIMER 1"
            config STATUS_LED_NIGHT_MODE_TIMER_2
                bool "TIMER 2"                
            config STATUS_LED_NIGHT_MODE_TIMER_3
                bool "TIMER 3"    
            config STATUS_LED_NIGHT_MODE_TIMER_DEF
                bool "TIMER default(2)"                                                   
        endchoice
        config STATUS_LED_NIGHT_MODE_TIMER
            int 
            default 0 if STATUS_LED_NIGHT_MODE_TIMER_0
            default 1 if STATUS_LED_NIGHT_MODE_TIMER_1
            default 2 if STATUS_LED_NIGHT_MODE_TIMER_2
            default 3 if STATUS_LED_NIGHT_MODE_TIMER_3  
            default 2 if STATUS_LED_NIGHT_MODE_TIMER_DEF  
endmenu  
```

## components/led/led_indicator/Kconfig
```kconfig
menu "LED Indicator"

    config BRIGHTNESS_TICKS
        int "One brightness change for ticks"
        range 1 50
        default 10

    config USE_GAMMA_CORRECTION
        bool "Enable gamma correction"
        default "y"

    config USE_MI_RGB_BLINK_DEFAULT
        bool "Use Xiaomi rgb blink default"
        default "n"

    menu "LEDC Config"

        choice LEDC_SPEED_MODE
            prompt "LEDC Speed Mode"
            default LEDC_LOW_SPEED_MODE

        config LEDC_HIGH_SPEED_MODE
            bool "LEDC high speed mode"
            depends on SOC_LEDC_SUPPORT_HS_MODE
        config LEDC_LOW_SPEED_MODE
            bool "LEDC low speed mode"
        endchoice

        config LEDC_SPEED_MODE_VALUE
            int
            default 1 if LEDC_LOW_SPEED_MODE && SOC_LEDC_SUPPORT_HS_MODE
            default 0 if LEDC_HIGH_SPEED_MODE && SOC_LEDC_SUPPORT_HS_MODE
            default 0 if LEDC_LOW_SPEED_MODE && !SOC_LEDC_SUPPORT_HS_MODE

        config LEDC_TIMER_BIT_NUM
            int "LEDC Timer Bit Num"
            default 13
            range 1 20 if SOC_LEDC_TIMER_BIT_WIDE_NUM > 14
            range 1 14 if SOC_LEDC_TIMER_BIT_WIDE_NUM <= 14
            help
                The bit number of LEDC timer (1 - SOC_LEDC_TIMER_BIT_WIDE_NUM)

        config LEDC_TIMER_FREQ_HZ
            int "LEDC Timer Frequency"
            default 5000
            help
                The frequency of LEDC timer (1 - 40000000)
    endmenu

endmenu
```

## components/led/led_indicator/test_apps/main/Kconfig.projbuild
```kconfig
menu "LED Indicator Test Configuration"

    config USE_IO_EXPANDER
        bool "Use IO Expander"
        default n

endmenu
```

## components/led/lightbulb_driver/Kconfig
```kconfig
menu "LightBulb Driver Config"

    menu "Drivers"
        config ENABLE_PWM_DRIVER
            bool "Enable PWM interface"
            default "y"
            help
                Enable PWM output.

        config PWM_ENABLE_HW_FADE
            depends on ENABLE_PWM_DRIVER
            bool "Use hardware fade API"
            default "n" if IDF_TARGET_ESP32C6
            default "y"
            help
                Use the hardware fade API to implement the fade function, and the change of the duty cycle will be smoother.
                Please note: the lightbulb component still uses esp_timer to trigger the fade API, and the fade API is only used for small-scale changes.

        config ENABLE_SM2135E_DRIVER
            bool "Enable sm2135e interface"
            default "y"
            help
                Enable SM2135E output.

        config ENABLE_SM2135EH_DRIVER
            bool "Enable sm2135eh interface"
            default "y"
            help
                Enable SM2135eh output.

        config ENABLE_SM2x35EGH_DRIVER
            bool "Enable sm2x35egh(sm2235egh sm2335egh) interface"
            default "y"
            help
                Enable SM2x35egh output.

        config ENABLE_BP5758D_DRIVER
            bool "Enable bp5758d interface"
            default "y"
            help
                Enable BP5758d output.

        config ENABLE_BP1658CJ_DRIVER
            bool "Enable bp1658cj interface"
            default "y"
            help
                Enable BP1658cj output.

        config ENABLE_KP18058_DRIVER
            bool "Enable kp18058 interface"
            default "y"
            help
                Enable KP18058 output.

        config ENABLE_WS2812_DRIVER
            bool "Enable ws2812 interface"
            default "y"
            help
                Enable ws2812 output.

        menu "IIC Send Task Config"
            depends on ENABLE_KP18058_DRIVER || ENABLE_BP1658CJ_DRIVER || ENABLE_BP5758D_DRIVER || ENABLE_SM2x35EGH_DRIVER || ENABLE_SM2135EH_DRIVER || ENABLE_SM2135E_DRIVER

            config LB_IIC_TASK_STACK
                int "IIC Send Task stack"
                default 2048
                help
                    Stack size for the IIC Send Task.

            config LB_IIC_QUEUE_SIZE
                int "IIC QUEUE Size"
                default 20
                help
                    Queue size for the IIC Send queue.

            config LB_IIC_TASK_PRIORITY
                int "IIC Send Task priority"
                default 20
                help
                    Priority for the IIC Send Task. Not recommended to be changed
                    unless you really need it.
        endmenu

    endmenu

    config ENABLE_DITHERING_CHECK
            bool "Enable dithering check and try to fix"
            default "y"
            help
                Dithering check and fix.

    config USE_GPTIMER_GENERATE_TICKS
            bool "Use gptimer generate tick"
            default "y"
            help
                fade tick uses gptimer instead of esp_timer.

    menu "Gptimer Tick Notify Task Config"
            depends on USE_GPTIMER_GENERATE_TICKS

            config LB_NOTIFY_TASK_STACK
                int "gptimer tick notify task stack"
                # for xtensa, the minimum stack size is 1280
                default 1280 if IDF_TARGET_ARCH_XTENSA
                default 1024
                help
                    Stack size for the gptimer tick notify task.

            config LB_NOTIFY_TASK_PRIORITY
                int "gptimer tick notify task priority"
                default 20
                help
                    Priority for the gptimer tick notify task. Not recommended to be changed
                    unless you really need it.
    endmenu

    menu "Debug Log Config"
        config ENABLE_LIGHTBULB_DEBUG_LOG_OUTPUT
            bool "Enable Lightbulb debug log output"
            default "n"
            help
                Enable Lightbulb debug log.

        config ENABLE_DRIVER_DEBUG_LOG_OUTPUT
            bool "Enable driver debug log output"
            default "n"
            help
                Enable driver debug log.

        choice LIGHTBULB_CHECK_LOG_DEFAULT_LEVEL
            bool "Default LIGHTBULB_CHECK func print log level"
            default LIGHTBULB_CHECK_DEFAULT_LEVEL_2
            help
                The verbosity of the log output, if you need to save flash size please lower the output level.

            config LIGHTBULB_CHECK_DEFAULT_LEVEL_1
                bool "Level 1, Print very little log"
            config LIGHTBULB_CHECK_DEFAULT_LEVEL_2
                bool "Level 2, Print basic log"
            config LIGHTBULB_CHECK_DEFAULT_LEVEL_3
                bool "Level 3, Print detail log"
        endchoice
    endmenu

endmenu
```

## components/led/lightbulb_driver/test_apps/sdkconfig.defaults
```kconfig
# Lightbulb driver
CONFIG_USE_GPTIMER_GENERATE_TICKS=n
CONFIG_ENABLE_LIGHTBULB_DEBUG=y

# IDF unit test
CONFIG_UNITY_FREERTOS_STACK_SIZE=10240
CONFIG_ESP_MAIN_TASK_STACK_SIZE=8192

# Freertos
CONFIG_FREERTOS_HZ=1000

# For IDF 5.0
CONFIG_ESP_TASK_WDT_EN=n

# For IDF4.4
CONFIG_ESP_TASK_WDT=n
```
