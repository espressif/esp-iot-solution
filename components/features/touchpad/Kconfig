## components/features/touchpad/Kconfig
```kconfig
menu "Touch Sensor"
    config DATA_SCOPE_DEBUG
        bool "Data scope debug (ESP-Tuning Tool)"
        default n
        help
            Enable scope debug function. Print the touch sensor raw data to ESP-Tuning tool via UART.
            ESP-Tuning tool is touch sensor tune tool. User can monitor the data of each touch channel,
            evaluate the touch system's touch performance (sensitivity, SNR, stability, channel coupling)
            and determine the threshold for each channel.
            attention 1. Choose a UART port that will only be used for scope debug.
            attention 2. Use this feature only during the testing phase.
            attention 3. ESP-Tuning tool can be downloaded from Espressif's official website.

        menu "Data scope port setting"
        depends on DATA_SCOPE_DEBUG
            config SCOPE_DEBUG_TASK_PRIORITY
                int "Scope debug task priority"
                range 0 25
                default 5

            choice SCOPE_PORT_NUM
                bool "Uart number (debug port)"
                default SCOPE_PORT_NUM_UART0
                help 
                    Choose a UART port that will only be used for scope debug. UART0 or UART1 or UART2.
                config SCOPE_PORT_NUM_UART0
                    bool "UART0"
                config SCOPE_PORT_NUM_UART1
                    bool "UART1"
                config SCOPE_PORT_NUM_UART2
                    bool "UART2"
            endchoice
                config SCOPE_DEBUG_PORT_NUM
                    int
                    default 0 if SCOPE_PORT_NUM_UART0
                    default 1 if SCOPE_PORT_NUM_UART1
                    default 2 if SCOPE_PORT_NUM_UART2
            
            choice SCOPE_PORT_BAUD_RATE
                bool "Baud rate (debug port)"
                default SCOPE_PORT_BAUD_RATE_921600
                help
                        Set the same parameters on the tool side.
                config SCOPE_PORT_BAUD_RATE_115200
                    bool "115200 (baud rate)"
                config SCOPE_PORT_BAUD_RATE_256000
                    bool "256000 (baud rate)"
                config SCOPE_PORT_BAUD_RATE_460800
                    bool "460800 (baud rate)"
                config SCOPE_PORT_BAUD_RATE_921600
                    bool "921600 (baud rate)[Default]"
                config SCOPE_PORT_BAUD_RATE_1152000
                    bool "1152000 (baud rate)"
            endchoice
            config SCOPE_DEBUG_BAUD_RATE
                int 
                default 115200  if SCOPE_PORT_BAUD_RATE_115200
                default 256000  if SCOPE_PORT_BAUD_RATE_256000
                default 460800  if SCOPE_PORT_BAUD_RATE_460800
                default 921600  if SCOPE_PORT_BAUD_RATE_921600
                default 1152000 if SCOPE_PORT_BAUD_RATE_1152000
            
            config SCOPE_DEBUG_UART_TXD_IO
                int "Uart TXD IO number"
                range 0 34
                default 1
                
            config SCOPE_DEBUG_UART_RXD_IO
                int "Uart RXD IO number"
                range 0 39
                default 3
        endmenu
endmenu
```

## components/general/button/button/Kconfig
```kconfig
menu "Button"
    config IO_GLITCH_FILTER_TIME_MS
        int "IO glitch filter timer ms (10~100)"
        range 10 100
        default 50
endmenu
```

## components/general/power_meter/power_meter/Kconfig
```kconfig
menu "Power meter"
    choice POWER_METER_PCNT_CHANNEL_CHOICE
        bool "power meter pcnt channel"
        default USE_PCNT_CHANNEL_0
        config USE_PCNT_CHANNEL_0
            bool "Select PCNT_CHANNEL_0 for power meter"
        config USE_PCNT_CHANNEL_1
            bool "Select PCNT_CHANNEL_1 for power meter"
    endchoice
    config POWER_METER_PCNT_CHANNEL
        int
        default 0 if USE_PCNT_CHANNEL_0
        default 1 if USE_PCNT_CHANNEL_1
    choice POWER_METER_VALUE_MULTIPLE_CHOICE
        bool "To choose different value accuracy"
        default VALUW_MULTIPLE_100
        config VALUE_MULTIPLE_1
            bool "read_value = (int)real_value"
        config VALUE_MULTIPLE_10
            bool "read_value = (int)(real_value * 10)"
        config VALUE_MULTIPLE_100
            bool "read_value = (int)(real_value * 100)"
    endchoice
    config POWER_METER_VALUE_MULTIPLE
        int
        default 1 if VALUE_MULTIPLE_1
        default 10 if VALUE_MULTIPLE_10
        default 100 if VALUE_MULTIPLE_100
    config POWER_METER_PCNT_FILTER
        int "Filter of pcnt channel, counter in APB_CLK cycles (1~1023)"
        range 1 1023
        default 100

    config POWER_METER_ZERO_PERIOD_MS
        int "Time(ms) to decide whether measure value is 0 (1000 ~ 10000)"
        range 1000 10000
        default 5000
endmenu
```

## components/general/relay/Kconfig
```kconfig
menu "Relay"
    config DFLIPFLOP_CLK_PERIOD_US
        int "Dflipflop clock period us (2~1000)"
        range 2 1000
        default 500
endmenu
```

## components/gprof/Kconfig
```kconfig
menu "Espressif GNU Profiler(GProf)"

    config GPROF_ENABLE
        bool "Enable Espressif GNU Profiler(GProf)"
        default n
        help
            Enable Espressif GNU Profiler(GProf) to gather profiling
            information when program is running

    if GPROF_ENABLE
        config GPROF_COMPONENTS
            string "Select components for GProf"
            default ""
            help
                Select components that are to be gathered profiling
                information when the program is running.

                Components must be separated by ";", if users want to
                profile component_A and component_B:

                    (component_A;component_B) Select components for GProf
    endif

endmenu
```

## components/i2c_bus/Kconfig
```kconfig
menu "Bus Options"

    menu "I2C Bus Options"
        config ESP_IDF_VERSION
            string
            option env="ESP_IDF_VERSION"

        config I2C_BUS_DYNAMIC_CONFIG
            bool "enable dynamic configuration"
            default y
            help
                If enable, i2c_bus will dynamically check configs and re-install i2c driver before each transfer,
                hence multiple devices with different configs on a single bus can be supported.

        config I2C_MS_TO_WAIT
            int "mutex block time"
            default 200
            range 50 5000
            help
                task block time when try to take the bus, unit:milliseconds

        config I2C_BUS_BACKWARD_CONFIG
            bool "Enable backward compatibility for the I2C driver (force use of the old i2c_driver above v5.3)"
            default n
            depends on ESP_IDF_VERSION >= 5.3
            help
                Enable this option for backward compatibility with the old I2C driver

        config I2C_BUS_SUPPORT_SOFTWARE
            bool "Enable software I2C support"
            default n
            help
                Enable this option to use a software-implemented I2C driver. This can be useful for scenarios where
                hardware I2C is unavailable or additional I2C buses are needed beyond the hardware support.

        config I2C_BUS_SOFTWARE_MAX_PORT
            int "Maximum number of software I2C ports"
            default 2
            range 1 5
            depends on I2C_BUS_SUPPORT_SOFTWARE
            help
                Set the maximum number of software I2C ports that can be used. This option is only applicable when
                software I2C support is enabled.
    endmenu

endmenu
```

## components/i2c_devices/i2c_bus/Kconfig
```kconfig
menu "I2C devices"
    config IOT_APDS9960_ENABLE
        bool "APDS9960 ENABLE"
        default y
        help
            "Select this one to enable APDS9960 device"   
    config IOT_AT24C02_ENABLE
        bool "AT24C02 ENABLE"
        default y
        help
            "Select this one to enable AT24C02 device"
    config IOT_BME280_ENABLE
        bool "BME280 ENABLE"
        default y
        help
            "Select this one to enable BME280 device"
    config IOT_CH450_ENABLE
        bool "CH450 ENABLE"
        default y
        help
            "Select this one to enable CH450 device" 
    config IOT_HT16C21_ENABLE
        bool "HT16C21 ENABLE"
        default y
        help
            "Select this one to enable HT16C21 device"
    config IOT_IS31FL3XXX_ENABLE
        bool "IS31FL3XXX ENABLE"
        default y
        help
            "Select this one to enable IS31FL3XXX device"
    config IOT_MCP23017_ENABLE
        bool "MCP23017 ENABLE"
        default y
        help
            "Select this one to enable MCP23017 device"
    config IOT_OLED_ENABLE
        bool "OLED_DEV_ENABLE(SSD1306)"
        default y
        help
            "Select this one to enable OLED device component"
        menu "OLED device"
            depends on OLED_ENABLE 
        endmenu     
        
    #------------------
    #--  I2C sensor --- 
    #------------------            
    config IOT_BH1750_ENABLE
        bool "SENSOR_BH1750_ENABLE"
        default y
        help
            "Select this one to enable BH1750 device component"  
    config IOT_HTS221_ENABLE
        bool "SENSOR_HTS221_ENABLE"
        default y
        help
            "Select this one to enable HTS221 device component"
    config IOT_LIS2DH12_ENABLE
        bool "SENSOR_LIS2DH12_ENABLE"
        default y
        help
            "Select this one to enable LIS2DH12 device component"
    config IOT_MVH3004D_ENABLE
        bool "SENSOR_MVH3004D_ENABLE"
        default y
        help
            "Select this one to enable MVH3004D device component"
    config IOT_VEML6040_ENABLE
        bool "SENSOR_VEML6040_ENABLE"
        default y
        help
            "Select this one to enable VEML6040 device component"
    config IOT_HDC2010_ENABLE
        bool "SENSOR_HDC2010_ENABLE"
        default y
        help
            "Select this one to enable HDC2010 device component"                    
    config IOT_FT5X06_ENABLE
        bool "SENSOR_FT5X06_ENABLE"
        default y
        help
            "Select this one to enable FT5X06 device component"

    config IOT_MPU6050_ENABLE
        bool "SENSOR_MPU6050_ENABLE"
        default y
        help
            "Select this one to enable MPU6050 device component"
endmenu
```

## components/i2s_devices/Kconfig
```kconfig
menu "I2S devices"
    config IOT_LCD_NT35510_ENABLE
        bool "I2S_LCD_NT35510_ENABLE"
        default y
        help
            "Select this one to enable NT35510 LCD device"      
    config IOT_LCD_ILI9806_ENABLE
        bool "I2S_LCD_ILI9806_ENABLE"
        default y
        help
            "Select this one to enable ILI9806 LCD device"   

    choice LCD_BITEMODE_CHOOSE
        bool "Choose Bit Mode"
            default BIT_MODE_16BIT

        config BIT_MODE_16BIT
            bool "16_BIT_MODE"
        config BIT_MODE_8BIT
            bool "8_BIT_MODE"

    endchoice
endmenu
```

## components/ir/ir_learn/Kconfig
```kconfig
menu "IR Learn"

    config RMT_MEM_BLOCK_SYMBOLS
        int "RMT MEM BLOCK SYMBOLS (DMA)"
        range 64 1024
        default 512
        help
            "Size of memory block, in number of `rmt_symbol_word_t`, must be an even."
            "In the DMA mode, this field controls the DMA buffer size, it can be set to a large value (e.g. 1024)"

    config RMT_DECODE_MARGIN_US
        int "DECODE MARGIN TIME (US)"
        range 10 300
        default 200
        help
            "Allowable error margin for each symbol level"

    config RMT_SINGLE_RANGE_MAX_US
        int "SINGLE RANGE MAX TIME (US)"
        range 10000 32767
        default 20000
        help
            "RMT will stop receiving if one symbol level has kept more than this time"

endmenu
```

## components/knob/Kconfig
```kconfig
menu "IOT Knob"

    config KNOB_PERIOD_TIME_MS
        int "BUTTON PERIOD TIME (MS)"
        range 2 10
        default 3
        help
            "Knob scan interval"

    config KNOB_DEBOUNCE_TICKS
        int "KNOB DEBOUNCE TICKS"
        range 1 8
        default 2
        help
            "One CONFIG_KNOB_DEBOUNCE_TICKS equal to n CONFIG_KNOB_PERIOD_TIME_MS"

    config KNOB_HIGH_LIMIT
        int "KNOB HIGH LIMIT"
        range 1 10000
        default 1000
        help
            "The highest number that can be counted by the knob"

    config KNOB_LOW_LIMIT
        int "KNOB LOW LIMIT"
        range -10000 -1
        default -1000
        help
            "The lowest number that can be counted by the knob"

endmenu
```
