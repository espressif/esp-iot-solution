## components/platforms/alink/Kconfig
```kconfig
menuconfig ALINK_ENABLE
    bool "Enable alink_embed function"
    default y
    help
       If the option is enabled, "ALINK_EMBED" works.

choice ALINK_VERSION
    bool "Select the version of alink"
    default ALINK_VERSION_EMBED
    depends on ALINK_ENABLE
    help
       esp32 alink embed is the access Ali small wisdom, SDK, APP side are all
       used in the Ali. Free service provided by Ali.

       esp32 alink sds's APP and the server are allowed to customize,  but need
       to pay the service fee

config ALINK_VERSION_EMBED
   bool "esp32 alink embed"
config ALINK_VERSION_SDS
   bool "esp32 alink sds"
endchoice

config ALINK_VERSION
    int
    default 0 if ALINK_VERSION_EMBED
    default 1 if ALINK_VERSION_SDS
    depends on ALINK_ENABLE

config ALINK_WRITE_NOT_BUFFER
    bool "Remove the buffer space for reporting data"
    default 0
    depends on ALINK_ENABLE
    help
        Remove the buffer space for reporting data.

config WIFI_WAIT_TIME
    int "the connection router maximum latency unit is seconds"
    default 60
    depends on ALINK_ENABLE
    help
        the connection router maximum latency unit is seconds

config ALINK_TASK_PRIOTY
    int "Configure the priority of all alink tasks"
    default 6
    depends on ALINK_ENABLE
    help
        Configure the priority of all alink tasks

config ALINK_EVENT_STACK_SIZE
    int "Event callback function stack space"
    default 4096
    depends on ALINK_ENABLE
    help
        Event callback function stack space

config ALINK_POST_DATA_STACK_SIZE
    int "The size of the task of reporting data to Ali"
    default 4096
    depends on ALINK_ENABLE
    help
        The size of the task of reporting data to Ali

config DOWN_CMD_QUEUE_NUM
    int "The number of buffered data received"
    default 3
    depends on ALINK_ENABLE
    help
        The number of buffered data received

config UP_CMD_QUEUE_NUM
    int "The number of buffered data send"
    default 3
    depends on ALINK_ENABLE
    help
        The number of buffered data send

config ALINK_DATA_LEN
    int "The maximum length of the transmitted data"
    default 1024
    depends on ALINK_ENABLE
    help
        The maximum length of this data is 1536B

config ALINK_CHIPID
    string "The name of the chip"
    default "esp32"
    depends on ALINK_ENABLE
    help
        Before modifying this parameter, make sure that the device is
        unbinded with Ali cloud server

config ALINK_MODULE_NAME
    string "The name of the module"
    default "ESP-WROOM-32"
    depends on ALINK_ENABLE
    help
        Before modifying this parameter, make sure that the device is
        unbinded with Ali cloud server

config DEVICE_ID_ADRR
    int "Device id storage address"
    default 3211264
    depends on ALINK_ENABLE
    help
        Device id storage address

choice LOG_ALINK_LEVEL
    bool "Configure the alink application layer's log"
    default LOG_ALINK_LEVEL_DEBUG
    depends on ALINK_ENABLE
    help
       Specify how much output to see in logs by default.
       Note that this setting limits which log statements
       are compiled into the program. So setting this to, say,
       "Warning" would mean that changing log level to "Debug"
       at runtime will not be possible.

config LOG_ALINK_LEVEL_NONE
   bool "No output"
config LOG_ALINK_LEVEL_ERROR
   bool "Error"
config LOG_ALINK_LEVEL_WARN
   bool "Warning"
config LOG_ALINK_LEVEL_INFO
   bool "Info"
config LOG_ALINK_LEVEL_DEBUG
   bool "Debug"
config LOG_ALINK_LEVEL_VERBOSE
   bool "Verbose"
endchoice

config LOG_ALINK_LEVEL
    int
    default 0 if LOG_ALINK_LEVEL_NONE
    default 1 if LOG_ALINK_LEVEL_ERROR
    default 2 if LOG_ALINK_LEVEL_WARN
    default 3 if LOG_ALINK_LEVEL_INFO
    default 4 if LOG_ALINK_LEVEL_DEBUG
    default 5 if LOG_ALINK_LEVEL_VERBOSE
    depends on ALINK_ENABLE

choice LOG_ALINK_SDK_LEVEL
    bool "Configure the alink sdk's log"
    default LOG_ALINK_SDK_LEVEL_TRACE
    depends on ALINK_ENABLE
    help
       Specify how much output to see in logs by default.
       Note that this setting limits which log statements
       are compiled into the program. So setting this to, say,
       "Warning" would mean that changing log level to "Debug"
       at runtime will not be possible.

config LOG_ALINK_SDK_LEVEL_NONE
   bool "No output"
config LOG_ALINK_SDK_LEVEL_ERROR
   bool "Error"
config LOG_ALINK_SDK_LEVEL_WARN
   bool "Warning"
config LOG_ALINK_SDK_LEVEL_INFO
   bool "Info"
config LOG_ALINK_SDK_LEVEL_DEBUG
   bool "Debug"
config LOG_ALINK_SDK_LEVEL_TRACE
   bool "Trace"
endchoice

config LOG_ALINK_SDK_LEVEL
    int
    default 0 if LOG_ALINK_SDK_LEVEL_NONE
    default 1 if LOG_ALINK_SDK_LEVEL_FATAL
    default 2 if LOG_ALINK_SDK_LEVEL_ERROR
    default 3 if LOG_ALINK_SDK_LEVEL_WARN
    default 4 if LOG_ALINK_SDK_LEVEL_INFO
    default 5 if LOG_ALINK_SDK_LEVEL_DEBUG
    default 6 if LOG_ALINK_SDK_LEVEL_TRACE
    depends on ALINK_ENABLE
```

## components/sensors/adc/mcp3201/test_apps/sdkconfig.defaults
```kconfig
CONFIG_ESP_DEFAULT_CPU_FREQ_MHZ_240=y
CONFIG_FREERTOS_HZ=1000
CONFIG_ESP_TASK_WDT_EN=n
CONFIG_FREERTOS_TIMER_TASK_STACK_DEPTH=4096
```
