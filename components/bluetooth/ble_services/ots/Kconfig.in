## components/bluetooth/ble_services/ots/Kconfig.in
```kconfig
# Object Transfer Service

menuconfig BLE_OTS
    bool "GATT Object Transfer Service"
    help
      Enable support for the Bluetooth Object Transfer Service (OTS),
      which allows transfer of binary objects between devices.

if BLE_OTS

config BLE_OTS_FIRST_CREATED_CHARACTERISTIC_ENABLE
    bool "Object First Created Characteristic"
    default y
    help
      Set y to enable First Created Characteristic or n to disable it.

config BLE_OTS_LAST_MODIFIED_CHARACTERISTIC_ENABLE
    bool "Object Last Modified Characteristic"
    default y
    help
      Set y to enable Last Modified Characteristic or n to disable it.

config BLE_OTS_OBJECT_CHANGE_CHARACTERISTIC_ENABLE
    bool "Object Change Characteristic"
    default y
    help
      Set y to enable Object Change Characteristic or n to disable it.

endif # BLE_OTS
```

## components/bluetooth/ble_services/tps/Kconfig.in
```kconfig
# GATT TX Power Service

menuconfig BLE_TPS
    bool "GATT TX Power Service"

if BLE_TPS

endif # BLE_TPS
```

## components/bluetooth/ble_services/uds/Kconfig.in
```kconfig
# User Data Service

menuconfig BLE_UDS
    bool "GATT User Data Service"

if BLE_UDS

config BLE_UDS_CHARACTERISTIC_ENABLE
    bool "User Data Service Characteristic"
    default n
    help
      Set y to support UDS characteristic or n to disable it.

config BLE_UDS_FEATURE_DB_CHG_NTF_ENABLE
    bool "UDS Databash change Increment Notification"
    default n
    help
      Set y to support Notification or n to disable it.

config BLE_UDS_REGISTER_USER_ENABLE
    bool "Body Composition Feature Indication"
    default n
    help
      Set y to support Registered or n to disable it.

endif # BLE_UDS
```

## components/bluetooth/ble_services/wss/Kconfig.in
```kconfig
# Weight Scale Service

menuconfig BLE_WSS
    bool "GATT Weight Scale Service"

if BLE_WSS

endif # BLE_WSS
```

## components/bootloader_support_plus/Kconfig.projbuild
```kconfig
menu "Bootloader config (Custom)"
    config BOOTLOADER_COMPRESSED_ENABLED
        bool "Enable compressed OTA support"
        default n

    choice BOOTLOADER_CUSTOM_DECOMPRESSOR
        prompt "Choose decompressor"
        default BOOTLOADER_DECOMPRESSOR_XZ
        depends on BOOTLOADER_COMPRESSED_ENABLED
        help
            Choose the corresponding decompression method to decompress the compressed OTA binary.

        config BOOTLOADER_DECOMPRESSOR_XZ
        bool "XZ"
        help
            Using XZ decompressor in custom bootloader.

    endchoice

    config BOOTLOADER_CUSTOM_DEBUG_ON
        bool "Turn on debug log in custom bootloader"
        default n

    config SKIP_VALIDATE_CUSTOM_COMPRESSED_HEADER
        bool "Skip compressed header validation after downloading compressed image"
        default n

    config SKIP_VALIDATE_CUSTOM_COMPRESSED_DATA
        bool "Skip compressed data validation in custom bootloader"
        default n

    config ENABLE_LEGACY_ESP_BOOTLOADER_PLUS_V2_SUPPORT
        bool "Enable legacy esp bootloader plus v2 support"
        help
            This option is reserved to support devices already using esp-bootloader-plus scheme.
            The triggering decompression mechanism in esp-bootloader-plus scheme and bootloader-support-plus scheme is different,
            so they are not compatible. Please make sure you only enable this option when you need the support of esp-bootloader-plus scheme.
        default n

endmenu
```

## components/button/Kconfig
```kconfig
menu "IoT Button"

    config BUTTON_PERIOD_TIME_MS
        int "BUTTON PERIOD TIME (MS)"
        range 2 500
        default 5
        help
            "Button scan interval"

    config BUTTON_DEBOUNCE_TICKS
        int "BUTTON DEBOUNCE TICKS"
        range 1 7
        default 2
        help
            "One CONFIG_BUTTON_DEBOUNCE_TICKS equal to CONFIG_BUTTON_PERIOD_TIME_MS"

    config BUTTON_SHORT_PRESS_TIME_MS
        int "BUTTON SHORT PRESS TIME (MS)"
        range 50 800
        default 180

    config BUTTON_LONG_PRESS_TIME_MS
        int "BUTTON LONG PRESS TIME (MS)"
        range 500 5000
        default 1500

    config BUTTON_LONG_PRESS_TOLERANCE_MS
        int "BUTTON LONG PRESS TOLERANCE TIME (MS)"
        default 20

    config BUTTON_SERIAL_TIME_MS
        int "BUTTON SERIAL TIME (MS)"
        range 2 1000
        default 20
        help
            "Serial trigger interval"

    config GPIO_BUTTON_SUPPORT_POWER_SAVE
        bool "GPIO BUTTON SUPPORT POWER SAVE"
        default n
        help
            Enable GPIO button power save

            The function enables the use of GPIO buttons during light sleep,
            but enabling this function prevents the simultaneous use of other
            types of buttons.

    config ADC_BUTTON_MAX_CHANNEL
        int "ADC BUTTON MAX CHANNEL"
        range 1 5
        default 3
        help
            "Maximum number of channels for ADC buttons"

    config ADC_BUTTON_MAX_BUTTON_PER_CHANNEL
        int "ADC BUTTON MAX BUTTON PER CHANNEL"
        range 1 10
        default 8
        help
            "Maximum number of buttons per channel"

    config ADC_BUTTON_SAMPLE_TIMES
        int "ADC BUTTON SAMPLE TIMES"
        range 1 4
        default 1
        help
            "Number of samples per scan"

endmenu
```

## components/dali/Kconfig
```kconfig
menu "DALI Component Configuration"

    comment "Part 101 (Physical Layer / RMT Driver) is always enabled."

    config DALI_PART102_ENABLED
        bool "Enable Part 102 — Control Gear (luminaires, drivers)"
        default y
        help
            Include support for IEC 62386-102 control gear: DAPC dimming,
            scene/group commands, commissioning (binary-search address
            assignment), and Part 209 DT8 colour control.

            Disable this option if your application only uses Part 103
            input devices and does not control any luminaires or drivers.

    config DALI_PART209_ENABLED
        bool "Enable Part 209 — DT8 Colour Control (CCT / RGB / RGBWAF)"
        default y
        depends on DALI_PART102_ENABLED
        help
            Include IEC 62386-209 (DT8) colour and colour-temperature
            control helpers (dali_master_set_colour / dali_enable_device_type).

            Requires Part 102 to be enabled. Disable this option if your
            luminaires are single-channel (DT6 or similar) and do not
            support colour control.

    config DALI_PART103_ENABLED
        bool "Enable Part 103 — Input Devices (sensors, push-buttons)"
        default y
        help
            Include support for IEC 62386-103 input devices: commissioning,
            device-level queries, and instance-level commands.

            Disable this option if your application only controls luminaires
            and does not use any DALI input devices.

    config DALI_PART303_304_ENABLED
        bool "Enable Part 303/304 — Occupancy & Light Sensor helpers"
        default y
        depends on DALI_PART103_ENABLED
        help
            Include IEC 62386-303 (occupancy sensor) and IEC 62386-304
            (light sensor) convenience wrappers.

            Requires Part 103 to be enabled. Disable this option if you
            use Part 103 input devices but do not need the occupancy/light
            sensor helper functions.

endmenu
```

## components/dali/Kconfig.projbuild
```kconfig
menu "DALI Driver"

    config DALI_RX_GPIO
        int "DALI RX GPIO number"
        range 0 48
        default 5
        help
            GPIO number connected to the DALI bus receive line.

    config DALI_TX_GPIO
        int "DALI TX GPIO number"
        range 0 48
        default 6
        help
            GPIO number connected to the DALI bus transmit line.

    config DALI_TX_INVERT
        bool "Invert TX signal polarity"
        default n
        help
            Enable this option when the hardware circuit between the MCU TX GPIO
            and the DALI bus performs an odd number of signal inversions.

            When enabled the RMT symbol levels are flipped so that the DALI bus
            still sees the correct Manchester-encoded waveform.

            NOTE: do NOT use flags.invert_out for this purpose -- that flag also
            inverts the RMT idle level between frames, which would pull the DALI
            bus low during inter-frame gaps and corrupt the protocol timing.

            Leave disabled (default) when the circuit is non-inverting or performs
            an even number of inversions (e.g. two back-to-back transistor stages).

    config DALI_RX_INVERT
        bool "Invert RX signal polarity"
        default n
        help
            Enable this option when the hardware circuit between the DALI bus and
            the MCU RX GPIO performs an odd number of signal inversions.

            When enabled the RMT RX channel's input-inversion flag is set so that
            the driver sees the correct Manchester-encoded levels regardless of the
            hardware polarity.

            Leave disabled (default) when the circuit is non-inverting or performs
            an even number of inversions.

endmenu
```
