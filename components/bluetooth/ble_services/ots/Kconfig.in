## components/display/lvgl_port/Kconfig.projbuild
```kconfig
menu "Example Configuration"
    menu "Touch Controller"
        config EXAMPLE_LCD_TOUCH_CONTROLLER_GT911
            bool "Enable LCD GT911 Touch"
            default n
            help
                Enable this option if you wish to use display touch.
    endmenu

    menu "Display"
        config EXAMPLE_LCD_RGB_BOUNCE_BUFFER_HEIGHT
            int "RGB Bounce buffer height"
            default 20
            help
                Height of bounce buffer. The width of the buffer is the same as that of the LCD.

        config EXAMPLE_LVGL_PORT_H_RES
            int "LVGL horizontal resolution (H_RES)"
            default 1024
            range 128 4096
            help
                Display horizontal resolution used by LVGL port. Can be overridden per example.

        config EXAMPLE_LVGL_PORT_V_RES
            int "LVGL vertical resolution (V_RES)"
            default 600
            range 128 4096
            help
                Display vertical resolution used by LVGL port. Can be overridden per example.

        config EXAMPLE_LVGL_PORT_TASK_MAX_DELAY_MS
            int "LVGL timer task maximum delay (ms)"
            default 500
            range 2 2000  # Example range, adjust as needed
            help
            The maximum delay of the LVGL timer task, in milliseconds.

        config EXAMPLE_LVGL_PORT_TASK_MIN_DELAY_MS
            int "LVGL timer task minimum delay (ms)"
            default 5
            range 1 100  # Example range, adjust as needed
            help
            The minimum delay of the LVGL timer task, in milliseconds.

        config EXAMPLE_LVGL_PORT_TASK_PRIORITY
            int "LVGL task priority"
            default 4
            help
                The Board Support Package will create a task that will periodically handle LVGL operation in lv_timer_handler().

        config EXAMPLE_LVGL_PORT_TASK_STACK_SIZE_KB
            int "LVGL task stack size (KB)"
            default 6
            help
                Size(KB) of LVGL task stack.

        config EXAMPLE_LVGL_PORT_TASK_CORE
            int "LVGL timer task core"
            default -1
            range -1 1
            help
            The core of the LVGL timer task.
            Set to -1 to not specify the core.
            Set to 1 only if the SoCs support dual-core, otherwise set to -1 or 0.

        config EXAMPLE_LVGL_PORT_TICK
            int "LVGL tick period"
            default 2
            range 1 100
            help
                Period of LVGL tick timer.

        config EXAMPLE_LVGL_PORT_AVOID_TEAR_ENABLE
            bool "Avoid tearing effect"
            default "n"
            help
                Avoid tearing effect through LVGL buffer mode and double frame buffers of RGB LCD. This feature is only available for RGB LCD.

        choice
            depends on EXAMPLE_LVGL_PORT_AVOID_TEAR_ENABLE
            prompt "Select Avoid Tearing Mode"
            default EXAMPLE_LVGL_PORT_AVOID_TEAR_MODE_3
            config EXAMPLE_LVGL_PORT_AVOID_TEAR_MODE_1
                bool "Mode1: LCD double-buffer & LVGL full-refresh"
            config EXAMPLE_LVGL_PORT_AVOID_TEAR_MODE_2
                bool "Mode2: LCD triple-buffer & LVGL full-refresh"
            config EXAMPLE_LVGL_PORT_AVOID_TEAR_MODE_3
                bool "Mode3: LCD double-buffer & LVGL direct-mode"
            config EXAMPLE_LVGL_PORT_AVOID_TEAR_MODE_4
                bool "Mode4: LCD triple-buffer & LVGL partial-mode"
            help
                The current tearing prevention mode supports both full refresh mode, direct mode, and differential copy mode.
                Mode 4 provides optimal performance by using triple buffering with differential copy algorithm.
                Tearing prevention mode may consume more PSRAM space.
        endchoice

        config EXAMPLE_LVGL_PORT_AVOID_TEAR_MODE
            depends on EXAMPLE_LVGL_PORT_AVOID_TEAR_ENABLE
            int
            default 1 if EXAMPLE_LVGL_PORT_AVOID_TEAR_MODE_1
            default 2 if EXAMPLE_LVGL_PORT_AVOID_TEAR_MODE_2
            default 3 if EXAMPLE_LVGL_PORT_AVOID_TEAR_MODE_3
            default 4 if EXAMPLE_LVGL_PORT_AVOID_TEAR_MODE_4

        choice
            depends on EXAMPLE_LVGL_PORT_AVOID_TEAR_ENABLE
            prompt "Select rotation"
            default EXAMPLE_LVGL_PORT_ROTATION_0
            config EXAMPLE_LVGL_PORT_ROTATION_0
                bool "Rotation 0"
            config EXAMPLE_LVGL_PORT_ROTATION_90
                bool "Rotation 90"
            config EXAMPLE_LVGL_PORT_ROTATION_180
                bool "Rotation 180"
            config EXAMPLE_LVGL_PORT_ROTATION_270
                bool "Rotation 270"
        endchoice

        config EXAMPLE_LVGL_PORT_PPA_ROTATION_ENABLE
            depends on EXAMPLE_LVGL_PORT_AVOID_TEAR_ENABLE && IDF_TARGET_ESP32P4 && !EXAMPLE_LVGL_PORT_ROTATION_0
            depends on EXAMPLE_LVGL_PORT_AVOID_TEAR_MODE != 4 || ESP_PPA_FREEZE_FIX_APPLIED
            bool "Enable PPA Rotation"
            default n
            help
                Enable this option to use PPA (Pixel Processor Assembly) for display rotation.
                This feature allows hardware-based rotation for improved performance

        config EXAMPLE_LVGL_PORT_ROTATION_DEGREE
            int
            default 0 if EXAMPLE_LVGL_PORT_ROTATION_0
            default 90 if EXAMPLE_LVGL_PORT_ROTATION_90
            default 180 if EXAMPLE_LVGL_PORT_ROTATION_180
            default 270 if EXAMPLE_LVGL_PORT_ROTATION_270

        config EXAMPLE_LVGL_PORT_BUF_PSRAM
            bool "Use PSRAM for LVGL buffer"
            depends on !EXAMPLE_LVGL_PORT_AVOID_TEAR_ENABLE
            default y

        config EXAMPLE_LVGL_PORT_BUF_HEIGHT
            depends on !EXAMPLE_LVGL_PORT_AVOID_TEAR_ENABLE || (EXAMPLE_LVGL_PORT_AVOID_TEAR_MODE_4)
            int "LVGL buffer height"
            default 50
            help
                Height of LVGL buffer. The width of the buffer is the same as that of the LCD.

        config EXAMPLE_LVGL_FPS_STATS_ENABLE
            bool "Enable LVGL FPS Statistics"
            default n
            help
                Enable real-time FPS statistics collection and logging in LVGL flush callback.

        choice
            depends on EXAMPLE_LVGL_FPS_STATS_ENABLE
            prompt "FPS Statistics Mode"
            default EXAMPLE_LVGL_FPS_STATS_MODE_SIMPLE
            config EXAMPLE_LVGL_FPS_STATS_MODE_SIMPLE
                bool "Simple - Average FPS only"
            config EXAMPLE_LVGL_FPS_STATS_MODE_DETAILED
                bool "Detailed - Instant + Average + Min/Max"
        endchoice

        config EXAMPLE_LVGL_FPS_STATS_LOG_INTERVAL_MS
            int "FPS statistics log interval (ms)"
            depends on EXAMPLE_LVGL_FPS_STATS_ENABLE
            default 1000
            range 500 10000
            help
                Interval for logging FPS statistics to console.

        config EXAMPLE_LVGL_FPS_STATS_WINDOW_SIZE
            int "FPS averaging window size"
            depends on EXAMPLE_LVGL_FPS_STATS_ENABLE
            default 30
            range 10 120
            help
                Number of recent frames to use for averaging FPS calculation.
    endmenu
endmenu
```

## components/display/tools/esp_lv_decoder/Kconfig
```kconfig
menu "ESP LV Decoder"

config ESP_LV_DECODER_PJPG_HW_ALPHA_BLEND
    bool "PPA hardware alpha blending for transparent PJPG images (RGB888 displays)"
    default n
    help
        Offload alpha blending of transparent PJPG images to the PPA hardware on
        RGB888/XRGB8888 displays, instead of blending on the CPU. This frees the
        CPU during rendering of images with per-pixel transparency.

        It works by decoding such PJPG images to interleaved ARGB8888 (the format
        the PPA blend engine can composite in a single hardware op).

        When enabled (y):
        - Transparent PJPG images blend via PPA hardware (CPU offloaded).
        - Costs ~33% more image memory (4 B/px vs 3 B/px) and a one-time CPU
          interleave per decode, and increases PSRAM read bandwidth during blend.

        When disabled (n):
        - PJPG decodes to planar RGB565A8 (3 B/px); on RGB888 displays the blend
          is done on the CPU.

        RGB565 displays are unaffected (always RGB565A8). LVGL v9 only.

        Recommendation: keep enabled when the CPU is the bottleneck; disable on
        PSRAM-bandwidth-constrained panels where the extra read traffic hurts more
        than the freed CPU helps. Measure both.

endmenu
```

## components/display/tools/esp_lv_decoder/test_apps/sdkconfig.defaults
```kconfig
# For IDF 5.0
CONFIG_ESP_TASK_WDT_EN=n

CONFIG_ESPTOOLPY_FLASHSIZE_4MB=y
CONFIG_PARTITION_TABLE_CUSTOM=y
CONFIG_LV_USE_FS_POSIX=y
CONFIG_LV_FS_POSIX_LETTER=65
CONFIG_ESP_MAIN_TASK_STACK_SIZE=8192
```

## components/display/tools/esp_lv_eaf_player/Kconfig
```kconfig
menu "ESP LV EAF Player"

    config ESP_LV_EAF_ENABLE_SW_JPEG
        bool "Enable Software JPEG Decoding"
        default y
        help
            Enable software JPEG decoder for EAF files with JPEG-encoded blocks.
            Disabling this option saves ~19KB DRAM but JPEG blocks will fail to
            decode with a runtime warning.

            If your EAF files only use RLE/Huffman encoding (no JPEG blocks),
            you can disable this to reduce memory usage.

endmenu
```
