## components/bluetooth/ble_profiles/std/ble_esl/Kconfig
```kconfig
menu "BLE Profile: Electronic Shelf Label"

    config BLE_ESL_PROFILE
        bool "Enable Electronic Shelf Label Profile for Tag"
        default n
        select BLE_ESL
        select BLE_DIS
        select BT_NIMBLE_ENC_ADV_DATA
        help
            Enable ESL Profile Tag role (GATT Server, GAP Peripheral).
            Instantiates ESL Service and Device Information Service.
            Selects Encrypted Advertising Data (EAD) for PAwR.
            Enable BLE_CONN_MGR_SM with Bond + Secure Connections.

    config BLE_ESL_OTS_SUPPORT
        bool "Enable OTP Object Server for ESL image transfer"
        depends on BLE_ESL_PROFILE
        select BLE_OBJECT_TRANSFER_PROFILE
        select BLE_ESL_DISPLAY_INFO
        default y
        help
            Instantiate OTP Object Server / OTS for image slots.
            Also selects Display Information (and Image Information).

    config BLE_ESL_MAX_IMAGES
        int "Maximum number of ESL image slots"
        depends on BLE_ESL_OTS_SUPPORT
        range 1 16
        default 1
        help
            Number of image objects exposed via OTS. Max_Image_Index is
            (this value - 1).

    config BLE_ESL_MAX_IMAGE_SIZE
        int "Maximum size of each ESL image object (bytes)"
        depends on BLE_ESL_OTS_SUPPORT
        range 64 65536
        default 4096
        help
            Allocated size for each image object in the OTP Object Server.

    config BLE_ESL_PROFILE_TIMEOUT_MIN
        int "ESL Synchronized/Unsynchronized timeout (minutes)"
        depends on BLE_ESL_PROFILE || BLE_ESL_PROFILE_AP
        range 1 60
        default 60
        help
            Lifecycle timeout in minutes. Synchronized with no activity goes
            Unsynchronized; Unsynchronized without Updating goes Unassociated.

    config BLE_ESL_PROFILE_AP
        bool "Enable Electronic Shelf Label Profile for Access Point"
        default n
        select BLE_OBJECT_TRANSFER_PROFILE
        select BT_NIMBLE_ENC_ADV_DATA
        help
            Enable ESL Profile Access Point role (GATT Client, GAP Central).
            Instantiates OTP Object Client. Selects EAD for PAwR.
            Enable BLE_CONN_MGR_SM with Bond + Secure Connections.
            Enable BLE_CONN_MGR_PERIODIC_ADV_WITH_RESP for PAwR.

    config BLE_ESL_PROFILE_AP_MAX_SUBEVENTS
        int "AP max PAwR subevents"
        depends on BLE_ESL_PROFILE_AP
        range 1 64
        default 16
        help
            Maximum number of PAwR subevent command slots.

    config BLE_ESL_PROFILE_AP_MAX_TAGS
        int "AP max tracked ESL Tags"
        depends on BLE_ESL_PROFILE_AP
        range 1 64
        default 8
        help
            Maximum number of remote ESL Tags tracked for lifecycle timeouts.

endmenu
```

## components/bluetooth/ble_services/cts/Kconfig.in
```kconfig
# Current Time Service

menuconfig BLE_CTS
    bool "GATT Current Time Service"

if BLE_CTS

choice BLE_CTS_DEFAULT_PERM
    prompt "Security for Current Time Service characteristics"
    default BLE_CTS_DEFAULT_PERM_RW
    help
      With encryption required, a peer can read, write and subscribe to these
      characteristics only over an encrypted link, and ble_conn_mgr refuses
      to notify or indicate them on a link that is not encrypted.

config BLE_CTS_DEFAULT_PERM_RW
    bool "No security required"

config BLE_CTS_DEFAULT_PERM_RW_ENCRYPT
    bool "Require encryption"

endchoice

config BLE_CTS_CURRENT_TIME_WRITE_ENABLE
    bool "Current time write enable"
    default y
    help
      Set y to enable write or n to disable it.

config BLE_CTS_LOCAL_TIME_CHAR_ENABLE
    bool "Local Time Information Characteristic"
    default y
    help
      Set y to support CTS Local time characteristic or n to disable it.

config BLE_CTS_LOCAL_TIME_WRITE_ENABLE
    bool "Local time write enable"
    default y
    depends on BLE_CTS_LOCAL_TIME_CHAR_ENABLE
    help
      Set y to enable write or n to disable it.

config BLE_CTS_REF_TIME_CHAR_ENABLE
    bool "Reference Time Information Characteristic"
    default y
    help
      Set y to support CTS Reference time characteristic or n to disable it.

endif # BLE_CTS
```

## components/bluetooth/ble_services/esl/Kconfig.in
```kconfig
# GATT Electronic Shelf Label Service

menuconfig BLE_ESL
    bool "GATT Electronic Shelf Label Service"

if BLE_ESL

config BLE_ESL_DISPLAY_INFO
    bool "ESL Display Information characteristic"
    default y
    select BLE_ESL_IMAGE_INFO
    help
      Enable ESL Display Information characteristic.
      Also enables ESL Image Information. When enabled, call
      esp_ble_esl_set_display_info() before esp_ble_esl_init().

config BLE_ESL_MAX_DISPLAYS
    int "Maximum number of displays"
    range 1 8
    default 1
    depends on BLE_ESL_DISPLAY_INFO
    help
      Maximum display records exposed by Display Information.

config BLE_ESL_IMAGE_INFO
    bool
    default y
    depends on BLE_ESL_DISPLAY_INFO
    help
      ESL Image Information characteristic.
      Selected automatically by BLE_ESL_DISPLAY_INFO.

config BLE_ESL_SENSOR_INFO
    bool "ESL Sensor Information characteristic"
    default n
    help
      Enable ESL Sensor Information characteristic.

config BLE_ESL_SENSOR_INFO_MAX_LEN
    int "Maximum Sensor Information length"
    range 3 48
    default 15
    depends on BLE_ESL_SENSOR_INFO
    help
      Maximum octets stored for Sensor Information characteristic.

config BLE_ESL_LED_INFO
    bool "ESL LED Information characteristic"
    default n
    help
      Enable ESL LED Information characteristic.

config BLE_ESL_MAX_LEDS
    int "Maximum number of LEDs"
    range 1 8
    default 1
    depends on BLE_ESL_LED_INFO
    help
      Maximum LED Information octets exposed by LED Information.

endif # BLE_ESL
```

## components/display/tools/esp_display_present/Kconfig
```kconfig
menu "Display presenter"
config ESP_DISPLAY_PRESENT_GRAM_BACKGROUND
    bool "Experimental zero-copy GRAM background submission"
    default n
    help
        Use the existing engine backend worker for synchronous internal DMA tile paths.
        Rotated and PSRAM tiles retain their existing async-copy scheduling.
        Adds the backend worker task when the synchronous GRAM path would not have one.
        Source tiles remain borrowed until real transfer completion.

config ESP_DISPLAY_PRESENT_GRAM_BACKGROUND_PRIORITY
    int "GRAM backend worker task priority"
    depends on ESP_DISPLAY_PRESENT_GRAM_BACKGROUND
    range 1 24
    default 7
    help
        Priority of the existing engine backend worker for experimental GRAM submission.
        Choose relative to the producer: a lower-priority backend worker can introduce
        command refill gaps while rendering continues. The board comparison
        uses producer priority 6 and backend worker priority 7.

config PV2_LEGACY_CALLBACK_JOIN
    bool
    default y
    select ESP_IPC_ENABLE if !ESP_SYSTEM_SINGLE_CORE_MODE
    help
        Borrowed display callbacks require a cross-core join before freeing
        their context. Enable the IDF IPC dependency as part of this component.

config PV2_LEGACY_RGB_BOUNCE_CONFIRMED
    bool "Application confirms borrowed RGB panel uses bounce buffers"
    default n
    help
        For older RGB drivers without a framebuffer capability query, enable
        only if the borrowed panel was created with RGB bounce buffers. When
        the query is available, the driver-reported configuration is used.
endmenu
```

## components/display/tools/esp_display_present/dev/test_apps/boards/sdkconfig.defaults.esp32s3
```kconfig
CONFIG_SPIRAM_MODE_OCT=y
CONFIG_SPIRAM_SPEED_80M=y
CONFIG_ESP_DEFAULT_CPU_FREQ_MHZ_240=y
CONFIG_ESP32S3_DATA_CACHE_64KB=y
CONFIG_ESP32S3_DATA_CACHE_LINE_64B=y
CONFIG_ESP_CONSOLE_UART_DEFAULT=y
```

## components/display/tools/esp_display_present/dev/test_apps/scanout_boundary/main/Kconfig.projbuild
```kconfig
menu "V2 scanout boundary test"
config BOUNDARY_RAW_RGB
    bool "Characterize raw RGB driver (no V2 safety claim)"
    depends on IDF_TARGET_ESP32S3
    default n
config BOUNDARY_NO_BOUNCE
    bool "RGB direct framebuffer DMA"
    depends on BOUNDARY_RAW_RGB
    default n
config BOUNDARY_ON_DEMAND
    bool "RGB refresh_on_demand"
    depends on BOUNDARY_RAW_RGB && BOUNDARY_NO_BOUNCE
    default n
config BOUNDARY_INJECT_RESTART
    bool "Request RGB restart explicitly (not an organic underrun)"
    depends on IDF_TARGET_ESP32S3 && !BOUNDARY_ON_DEMAND
    default n
config BOUNDARY_STRESS
    bool "Run external-memory copy pressure task"
    default n
endmenu
```

## components/display/tools/esp_display_present/test_apps/sdkconfig.defaults
```kconfig
CONFIG_ESPTOOLPY_FLASHSIZE_4MB=y
CONFIG_ESP_MAIN_TASK_STACK_SIZE=8192
CONFIG_ESP_TASK_WDT_EN=n
CONFIG_ESP_TIMER_SUPPORTS_ISR_DISPATCH_METHOD=y
```

## components/display/tools/esp_lv_present/test_apps/sdkconfig.defaults
```kconfig
CONFIG_ESPTOOLPY_FLASHSIZE_4MB=y
CONFIG_ESP_MAIN_TASK_STACK_SIZE=8192
CONFIG_ESP_TASK_WDT_EN=n
CONFIG_ESP_TIMER_SUPPORTS_ISR_DISPATCH_METHOD=y

CONFIG_LV_CONF_SKIP=y
CONFIG_LV_COLOR_DEPTH_16=y
CONFIG_LV_COLOR_DEPTH=16
CONFIG_LV_OS_NONE=y
CONFIG_LV_USE_ASSERT_NULL=n
CONFIG_LV_USE_ASSERT_MALLOC=n
CONFIG_LV_USE_ASSERT_STYLE=n
CONFIG_LV_USE_ASSERT_MEM_INTEGRITY=n
CONFIG_LV_USE_ASSERT_OBJ=n
```

## components/esp_flux/test_apps/sdkconfig.defaults
```kconfig
# Override some defaults so BT stack is enabled
# in this example

#
# BT config
#
CONFIG_BT_ENABLED=y
CONFIG_BTDM_CTRL_MODE_BLE_ONLY=y
CONFIG_BTDM_CTRL_MODE_BR_EDR_ONLY=n
CONFIG_BTDM_CTRL_MODE_BTDM=n
CONFIG_BT_BLUEDROID_ENABLED=n
CONFIG_BT_NIMBLE_ENABLED=y
CONFIG_BT_NIMBLE_TRANSPORT_ACL_FROM_LL_COUNT=20
CONFIG_BT_NIMBLE_TRANSPORT_EVT_SIZE=255
CONFIG_BT_NIMBLE_MSYS_1_BLOCK_COUNT=50

CONFIG_FREERTOS_HZ=1000
```

## components/esp_gmp/Kconfig
```kconfig
menu "ESP-GMP"

    config ESP_GMP_MAX_PAYLOAD
        int "Maximum GMP payload bytes (product policy cap)"
        range 64 65535
        default 4096
        help
            Upper bound for GMP payload before transport limits are applied.
            Runtime effective limit is min(this, registered transport max_payload).

    config ESP_GMP_MAX_LINKS
        int "Maximum registered links"
        range 1 16
        default 4

    config ESP_GMP_TX_QUEUE_DEPTH
        int "Queued outgoing GMP messages per link"
        range 1 16
        default 4

    config ESP_GMP_FLUX_WINDOW_SIZE
        int "Default Flux adapter window size for GMP sends (0 = Flux default 6)"
        range 0 255
        default 6

    config ESP_GMP_FLUX_WINDOW_THRESHOLD
        int "Default Flux adapter window threshold percent for GMP sends"
        range 0 100
        default 50

    config ESP_GMP_MAX_HANDLERS
        int "Maximum group packet handlers"
        range 1 16
        default 8

    config ESP_GMP_MAX_LINK_EVENT_SUBSCRIBERS
        int "Maximum link-event subscribers"
        range 1 16
        default 8

    menu "Profiles"

        config ESP_GMP_PROFILE_OS
            bool "OS profile (capability query)"
            default y
            help
                Standard OS group: OS_CAP_QUERY and runtime capability registration.
                Recommended for all products that use optional OTA/FT profiles.

        config ESP_GMP_PROFILE_OTA
            bool "OTA profile"
            default y
            help
                Enable OTA upload profile (device and/or host roles below).

        config ESP_GMP_OTA_DEVICE
            bool "OTA device (receiver / being upgraded)"
            depends on ESP_GMP_PROFILE_OTA
            default y
            help
                Compile device-side OTA handler (writes app_update partition).

        config ESP_GMP_OTA_HOST
            bool "OTA host (sender / uploader)"
            depends on ESP_GMP_PROFILE_OTA
            default n
            help
                Compile host-side OTA upload_stream API (no app_update dependency).

        config ESP_GMP_PROFILE_FILE_TRANSFER
            bool "File Transfer profile"
            default n
            help
                Enable file transfer profile (FS send/recv over GMP).

        config ESP_GMP_FT_DATA_PIPE_DEPTH
            int "File Transfer DATA pipeline depth"
            depends on ESP_GMP_PROFILE_FILE_TRANSFER
            range 1 8
            default 2
            help
                Max in-flight FT DATA_BLOCK requests on the sender.
                1 = classic stop-and-wait. Values >1 pipeline within the GMP
                TX queue / Flux window (capped by esp_gmp_recommended_pipeline_depth).

    endmenu

    menu "ESP-GMP OTA"
        depends on ESP_GMP_PROFILE_OTA

        config ESP_GMP_OTA_CHUNK_HINT
            int "DATA chunk hint in start response (0 = auto from link MTU)"
            range 0 65535
            default 0
            depends on ESP_GMP_OTA_DEVICE

        config ESP_GMP_OTA_RESTART_DELAY_MS
            int "Delay before esp_restart() after successful OTA (ms)"
            range 0 10000
            default 500
            depends on ESP_GMP_OTA_DEVICE

        config ESP_GMP_OTA_APPLY_TASK_STACK
            int "OTA apply task stack size (bytes)"
            default 4096
            depends on ESP_GMP_OTA_DEVICE

        config ESP_GMP_OTA_APPLY_TASK_PRIO
            int "OTA apply task priority"
            range 1 25
            default 5
            depends on ESP_GMP_OTA_DEVICE

    endmenu

endmenu
```

## components/extended_vfs/Kconfig
```kconfig
menu "Extended VFS"
    config EXTENDED_VFS
        bool "Enable Extended VFS"
        default y

    if EXTENDED_VFS
        menu "Peripherals"
            config EXTENDED_VFS_GPIO
                bool "GPIO"
                default y
                help
                    Select this option, then "/dev/gpio/x" (x=0, 1, ...) will be registered
                    to VFS.

            config EXTENDED_VFS_I2C
                bool "I2C"
                default y
                help
                    Select this option, then "/dev/i2c/x" (x=0, 1, ...) will be registered
                    to VFS. On ESP-IDF 5.3+, I2C slave needs slave driver v2
                    (CONFIG_I2C_ENABLE_SLAVE_DRIVER_VERSION_2, or IDF >= 6.0);
                    otherwise slave I2CIOCSCFG / transfer returns ENOTSUP.

            config EXTENDED_VFS_LEDC
                bool "LEDC"
                default y
                help
                    Select this option, then "/dev/ledc/x" (x=0, 1, ...) will be registered
                    to VFS.

            config EXTENDED_VFS_SPI
                bool "SPI"
                default y
                help
                    Select this option, then "/dev/spi/x" (x=1, 2, ...) will be registered
                    to VFS.
        endmenu
    endif
endmenu
```

## components/network_provisioner/Kconfig
```kconfig
menu "Network Provisioner"

    config NETWORK_PROVISIONER_DEFAULT_POLL_TIMEOUT_MS
        int "Default provision status poll timeout (ms)"
        default 60000
        range 1000 600000

    config NETWORK_PROVISIONER_DEFAULT_POLL_INTERVAL_MS
        int "Default provision status poll interval (ms)"
        default 1000
        range 100 10000

endmenu
```

## components/network_provisioner/test_apps/sdkconfig.defaults
```kconfig
CONFIG_UNITY_ENABLE_FLOAT=y
CONFIG_ESP_PROTOCOMM_EXT_SUPPORT_SECURITY_VERSION_0=y
CONFIG_ESP_PROTOCOMM_EXT_SUPPORT_SECURITY_VERSION_1=y
CONFIG_ESP_PROTOCOMM_EXT_SUPPORT_SECURITY_VERSION_2=y
```
