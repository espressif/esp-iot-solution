## components/protocomm_ext/Kconfig
```kconfig
menu "Protocomm_ext"

    config ESP_PROTOCOMM_EXT_SUPPORT_SECURITY_VERSION_0
        bool "Support protocomm security version 0 (no security)"
        default y
        help
            Enable support of security version 0.
            Disabling this option saves some code size.
            Consult the Enabling protocomm security version section of the
            Protocomm documentation in ESP-IDF Programming guide for more details.

    config ESP_PROTOCOMM_EXT_SUPPORT_SECURITY_VERSION_1
        bool "Support protocomm security version 1 (Curve25519 key exchange + AES-CTR encryption/decryption)"
        default y
        help
            Enable support of security version 1.
            Disabling this option saves some code size.
            Consult the Enabling protocomm security version section of the
            Protocomm documentation in ESP-IDF Programming guide for more details.

    config ESP_PROTOCOMM_EXT_SUPPORT_SECURITY_VERSION_2
        bool "Support protocomm security version 2 (SRP-6a key exchange + AES-GCM encryption/decryption)"
        default y
        help
            Enable support of security version 2 (client side).
            Disabling this option saves some code size.
            Consult the Enabling protocomm security version section of the
            Protocomm documentation in ESP-IDF Programming guide for more details.

endmenu
```

## components/sensors/battery_fuel_gauge/bq27220/Kconfig
```kconfig
menu "BQ27220 Configuration"

    config BQ27220_SEAL_SETTLE_MS
        int "Seal confirmation timeout (ms)"
        range 0 10000
        default 2000
        help
            Maximum time to wait for OperationStatus()[SEC] to report SEALED after sending the SEALED subcommand.
            The driver returns as soon as SEALED is confirmed, and returns immediately if the gauge is already sealed.

endmenu
```
