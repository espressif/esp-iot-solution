## components/touch/touch_proximity_sensor/Kconfig
```kconfig
menu "Touch Proximity Sensor"

    config TOUCH_PROXIMITY_SENSOR_DEBUG
        bool "Enable touch proximity sensor debug mode"
        default n
        select TOUCH_SENSOR_FSM_DEBUG
        help
            Print complete fused FSM snapshots in the vl CSV format.

    config TOUCH_PROXIMITY_MEAS_COUNT
        int "Default measurement count"
        default 20
        range 1 255
        help
            Number of measurements accumulated for one proximity frame.
            The FSM sample period includes this count.

endmenu
```

## components/touch/touch_proximity_sensor/test_apps/sdkconfig.defaults
```kconfig
CONFIG_TOUCH_PROXIMITY_SENSOR_DEBUG=n
CONFIG_TOUCH_PROXIMITY_MEAS_COUNT=20
CONFIG_IDF_TARGET="esp32s3"
CONFIG_ESP_DEFAULT_CPU_FREQ_MHZ_240=y
CONFIG_FREERTOS_HZ=1000
CONFIG_ESP_TASK_WDT_EN=n
CONFIG_TOUCH_SUPPRESS_DEPRECATE_WARN=y
```

## components/touch/touch_slider_sensor/Kconfig
```kconfig
menu "Touch Slider Sensor Configuration"

    config TOUCH_SLIDER_SENSOR_DEBUG
        bool "Enable touch slider sensor debug mode"
        default n
        select TOUCH_SENSOR_FSM_DEBUG
        help
            Print complete fused FSM snapshots in the vl CSV format.

    config TOUCH_SLIDER_SENSOR_QUANTIFY_LOWER_THRESHOLD_X1000
        int "Quantify lower threshold (/1000)"
        default 300
        range 0 10000
        help
            Normalized fused amplitude below this ratio of the configured
            channel threshold is ignored by the position estimator.

    config TOUCH_SLIDER_SENSOR_POS_FILTER_SIZE
        int "Position filter size"
        default 10
        range 1 100
        help
            Window length for the slider position moving average.

    config TOUCH_SLIDER_SENSOR_POS_FILTER_FACTOR
        int "Position filter factor"
        default 2
        range 1 10
        help
            Divisor of the position IIR filter. One disables the IIR tail.

endmenu
```

## components/touch/touch_slider_sensor/test_apps/sdkconfig.defaults
```kconfig
CONFIG_TOUCH_SLIDER_SENSOR_DEBUG=n
CONFIG_TOUCH_SLIDER_SENSOR_QUANTIFY_LOWER_THRESHOLD_X1000=300
CONFIG_TOUCH_SLIDER_SENSOR_POS_FILTER_SIZE=10
CONFIG_TOUCH_SLIDER_SENSOR_POS_FILTER_FACTOR=2
CONFIG_ESP_CONSOLE_USB_SERIAL_JTAG=y
CONFIG_FREERTOS_HZ=1000
CONFIG_ESP_TASK_WDT_EN=n
```

## components/usb/esp_msc_ota/Kconfig
```kconfig
menu "MSC OTA Config"

    config MSC_PRINT_DESC
        bool "Print descriptor info"
        default n
endmenu
```

## examples/bluetooth/ble_profiles/ble_esl/ble_esl_ap/main/Kconfig.projbuild
```kconfig
menu "BLE ESL AP Product Example"

    choice ESL_AP_OPERATION_MODE
        prompt "AP operation mode"
        default ESL_AP_MODE_WITH_APP
        help
            AP + phone app is the default for this profile backport (mode 2:
            e-paper upload/display/refresh via the existing Android App).
            Standalone auto-scan is optional and not required for mode 2.

        config ESL_AP_MODE_STANDALONE
            bool "Standalone AP (no phone gateway)"

        config ESL_AP_MODE_WITH_APP
            bool "AP + phone app (NUS JSONL gateway)"
            select BT_NIMBLE_DYNAMIC_SERVICE if BT_NIMBLE_ENABLED
            help
                NUS is registered after ble_conn_mgr starts the NimBLE host.
                Dynamic GATT (BT_NIMBLE_DYNAMIC_SERVICE) is required; static
                ble_gatts_add_svcs() returns BLE_HS_EBUSY at that point.
    endchoice

    config ESL_AP_AUTO_CONNECT_UNASSOCIATED
        bool "Automatically connect to unassociated tags"
        depends on ESL_AP_MODE_STANDALONE
        default n

    config ESL_AP_DEFAULT_ESL_ID
        hex "Default ESL ID"
        range 0x00 0xFE
        default 0x00

    config ESL_AP_DEFAULT_GROUP_ID
        hex "Default Group ID (PAwR subevent index)"
        range 0x00 0x7F
        default 0x00

    config ESL_AP_DEFAULT_DISPLAY_INDEX
        int "Default display index"
        range 0 255
        default 0

    config ESL_AP_DEFAULT_IMAGE_INDEX
        int "Default image index for first OTS transfer"
        range 0 3
        default 0

    config ESL_AP_DEFAULT_IMAGE_ID
        int "Default image manager image ID"
        range 1 999
        default 1

    config ESL_AP_PAWR_INTERVAL_MIN
        int "PAwR interval min (1.25 ms units)"
        range 6 65535
        default 320

    config ESL_AP_PAWR_INTERVAL_MAX
        int "PAwR interval max (1.25 ms units)"
        range 6 65535
        default 320

    config ESL_AP_PAWR_NUM_SUBEVENTS
        int "PAwR subevents"
        range 1 128
        default 4
        help
            Number of PAwR subevents per interval. ESL group_id maps 1:1 to
            the subevent index, so this must be > max group_id in use.

    config ESL_AP_PAWR_SUBEVENT_INTERVAL
        hex "PAwR subevent interval (1.25 ms units)"
        default 0x50

    config ESL_AP_PAWR_RESPONSE_SLOT_DELAY
        hex "PAwR response slot delay"
        default 0x28

    config ESL_AP_PAWR_RESPONSE_SLOT_SPACING
        hex "PAwR response slot spacing"
        default 0x50

    config ESL_AP_PAWR_NUM_RESPONSE_SLOTS
        int "PAwR response slots"
        range 1 255
        default 3

    config ESL_AP_AUTO_PING_INTERVAL_SEC
        int "Auto PAwR ping interval (seconds, 0=disable)"
        range 0 3600
        default 15

    config ESL_AP_RECOVERY_PROBE_DELAY_MS
        int "OBSOLETE: recovery probe delay (unused)"
        range 500 10000
        default 2000

    config ESL_AP_LED_COLOR_RED
        int "Default LED red level (0-3)"
        range 0 3
        default 3

    config ESL_AP_LED_COLOR_GREEN
        int "Default LED green level (0-3)"
        range 0 3
        default 0

    config ESL_AP_LED_COLOR_BLUE
        int "Default LED blue level (0-3)"
        range 0 3
        default 0

    config ESL_AP_LED_BRIGHTNESS
        int "Default LED brightness (0-3)"
        range 0 3
        default 3

endmenu
```

## examples/bluetooth/ble_profiles/ble_esl/ble_esl_tag/main/Kconfig.projbuild
```kconfig
menu "BLE ESL Tag Product Example"

    config ESL_TAG_ADV_NAME
        string "Tag advertisement name"
        default "ESP_ESL_TAG"
        help
            Complete Local Name used by ble_conn_mgr advertising.

    config ESL_TAG_DISPLAY_WIDTH
        int "Display width (metadata)"
        default 296

    config ESL_TAG_DISPLAY_HEIGHT
        int "Display height (metadata)"
        default 128

    config ESL_TAG_MAX_IMAGES
        int "Maximum stored image slots (Max_Image_Index + 1)"
        range 1 255
        default 4
        help
            Reported via ESL Image Information. OTS flash persistence
            covers physical slots 0..3.

    config ESL_TAG_LED_MULTI_DEMO
        bool "Enable multi-Tag LED demo local green on SYNCHRONIZED"
        depends on ESL_TAG_LED_BACKEND_WS2812 || ESL_TAG_LED_BACKEND_GPIO
        default n
        help
            Keep disabled for mode 2 so association NVS is saved and restored.

endmenu
```

## examples/bluetooth/ble_profiles/ble_esl/components/epaper/Kconfig
```kconfig
menu "E-paper Display Pin Configuration"

config EPAPER_PIN_NUM_DC
    int "E-paper DC Pin Number"
    default 1 if IDF_TARGET_ESP32H4
    default 20
    help
      Select the pin number for connecting E-paper DC pin

config EPAPER_PIN_NUM_RST
    int "E-paper RST Pin Number"
    default 16 if IDF_TARGET_ESP32H4
    default 19
    help
      Select the pin number for connecting E-paper RST pin

config EPAPER_PIN_NUM_CS
    int "E-paper CS Pin Number"
    default 0 if IDF_TARGET_ESP32H4
    default 21
    help
      Select the pin number for connecting E-paper CS pin

config EPAPER_PIN_NUM_BUSY
    int "E-paper BUSY Pin Number"
    default 17 if IDF_TARGET_ESP32H4
    default 22
    help
      Select the pin number for connecting E-paper BUSY pin

config EPAPER_PIN_NUM_MOSI
    int "E-paper MOSI Pin Number"
    default 38 if IDF_TARGET_ESP32H4
    default 18
    help
      Select the pin number for connecting E-paper MOSI pin

config EPAPER_PIN_NUM_SCLK
    int "E-paper SCLK Pin Number"
    default 39 if IDF_TARGET_ESP32H4
    default 15
    help
      Select the pin number for connecting E-paper SCLK pin

endmenu
```

## examples/bluetooth/ble_profiles/ble_esl/components/esl_tag_hal/Kconfig
```kconfig
menu "ESL Tag HAL"

    choice ESL_TAG_DISPLAY_BACKEND
        prompt "Display output backend"
        default ESL_TAG_DISPLAY_BACKEND_EPAPER if IDF_TARGET_ESP32H4 || IDF_TARGET_ESP32C6
        default ESL_TAG_DISPLAY_BACKEND_MOCK

        config ESL_TAG_DISPLAY_BACKEND_MOCK
            bool "Mock (log only)"

        config ESL_TAG_DISPLAY_BACKEND_EPAPER
            bool "SSD1680 e-paper (epaper component)"
    endchoice

    config ESL_TAG_EPAPER_PWR_GPIO
        int "E-paper power control GPIO"
        range 0 54
        default 37 if IDF_TARGET_ESP32H4
        default 8 if IDF_TARGET_ESP32C6
        default 37
        depends on ESL_TAG_DISPLAY_BACKEND_EPAPER
        help
            GPIO that enables the e-paper panel power rail. Polarity is set by
            ESL_TAG_EPAPER_PWR_ACTIVE_HIGH.

    config ESL_TAG_EPAPER_PWR_ACTIVE_HIGH
        bool "E-paper power GPIO is active-high"
        default y if IDF_TARGET_ESP32H4
        default n if IDF_TARGET_ESP32C6
        default y
        depends on ESL_TAG_DISPLAY_BACKEND_EPAPER
        help
            When enabled, the power GPIO is driven high to power the panel and
            low to cut power. This matches esp_esl_demo on ESP32-H4 (GPIO37 held
            high during init/refresh). Disable for active-low power rails.

    config ESL_TAG_EPAPER_SPI_HOST
        int "E-paper SPI host id (SPI2_HOST=1 on most chips)"
        range 0 2
        default 1
        depends on ESL_TAG_DISPLAY_BACKEND_EPAPER

    choice ESL_TAG_LED_BACKEND
        prompt "LED output backend"
        # Epaper owns SPI2 + GPIO38 on H4; keep LED off to avoid bus/pin clash.
        default ESL_TAG_LED_BACKEND_NONE if ESL_TAG_DISPLAY_BACKEND_EPAPER
        default ESL_TAG_LED_BACKEND_WS2812 if IDF_TARGET_ESP32C6
        default ESL_TAG_LED_BACKEND_WS2812 if IDF_TARGET_ESP32H4
        default ESL_TAG_LED_BACKEND_NONE

        config ESL_TAG_LED_BACKEND_NONE
            bool "Disabled (log only)"

        config ESL_TAG_LED_BACKEND_GPIO
            bool "Discrete GPIO LED"

        config ESL_TAG_LED_BACKEND_WS2812
            bool "Addressable WS2812 (e.g. C6/H4 DevKit onboard RGB)"
    endchoice

    config ESL_TAG_LED_GPIO
        int "GPIO for discrete LED (-1 disabled)"
        range -1 54
        default -1
        depends on ESL_TAG_LED_BACKEND_GPIO

    config ESL_TAG_LED_ACTIVE_LEVEL
        int "Discrete LED active level (0=active low, 1=active high)"
        range 0 1
        default 1
        depends on ESL_TAG_LED_BACKEND_GPIO

    config ESL_TAG_WS2812_GPIO
        int "WS2812 data GPIO"
        range 0 54
        default 38 if IDF_TARGET_ESP32H4
        default 8
        depends on ESL_TAG_LED_BACKEND_WS2812

    choice ESL_TAG_WS2812_BACKEND
        depends on ESL_TAG_LED_BACKEND_WS2812
        prompt "WS2812 peripheral backend"
        default ESL_TAG_WS2812_BACKEND_SPI if IDF_TARGET_ESP32H4
        default ESL_TAG_WS2812_BACKEND_RMT if SOC_RMT_SUPPORTED
        default ESL_TAG_WS2812_BACKEND_SPI

        config ESL_TAG_WS2812_BACKEND_RMT
            depends on SOC_RMT_SUPPORTED
            bool "RMT"

        config ESL_TAG_WS2812_BACKEND_SPI
            bool "SPI"
    endchoice

endmenu
```

## examples/bluetooth/ble_profiles/ble_midi/ble_midi_central/main/Kconfig.projbuild
```kconfig
menu "Example Configuration"
    config EXAMPLE_LOCAL_NAME
        string "Local GAP device name"
        default "BLE_MIDI_Central"
        help
            Name used for this central device (GAP).

    config EXAMPLE_PEER_NAME
        string "Peer name to match (optional)"
        default ""
        help
            If non-empty, connect when this complete/short name appears in advertising.
            Set to "BLE_MIDI" to match the default ble_midi_peripheral device name.
            If empty (default), only the BLE-MIDI Service UUID in advertising is used.

    config EXAMPLE_BLE_SUB_ADV
        string "Unused (central role)"
        default ""
        help
            Reserved for future use.

endmenu
```

## examples/camera/video_lcd_display/main/Kconfig.projbuild
```kconfig
menu "Example Configuration"

    config EXAMPLE_ENABLE_MIPI_CSI_CAM_SENSOR
        bool "Enable MIPI CSI Camera Sensor"
        default y
        depends on SOC_MIPI_CSI_SUPPORTED

    if EXAMPLE_ENABLE_MIPI_CSI_CAM_SENSOR
        config EXAMPLE_MIPI_CSI_SCCB_I2C_PORT
            int "MIPI CSI SCCB I2C Port Number"
            default 0
            range 0 1

        config EXAMPLE_MIPI_CSI_SCCB_I2C_SCL_PIN
            int "MIPI CSI SCCB I2C SCL Pin"
            default 34
            range -1 56

        config EXAMPLE_MIPI_CSI_SCCB_I2C_SDA_PIN
            int "MIPI CSI SCCB I2C SDA Pin"
            default 31
            range -1 56

        config EXAMPLE_MIPI_CSI_SCCB_I2C_FREQ
            int "MIPI CSI SCCB I2C Frequency"
            default 100000
            range 100000 400000
            help
                Increasing this value can reduce the initialization time of the camera sensor.
                Please refer to the relevant instructions of the camera sensor to adjust the value.

        config EXAMPLE_MIPI_CSI_CAM_SENSOR_RESET_PIN
            int "MIPI CSI Camera Sensor Reset Pin"
            default -1
            range -1 56

        config EXAMPLE_MIPI_CSI_CAM_SENSOR_PWDN_PIN
            int "MIPI CSI Camera Sensor Power Down Pin"
            default -1
            range -1 56
    endif

    config EXAMPLE_ENABLE_PRINT_FPS_RATE_VALUE
        bool "Print capture FPS"
        default y

    config EXAMPLE_USE_MEMORY_MAPPING
        bool "Use Memory Mapping for Buffer Allocation"
        default n
        help
            Use V4L2_MEMORY_MMAP buffers allocated by esp_video.
            Otherwise, provide application-owned V4L2_MEMORY_USERPTR buffers.

    config EXAMPLE_CAM_BUF_COUNT
        int "Capture Buffer Count for Copy Mode"
        default 2
        range 2 3
        help
            Used for MMAP or when the capture size differs from the LCD.
            Matching USERPTR capture uses three shared LCD buffers: two
            queued for capture and one held for scanout.

    choice
        prompt "Choose the color format of the LCD"
        default LCD_PIXEL_FORMAT_RGB565
            config LCD_PIXEL_FORMAT_RGB565
                bool "RGB565"

            config LCD_PIXEL_FORMAT_RGB888
                bool "RGB888"
    endchoice

    config EXAMPLE_ENABLE_CAM_SENSOR_PIC_VFLIP
        bool "Enable Camera Sensor Picture Vertical Flip"
        default y

    config EXAMPLE_ENABLE_CAM_SENSOR_PIC_HFLIP
        bool "Enable Camera Sensor Picture Horizontal Flip"
        default y

endmenu
```

## examples/display/gui/gsp_lvgl_present_handoff/main/Kconfig.projbuild
```kconfig
# SPDX-FileCopyrightText: 2026 Espressif Systems (Shanghai) CO LTD
#
# SPDX-License-Identifier: Apache-2.0

menu "GSP/LVGL presenter ownership handoff stress test"

    config APP_HANDOFF_CYCLES
        int "GSP <-> LVGL handoff cycles per reporting batch"
        range 1 1000
        default 5
        help
            Each cycle runs a GSP phase, pauses GSP, hands the shared
            presenter to LVGL, then resumes GSP. Batches repeat until
            the device is reset.

    config APP_PHASE_SECONDS
        int "Duration of each GSP/LVGL phase (seconds)"
        range 1 3600
        default 5
        help
            GSP animates for this long before the pause, and LVGL pumps
            lv_timer_handler() for this long before tearing down.

endmenu
```
