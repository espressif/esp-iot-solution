## examples/display/gui/gsp_lvgl_present_handoff/sdkconfig.defaults
```kconfig
CONFIG_COMPILER_CXX_EXCEPTIONS=n
CONFIG_ESPTOOLPY_FLASHSIZE_4MB=y
CONFIG_PARTITION_TABLE_CUSTOM=y
CONFIG_PARTITION_TABLE_CUSTOM_FILENAME="partitions.csv"
CONFIG_ESP_MAIN_TASK_STACK_SIZE=20480
CONFIG_ESP_TASK_WDT_INIT=n
CONFIG_COMPILER_OPTIMIZATION_PERF=y
CONFIG_FREERTOS_HZ=1000

CONFIG_LV_CONF_SKIP=y
CONFIG_LV_COLOR_DEPTH_16=y
CONFIG_LV_COLOR_DEPTH=16
# S3 (and similar) defaults use LV_DRAW_SW_DRAW_UNIT_CNT=2; LVGL requires an OS.
CONFIG_LV_OS_FREERTOS=y
CONFIG_LV_USE_ASSERT_NULL=n
CONFIG_LV_USE_ASSERT_MALLOC=n
CONFIG_LV_USE_ASSERT_STYLE=n
CONFIG_LV_USE_ASSERT_MEM_INTEGRITY=n
CONFIG_LV_USE_ASSERT_OBJ=n
```

## examples/display/gui/gsp_lvgl_present_handoff/sdkconfig.defaults.esp32c3
```kconfig
# ESP32-C3 default configuration

CONFIG_IDF_TARGET="esp32c3"
CONFIG_EXAMPLE_LCD_INTERFACE_SPI_WITHOUT_PSRAM=y
# CONFIG_SPIRAM is not set
```

## examples/display/gui/gsp_showcase/sdkconfig.defaults
```kconfig
CONFIG_COMPILER_CXX_EXCEPTIONS=n
CONFIG_ESPTOOLPY_FLASHSIZE_4MB=y
CONFIG_PARTITION_TABLE_CUSTOM=y
CONFIG_PARTITION_TABLE_CUSTOM_FILENAME="partitions.csv"
CONFIG_ESP_MAIN_TASK_STACK_SIZE=20480
CONFIG_FREERTOS_HZ=1000
```

## examples/display/gui/gsp_showcase/sdkconfig.defaults.esp32p4
```kconfig
CONFIG_SPIRAM=y
CONFIG_ESPTOOLPY_FLASHSIZE_8MB=y
CONFIG_SPIRAM_MODE_HEX=y
CONFIG_SPIRAM_SPEED_200M=y
CONFIG_SPIRAM_XIP_FROM_PSRAM=y
CONFIG_CACHE_L2_CACHE_256KB=y
CONFIG_CACHE_L2_CACHE_LINE_128B=y
```
