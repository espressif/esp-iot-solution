## components/bluetooth/ble_services/hrs/Kconfig.in
```kconfig
# GATT Heart Rate Service

menuconfig BLE_HRS
    bool "GATT Heart Rate Service"

if BLE_HRS

choice BLE_HRS_DEFAULT_PERM
    prompt "Default permissions used for HRS characteristics"
    default BLE_HRS_DEFAULT_PERM_RW
    help
      Default permissions for HRS characteristic attributes
      used when no permission is set for the report.
      Used also for boot reports.

config BLE_HRS_DEFAULT_PERM_RW
    bool "Read and write allowed"

config BLE_HRS_DEFAULT_PERM_RW_ENCRYPT
    bool "Require encryption for access"

config BLE_HRS_DEFAULT_PERM_RW_AUTHEN
    bool "Require encryption and authentication for access"

endchoice

config BLE_HRS_BODY_SENSOR_LOCATION
    bool "Body Sensor Location characteristic"
    help
      Enable Body Sensor Location characteristic in Heart Rate Service.

config BLE_HRS_CONTROL_POINT
    bool "Heart Rate Control Point characteristic"
    help
      Enable Heart Rate Control Point characteristic in Heart Rate Service.

endif # BLE_HRS
```

## components/bluetooth/ble_services/hts/Kconfig.in
```kconfig
# GATT Health Thermometer Service

menuconfig BLE_HTS
    bool "GATT Health Thermometer Service"

if BLE_HTS

choice BLE_HTS_DEFAULT_PERM
    prompt "Default permissions used for HTS characteristics"
    default BLE_HTS_DEFAULT_PERM_RW
    help
      Default permissions for HTS characteristic attributes
      used when no permission is set for the report.
      Used also for boot reports.

config BLE_HTS_DEFAULT_PERM_RW
    bool "Read and write allowed"

config BLE_HTS_DEFAULT_PERM_RW_ENCRYPT
    bool "Require encryption for access"

config BLE_HTS_DEFAULT_PERM_RW_AUTHEN
    bool "Require encryption and authentication for access"

endchoice

config BLE_HTS_TEMPERATURE_TYPE
    bool "Temperature Type characteristic"
    help
      Enable Temperature Type characteristic in Health Thermometer Service.

config BLE_HTS_INTERMEDIATE_TEMPERATURE
    bool "Intermediate Temperature characteristic"
    help
      Enable Intermediate Temperature characteristic in Health Thermometer Service.

config BLE_HTS_MEASUREMENT_INTERVAL
    bool "Measurement Interval characteristic"
    help
      Enable Measurement Interval characteristic in Health Thermometer Service.

config BLE_HTS_MEASUREMENT_INTERVAL_INDICATE_ENABLE
    bool "Measurement Interval Indicate"
    default y
    depends on BLE_HTS_MEASUREMENT_INTERVAL
    help
      Set y to support indicate n to disable it.

config BLE_HTS_MEASUREMENT_INTERVAL_WRITE_ENABLE
    bool "Measurement Interval Write"
    default y
    depends on BLE_HTS_MEASUREMENT_INTERVAL
    help
      Set y to support indicate n to disable it.

endif # BLE_HTS
```

## components/bluetooth/ble_services/ias/Kconfig.in
```kconfig
# Immediate Alert Service

menuconfig BLE_IAS
    bool "GATT Immediate Alert Service"
    help
      Enable support for the Bluetooth Immediate Alert Service (IAS),
      which exposes the Alert Level characteristic for immediate alerting.

if BLE_IAS

endif # BLE_IAS
```

## components/bluetooth/ble_services/midi/Kconfig.in
```kconfig
# Bluetooth Low Energy MIDI Service

config BLE_MIDI
    bool "Bluetooth Low Energy MIDI Service"
    depends on BT_ENABLED && BT_NIMBLE_ENABLED
    default y if BLE_MIDI_PROFILE
    help
      Enable Bluetooth Low Energy MIDI Service (MIDI over BLE) in GATT server.
```

## components/bluetooth/ble_services/ota/Kconfig.in
```kconfig
# ESP BLE OTA GATT service (0x8018) for esp_ble_conn_mgr

menuconfig BLE_OTA_SVC
    bool "ESP BLE OTA GATT service (0x8018, conn_mgr)"

if BLE_OTA_SVC

endif # BLE_OTA_SVC
```
