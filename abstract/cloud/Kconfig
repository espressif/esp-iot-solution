## abstract/cloud/Kconfig
```kconfig
choice CLOUD_TYPE
    bool "cloud type"
    default CLOUD_ALINK
    help
      select the cloud type

config CLOUD_ALINK
    bool "alink cloud"
config CLOUD_JOYLINK
    bool "joylink cloud"
endchoice
```

## abstract/virtual_device/Kconfig
```kconfig
choice SMART_DEVICE_TYPE
    bool "Device type"
    default SMART_SOCKET_DEVICE
    help
      select the device type

config SMART_SOCKET_DEVICE
    bool "smart socket"
config SMART_LIGHT_DEVICE
    bool "smart light"
endchoice
```

## components/audio/adc_mic/Kconfig
```kconfig
menu "ADC Mic"

    config ADC_MIC_APPLY_GAIN
        int "Apply Gain"
        default 3
        range 0 4
        help
            Apply gain to the ADC mic.
            0: No gain applied
            1: Left shift 1 bit (2x gain)
            2: Left shift 2 bits (4x gain)
            3: Left shift 3 bits (8x gain)
            4: Left shift 4 bits (16x gain)

    config ADC_MIC_OFFSET
        int
        default 2048 if ADC_MIC_APPLY_GAIN = 0
        default 4095 if ADC_MIC_APPLY_GAIN = 1
        default 8190 if ADC_MIC_APPLY_GAIN = 2
        default 16380 if ADC_MIC_APPLY_GAIN = 3
        default 32760 if ADC_MIC_APPLY_GAIN = 4

    config ADC_MIC_TASK_PRIORITY
        int "Task Priority"
        default 1
        range 0 15
        help
            Task priority for the ADC mic worker task.

    config ADC_MIC_TASK_STACK_SIZE
        int "Task Stack Size"
        default 3072
        range 2048 8192
        help
            Stack size for the ADC mic worker task.

    config ADC_MIC_TASK_CORE
        int "Task Core"
        default -1
        range -1 1
        help
            Core for the ADC mic worker task, -1 means no affinity.
        depends on SOC_CPU_CORES_NUM > 1 && !FREERTOS_UNICORE
endmenu
```

## components/avi_player/Kconfig
```kconfig
menu "AVI Player"

    config AVI_PLAYER_DEBUG_INFO
        bool "Debug information"
        default n
        help
            Enable debug information.

endmenu
```

## components/ble_profiles/esp/ble_ota/Kconfig
```kconfig
menu "OTA Manager"
    config OTA_WITH_PROTOCOMM
        bool
        prompt "Enable protocomm level security"
        depends on BT_NIMBLE_ENABLED
        help
            Used to enable protocomm level security for file transfer using OTA
endmenu
```

## components/bluetooth/ble_adv/bthome/test_apps/sdkconfig.defaults
```kconfig
# Override some defaults so BT stack is enabled
# in this example

CONFIG_FREERTOS_HZ=1000
CONFIG_ESP_TASK_WDT_EN=n

#
# BT config
#
CONFIG_BT_ENABLED=y
CONFIG_BTDM_CTRL_MODE_BLE_ONLY=y
CONFIG_BTDM_CTRL_MODE_BR_EDR_ONLY=n
CONFIG_BTDM_CTRL_MODE_BTDM=n
CONFIG_BT_BLUEDROID_ENABLED=n
CONFIG_BT_CONTROLLER_ONLY=y
```

## components/bluetooth/ble_conn_mgr/Kconfig
```kconfig
menu "BLE Connection Management"

    choice BLE_CONN_MGR_ROLE
        bool "BLE Role"
        default BLE_CONN_MGR_ROLE_PERIPHERAL
        help
            Select which role does the device work, support peripheral/central/both.

        config BLE_CONN_MGR_ROLE_PERIPHERAL
            bool "Peripheral"
        config BLE_CONN_MGR_ROLE_CENTRAL
            bool "Central"
        config BLE_CONN_MGR_ROLE_BOTH
            bool "Both Peripheral and Central"
    endchoice

    config BLE_CONN_MGR_ROLE
        int
        default 0 if BLE_CONN_MGR_ROLE_PERIPHERAL
        default 1 if BLE_CONN_MGR_ROLE_CENTRAL
        default 2 if BLE_CONN_MGR_ROLE_BOTH

    config BLE_CONN_MGR_WAIT_DURATION
        int "Duration to wait for completed"
        range 10 31
        default 31
        help
            Set the duration to wait for completed. Use a value big enough to avoid retransmissions.

    config BLE_CONN_MGR_EXTENDED_ADV
        bool
        depends on BLE_CONN_MGR_ROLE_PERIPHERAL || BLE_CONN_MGR_ROLE_BOTH && SOC_BLE_50_SUPPORTED
        default n
        select BT_NIMBLE_EXT_ADV if BT_NIMBLE_ENABLED
        prompt "Enable Extended Adv"
        help
            Use this option to enable extended advertising besides esp32.

    config BLE_CONN_MGR_EXTENDED_ADV_CAP
        int
        range 0 15
        depends on BLE_CONN_MGR_EXTENDED_ADV
        default 0
        prompt "Set Extended Advertising Capability"
        help
            Set extended advertising capability.

            This is a bit map of bits that represents extended advertising capability of the device:

            - BIT0: Connect flag, it performs connectable advertising if set.
            - BIT1: Scan flag, it performs scannable advertising if set.
            - BIT2: Directed flag, it performs directed advertising if set.
            - BIT3: High-duty directed flag, it performs high-duty directed advertising if set.
            - BIT4: Legacy PDUs flag, it uses legacy PDUs for advertising if set.
            - BIT5: Anonymous flag, it performs anonymous advertising if set.
            - BIT6: TX Power flag, it includes TX power in advertising PDU if set.
            - BIT7: Scan request notification flag, it enable scan request notification if set.

    config BLE_CONN_MGR_PERIODIC_ADV
        bool
        depends on BLE_CONN_MGR_EXTENDED_ADV
        default n
        prompt "Enable Periodic Adv"
        help
            Use this option to enable periodic advertising.

    config BLE_CONN_MGR_PERIODIC_ADV_CAP
        int
        range 0 15
        depends on BLE_CONN_MGR_PERIODIC_ADV
        default 0
        prompt "Set Periodic Advertising Capability"
        help
            Set periodic advertising capability.

            This is a bitmap represents periodic advertising capability of the device, the bits are defined as follows:

            - BIT0: TX Power flag, it includes TX power in advertising PDU if set.

    config BLE_CONN_MGR_PERIODIC_SYNC
        bool
        depends on BLE_CONN_MGR_ROLE_CENTRAL || BLE_CONN_MGR_ROLE_BOTH && SOC_BLE_50_SUPPORTED
        default n
        select BT_NIMBLE_EXT_ADV if BT_NIMBLE_ENABLED
        prompt "Enable Periodic Sync"
        help
            Use this option to enable periodic sync with the advertiser.

    config BLE_CONN_MGR_PERIODIC_SYNC_CAP
        int
        range 0 15
        depends on BLE_CONN_MGR_PERIODIC_SYNC
        default 0
        prompt "Set Periodic Sync Capability"
        help
            Set periodic sync capability.

            This is a bitmap represents periodic sync capability of the device, the bits are defined as follows:

            - BIT0: Reports flag, it is initially disabled when sync is created if set.

    menuconfig BLE_CONN_MGR_SM
        bool "Enable Security Manager"

    if BLE_CONN_MGR_SM
        choice BLE_CONN_MGR_SM_IO_TYPE
            prompt "Local Input Output Capability"
            default BLE_CONN_MGR_SM_IO_CAP_NO_IO
            help
                Select which capability does the device work, support display/keyboard/both.

            config BLE_CONN_MGR_SM_IO_CAP_DISP_ONLY
                bool "Display Only"
            config BLE_CONN_MGR_SM_IO_CAP_DISP_YES_NO
                bool "Display Yes/No"
            config BLE_CONN_MGR_SM_IO_CAP_KEYBOARD_ONLY
                bool "Keyboard Only"
            config BLE_CONN_MGR_SM_IO_CAP_NO_IO
                bool "Just works"
            config BLE_CONN_MGR_SM_IO_CAP_KEYBOARD_DISP
                bool "Both Keyboard & Display"
        endchoice

        config BLE_CONN_MGR_SM_IO_TYPE
            int
            default 0 if BLE_CONN_MGR_SM_IO_CAP_DISP_ONLY
            default 1 if BLE_CONN_MGR_SM_IO_CAP_DISP_YES_NO
            default 2 if BLE_CONN_MGR_SM_IO_CAP_KEYBOARD_ONLY
            default 3 if BLE_CONN_MGR_SM_IO_CAP_NO_IO
            default 4 if BLE_CONN_MGR_SM_IO_CAP_KEYBOARD_DISP

        config BLE_CONN_MGR_SM_CAP
            int
            range 0 15
            default 0
            prompt "Set Security Manager Capability"
            help
                Set security manager capability.

                This is a bitmap represents security manager capability of the device, the bits are defined as follows:

                - BIT0: OOB flag, it requires Out-Of-Band information when pairing if set.
                - BIT1: Bond flag, it stores keys distributed during bonding if set.
                - BIT2: MITM flag, it requires Man-In-The-Middle protection when pairing if set.
                - BIT3: Secure Connections flag, it requires secure connections for pairing if also supported by remote device if set.

        config BLE_CONN_MGR_SM_KEY_DIST
            int
            range 0 15
            default 0
            prompt "Set Key Distribution"
            help
                Set key distribution to indicate which keys to distribute during pairing, it will be set if bond flag is set to 1.

    endif # BLE_CONN_MGR_SM

endmenu
```

## components/bluetooth/ble_profiles/esp/ble_ota/Kconfig
```kconfig
menu "OTA Manager"
    choice OTA_TYPE
        prompt "Type of OTA"
        default OTA_WITHOUT_SECURITY

        config OTA_WITHOUT_SECURITY
            bool "Enable OTA without security"
            help
                This transfers file without any security using OTA

        config OTA_WITH_PROTOCOMM
            bool
            prompt "Enable protocomm level security"
            depends on BT_NIMBLE_ENABLED
            help
                Used to enable protocomm level security for file transfer using OTA

        config PRE_ENC_OTA
            bool
            prompt "Enable pre encrypted OTA"
            depends on BT_NIMBLE_ENABLED
            help
                Used to enable transferring pre encrypted file via OTA
    endchoice
endmenu
```

## components/bluetooth/ble_profiles/esp/ble_ota_raw/Kconfig
```kconfig
menuconfig BLE_OTA_RAW_PROFILE
    bool "BLE OTA Raw Profile"
    select BLE_OTA_SVC
    select BLE_DIS
```

## components/bluetooth/ble_profiles/std/ble_anp/Kconfig
```kconfig
menu "BLE Profile: Alert Notification"
    config BLE_ALERT_NOTIFICATION_PROFILES
    bool "Enable Alert Notification Profile"
    default n
    help
        Enable support for Alert Notification Profile.
endmenu
```

## components/bluetooth/ble_profiles/std/ble_hrp/Kconfig
```kconfig
menu "BLE Profile: Heart Rate"
    config BLE_HEART_RATE_PROFILES
    bool "Enable Heart Rate Profile"
    default n
    help
        Enable support for Heart Rate Profile.

endmenu
```

## components/bluetooth/ble_profiles/std/ble_htp/Kconfig
```kconfig
menu "BLE Profile: Health Thermometer"
    config BLE_HEALTH_THERMOMETER_PROFILES
        bool "Enable Health Thermometer Profile"
        default n
        help
            Enable support for Health Thermometer Profile.
endmenu
```

## components/bluetooth/ble_profiles/std/ble_otp/Kconfig
```kconfig
menu "BLE Profile: Object Transfer"
    config BLE_OBJECT_TRANSFER_PROFILE
        bool "Enable Object Transfer Profile"
        default n
        select BLE_OTS
        help
            Enable support for Object Transfer Profile (OTP). This profile
            is based on the Object Transfer Service (OTS) and uses L2CAP CoC
            for bulk data transfer.
endmenu
```

## components/bluetooth/ble_profiles/third_party/ble_midi/Kconfig
```kconfig
menu "BLE Profile: MIDI over BLE"
    config BLE_MIDI_PROFILE
        bool "Enable MIDI over BLE Profile"
        default n
        help
            Enable support for MIDI over BLE (BLE-MIDI) profile.
endmenu
```

## components/bluetooth/ble_services/Kconfig
```kconfig
menu "BLE Standard Services"

    orsource "./ans/Kconfig.in"
    orsource "./bas/Kconfig.in"
    orsource "./bcs/Kconfig.in"
    orsource "./cts/Kconfig.in"
    orsource "./dis/Kconfig.in"
    orsource "./hrs/Kconfig.in"
    orsource "./hts/Kconfig.in"
    orsource "./midi/Kconfig.in"
    orsource "./tps/Kconfig.in"
    orsource "./uds/Kconfig.in"
    orsource "./wss/Kconfig.in"

endmenu
```

## components/bluetooth/ble_services/ans/Kconfig.in
```kconfig
# GATT Alert Notification Service

menuconfig BLE_ANS
    bool "GATT Alert Notification Service"

if BLE_ANS

endif # BLE_ANS
```

## components/bluetooth/ble_services/bas/Kconfig.in
```kconfig
# GATT Battery Service

menuconfig BLE_BAS
    bool "GATT Battery Service"

if BLE_BAS

config BLE_BAS_BATTERY_LEVEL_NOTIFY_ENABLE
    bool "Battery Level Notification"
    default y
    help
      Set y to support notification or n to disable it.

config BLE_BAS_BATTERY_LEVEL_STATUS
    bool "Battery Level Status characteristic"
    help
      Enable Battery Level Status characteristic in Battery Service.

config BLE_BAS_BATTERY_LEVEL_STATUS_INDICATE_ENABLE
    bool "Battery Level Status Indicate"
    default y
    depends on BLE_BAS_BATTERY_LEVEL_STATUS
    help
      Set y to support indicate or n to disable it.

config BLE_BAS_ESTIMATED_SERVICE_DATE
    bool "Estimated Service Date characteristic"
    help
      Enable Estimated Service Date characteristic in Battery Service.

config BLE_BAS_ESTIMATED_SERVICE_DATE_INDICATE_ENABLE
    bool "Estimated Service Date Indicate"
    default y
    depends on BLE_BAS_ESTIMATED_SERVICE_DATE
    help
      Set y to support indicate or n to disable it.

config BLE_BAS_BATTERY_CRITICAL_STATUS
    bool "Battery Critical Status characteristic"
    help
      Enable Battery Critical Status characteristic in Battery Service.

config BLE_BAS_BATTERY_ENERGY_STATUS
    bool "Battery Energy Status characteristic"
    help
      Enable Battery Energy Status characteristic in Battery Service.

config BLE_BAS_BATTERY_ENERGY_STATUS_INDICATE_ENABLE
    bool "Battery Energy Status Indicate"
    default y
    depends on BLE_BAS_BATTERY_ENERGY_STATUS
    help
      Set y to support indicate or n to disable it.

config BLE_BAS_BATTERY_TIME_STATUS
    bool "Battery Time Status characteristic"
    help
      Enable Battery Time Status characteristic in Battery Service.

config BLE_BAS_BATTERY_TIME_STATUS_INDICATE_ENABLE
    bool "Battery Energy Status Indicate"
    default y
    depends on BLE_BAS_BATTERY_TIME_STATUS
    help
      Set y to support indicate or n to disable it.

config BLE_BAS_BATTERY_HEALTH_STATUS
    bool "Battery Health Status characteristic"
    help
      Enable Battery Health Status characteristic in Battery Service.

config BLE_BAS_BATTERY_HEALTH_STATUS_INDICATE_ENABLE
    bool "Battery Health Status Indicate"
    default y
    depends on BLE_BAS_BATTERY_HEALTH_STATUS
    help
      Set y to support indicate or n to disable it.

config BLE_BAS_BATTERY_HEALTH_INFORMATION
    bool "Battery Health Information characteristic"
    help
      Enable Battery Health Information characteristic in Battery Service.

config BLE_BAS_BATTERY_INFORMATION
    bool "Battery Information characteristic"
    help
      Enable Battery Information characteristic in Battery Service.

endif # BLE_BAS
```

## components/bluetooth/ble_services/bcs/Kconfig.in
```kconfig
# Body Composition Service

menuconfig BLE_BCS
    bool "GATT Body Composition Service"

if BLE_BCS

config BLE_BCS_FEATURE_INDICATE_ENABLE
    bool "Body Composition Feature Indication"
    default y
    help
      Set y to support Indication or n to disable it.

endif # BLE_BCS
```
